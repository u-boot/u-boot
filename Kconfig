## arch/arm/cpu/arm1176/bcm2835/Kconfig
```kconfig
if TARGET_RPI || TARGET_RPI_2

config DM
	default y

config DM_SERIAL
	default y

config DM_GPIO
	default y

endif
```

## arch/arm/cpu/arm926ejs/davinci/Kconfig
```kconfig
if ARCH_DAVINCI

choice
	prompt "DaVinci board select"

config TARGET_ENBW_CMC
	bool "EnBW CMC board"

config TARGET_IPAM390
	bool "IPAM390 board"
	select SUPPORT_SPL

config TARGET_DA830EVM
	bool "DA830 EVM board"

config TARGET_DA850EVM
	bool "DA850 EVM board"
	select SUPPORT_SPL

config TARGET_CAM_ENC_4XX
	bool "CAM ENC 4xx board"
	select SUPPORT_SPL

config TARGET_HAWKBOARD
	bool "Hawkboard"
	select SUPPORT_SPL

config TARGET_DAVINCI_DM355EVM
	bool "DM355 EVM board"

config TARGET_DAVINCI_DM355LEOPARD
	bool "DM355 Leopard board"

config TARGET_DAVINCI_DM365EVM
	bool "DM365 EVM board"

config TARGET_DAVINCI_DM6467EVM
	bool "DM6467 EVM board"

config TARGET_DAVINCI_DVEVM
	bool "DVEVM board"

config TARGET_EA20
	bool "EA20 board"

config TARGET_DAVINCI_SCHMOOGIE
	bool "Schmoogie board"

config TARGET_DAVINCI_SFFSDR
	bool "SFFSDR board"

config TARGET_DAVINCI_SONATA
	bool "Sonata board"

config TARGET_CALIMAIN
	bool "Calimain board"

endchoice

config SYS_SOC
	default "davinci"

source "board/enbw/enbw_cmc/Kconfig"
source "board/ait/cam_enc_4xx/Kconfig"
source "board/Barix/ipam390/Kconfig"
source "board/davinci/da8xxevm/Kconfig"
source "board/davinci/dm355evm/Kconfig"
source "board/davinci/dm355leopard/Kconfig"
source "board/davinci/dm365evm/Kconfig"
source "board/davinci/dm6467evm/Kconfig"
source "board/davinci/dvevm/Kconfig"
source "board/davinci/ea20/Kconfig"
source "board/davinci/schmoogie/Kconfig"
source "board/davinci/sffsdr/Kconfig"
source "board/davinci/sonata/Kconfig"
source "board/omicron/calimain/Kconfig"

endif
```

## arch/arm/cpu/arm926ejs/kirkwood/Kconfig
```kconfig
if KIRKWOOD

choice
	prompt "Marvell Kirkwood board select"

config TARGET_OPENRD
	bool "Marvell OpenRD Board"

config TARGET_MV88F6281GTW_GE
	bool "MV88f6281GTW_GE Board"

config TARGET_RD6281A
	bool "RD6281A Board"

config TARGET_DREAMPLUG
	bool "DreamPlug Board"

config TARGET_GURUPLUG
	bool "GuruPlug Board"

config TARGET_SHEEVAPLUG
	bool "SheevaPlug Board"

config TARGET_LSXL
	bool "lsxl Board"

config TARGET_POGO_E02
	bool "pogo_e02 Board"

config TARGET_DNS325
	bool "dns325 Board"

config TARGET_ICONNECT
	bool "iconnect Board"

config TARGET_TK71
	bool "TK71 Board"

config TARGET_KM_KIRKWOOD
	bool "KM_KIRKWOOD Board"

config TARGET_NET2BIG_V2
	bool "LaCie 2Big Network v2 NAS Board"

config TARGET_NETSPACE_V2
	bool "LaCie netspace_v2 Board"

config TARGET_WIRELESS_SPACE
	bool "LaCie Wireless_space Board"

config TARGET_IB62X0
	bool "ib62x0 Board"

config TARGET_DOCKSTAR
	bool "Dockstar Board"

config TARGET_GOFLEXHOME
	bool "GoFlex Home Board"

endchoice

config SYS_SOC
	default "kirkwood"

source "board/Marvell/openrd/Kconfig"
source "board/Marvell/mv88f6281gtw_ge/Kconfig"
source "board/Marvell/rd6281a/Kconfig"
source "board/Marvell/dreamplug/Kconfig"
source "board/Marvell/guruplug/Kconfig"
source "board/Marvell/sheevaplug/Kconfig"
source "board/buffalo/lsxl/Kconfig"
source "board/cloudengines/pogo_e02/Kconfig"
source "board/d-link/dns325/Kconfig"
source "board/iomega/iconnect/Kconfig"
source "board/karo/tk71/Kconfig"
source "board/keymile/km_arm/Kconfig"
source "board/LaCie/net2big_v2/Kconfig"
source "board/LaCie/netspace_v2/Kconfig"
source "board/LaCie/wireless_space/Kconfig"
source "board/raidsonic/ib62x0/Kconfig"
source "board/Seagate/dockstar/Kconfig"
source "board/Seagate/goflexhome/Kconfig"

endif
```

## arch/arm/cpu/arm926ejs/orion5x/Kconfig
```kconfig
if ORION5X

choice
	prompt "Marvell Orion board select"

config TARGET_EDMINIV2
	bool "LaCie Ethernet Disk mini V2"

endchoice

config SYS_CPU
	default "arm926ejs"

config SYS_SOC
	default "orion5x"

source "board/LaCie/edminiv2/Kconfig"

endif
```

## arch/arm/cpu/arm926ejs/versatile/Kconfig
```kconfig
if ARCH_VERSATILE

config SYS_BOARD
	default "versatile"

config SYS_VENDOR
	default "armltd"

config SYS_SOC
	default "versatile"

config SYS_CONFIG_NAME
	default "versatile"

endif
```

## arch/arm/cpu/armv7/Kconfig
```kconfig
if CPU_V7

config CPU_V7_HAS_NONSEC
        bool

config CPU_V7_HAS_VIRT
        bool

config ARMV7_NONSEC
	bool "Enable support for booting in non-secure mode" if EXPERT
	depends on CPU_V7_HAS_NONSEC
	default y
	---help---
	Say Y here to enable support for booting in non-secure / SVC mode.

config ARMV7_BOOT_SEC_DEFAULT
	bool "Boot in secure mode by default" if EXPERT
	depends on ARMV7_NONSEC
	default y if TEGRA
	---help---
	Say Y here to boot in secure mode by default even if non-secure mode
	is supported. This option is useful to boot kernels which do not
	suppport booting in non-secure mode. Only set this if you need it.
	This can be overridden at run-time by setting the bootm_boot_mode env.
	variable to "sec" or "nonsec".

config ARMV7_VIRT
	bool "Enable support for hardware virtualization" if EXPERT
	depends on CPU_V7_HAS_VIRT && ARMV7_NONSEC
	default y
	---help---
	Say Y here to boot in hypervisor (HYP) mode when booting non-secure.

config ARMV7_LPAE
	bool "Use LPAE page table format" if EXPERT
	depends on CPU_V7
	default n
	---help---
	Say Y here to use the long descriptor page table format. This is
	required if U-Boot runs in HYP mode.

endif
```

## arch/arm/cpu/armv7/am33xx/Kconfig
```kconfig
if AM43XX
config TARGET_AM43XX_EVM
	bool "Support am43xx_evm"
	select TI_I2C_BOARD_DETECT
	help
	  This option specifies support for the AM43xx
	  GP and HS EVM development platforms.The AM437x
	  GP EVM is a standalone test, development, and
	  evaluation module system that enables developers
	  to write software and develop hardware around
	  an AM43xx processor subsystem.

config ISW_ENTRY_ADDR
	hex "Address in memory or XIP flash of bootloader entry point"
	help
	  After any reset, the boot ROM on the AM43XX SOC
	  searches the boot media for a valid boot image.
	  For non-XIP devices, the ROM then copies the
	  image into internal memory.
	  For all boot modes, after the ROM processes the
	  boot image it eventually computes the entry
	  point address depending on the device type
	  (secure/non-secure), boot media (xip/non-xip) and
	  image headers.
	default 0x402F4000

config PUB_ROM_DATA_SIZE
	hex "Size in bytes of the L3 SRAM reserved by ROM to store data"
	help
	  During the device boot, the public ROM uses the top of
	  the public L3 OCMC RAM to store r/w data like stack,
	  heap, globals etc. When the ROM is copying the boot
	  image from the boot media into memory, the image must
	  not spill over into this area. This value can be used
	  during compile time to determine the maximum size of a
	  boot image. Once the ROM transfers control to the boot
	  image, this area is no longer used, and can be reclaimed
	  for run time use by the boot image.
	default 0x8400
endif
```

## arch/arm/cpu/armv7/exynos/Kconfig
```kconfig
if ARCH_EXYNOS

choice
	prompt "EXYNOS board select"

config TARGET_SMDKV310
	select SUPPORT_SPL
	bool "Exynos4210 SMDKV310 board"
	select OF_CONTROL if !SPL_BUILD

config TARGET_TRATS
	bool "Exynos4210 Trats board"

config TARGET_S5PC210_UNIVERSAL
	bool "EXYNOS4210 Universal C210 board"

config TARGET_ORIGEN
	bool "Exynos4412 Origen board"
	select SUPPORT_SPL

config TARGET_TRATS2
	bool "Exynos4412 Trat2 board"

config TARGET_ODROID
	bool "Exynos4412 Odroid board"

config TARGET_ODROID_XU3
	bool "Exynos5422 Odroid board"
	select OF_CONTROL

config TARGET_ARNDALE
	bool "Exynos5250 Arndale board"
	select CPU_V7_HAS_NONSEC
	select CPU_V7_HAS_VIRT
	select SUPPORT_SPL
	select OF_CONTROL if !SPL_BUILD

config TARGET_SMDK5250
	bool "SMDK5250 board"
	select SUPPORT_SPL
	select OF_CONTROL if !SPL_BUILD

config TARGET_SNOW
	bool "Snow board"
	select SUPPORT_SPL
	select OF_CONTROL if !SPL_BUILD

config TARGET_SMDK5420
	bool "SMDK5420 board"
	select SUPPORT_SPL
	select OF_CONTROL if !SPL_BUILD

config TARGET_PEACH_PI
	bool "Peach Pi board"
	select SUPPORT_SPL
	select OF_CONTROL if !SPL_BUILD

config TARGET_PEACH_PIT
	bool "Peach Pit board"
	select SUPPORT_SPL
	select OF_CONTROL if !SPL_BUILD

endchoice

config SYS_SOC
	default "exynos"

source "board/samsung/smdkv310/Kconfig"
source "board/samsung/trats/Kconfig"
source "board/samsung/universal_c210/Kconfig"
source "board/samsung/origen/Kconfig"
source "board/samsung/trats2/Kconfig"
source "board/samsung/odroid/Kconfig"
source "board/samsung/arndale/Kconfig"
source "board/samsung/smdk5250/Kconfig"
source "board/samsung/smdk5420/Kconfig"

endif
```

## arch/arm/cpu/armv7/highbank/Kconfig
```kconfig
if ARCH_HIGHBANK

config SYS_CPU
	default "armv7"

config SYS_BOARD
	default "highbank"

config SYS_SOC
	default "highbank"

config SYS_CONFIG_NAME
	default "highbank"

endif
```

## arch/arm/cpu/armv7/keystone/Kconfig
```kconfig
if ARCH_KEYSTONE

choice
	prompt "TI Keystone board select"

config TARGET_K2HK_EVM
	bool "TI Keystone 2 Kepler/Hawking EVM"

config TARGET_K2E_EVM
	bool "TI Keystone 2 Edison EVM"

config TARGET_K2L_EVM
	bool "TI Keystone 2 Lamar EVM"

endchoice

config SYS_SOC
	default "keystone"

source "board/ti/ks2_evm/Kconfig"

endif
```

## arch/arm/cpu/armv7/ls102xa/Kconfig
```kconfig
config ARCH_LS1021A
	bool
	select SYS_FSL_ERRATUM_A010315
	select SYS_FSL_SRDS_1
	select SYS_HAS_SERDES
	select SYS_FSL_DDR_BE
	select SYS_FSL_DDR_VER_50

menu "LS102xA architecture"
	depends on ARCH_LS1021A

config LS1_DEEP_SLEEP
	bool "Deep sleep"
	depends on ARCH_LS1021A

config MAX_CPUS
	int "Maximum number of CPUs permitted for LS102xA"
	depends on ARCH_LS1021A
	default 2
	help
	  Set this number to the maximum number of possible CPUs in the SoC.
	  SoCs may have multiple clusters with each cluster may have multiple
	  ports. If some ports are reserved but higher ports are used for
	  cores, count the reserved ports. This will allocate enough memory
	  in spin table to properly handle all cores.

config NUM_DDR_CONTROLLERS
	int "Maximum DDR controllers"
	default 1

config SECURE_BOOT
	bool	"Secure Boot"
	help
		Enable Freescale Secure Boot feature. Normally selected
		by defconfig. If unsure, do not change.

config SYS_FSL_ERRATUM_A010315
	bool "Workaround for PCIe erratum A010315"

config SYS_FSL_SRDS_1
	bool

config SYS_FSL_SRDS_2
	bool

config SYS_HAS_SERDES
	bool

config SYS_FSL_DDR
	bool "Freescale DDR driver"
	help
	  Select Freescale General DDR driver, shared between most Freescale
	  PowerPC- based SoCs (such as mpc83xx, mpc85xx, mpc86xx) and ARM-
	  based Layerscape SoCs (such as ls2080a).

config SYS_FSL_DDR_BE
	bool
	default y
	help
	  Access DDR registers in big-endian.

config SYS_FSL_DDR_VER
	int
	default 50 if SYS_FSL_DDR_VER_50

config SYS_FSL_DDR_VER_50
	bool

config SYS_FSL_DDRC_ARM_GEN3
	bool

config SYS_FSL_DDRC_GEN4
	bool

config SYS_FSL_DDR3
	bool "Freescale DDR3 controller"
	depends on !SYS_FSL_DDR4
	select SYS_FSL_DDR
	select SYS_FSL_DDRC_ARM_GEN3
	help
	  Enable Freescale DDR3 controller on ARM-based SoCs.

config SYS_FSL_DDR4
	bool "Freescale DDR4 controller"
	select SYS_FSL_DDR
	select SYS_FSL_DDRC_GEN4
	help
	  Enable Freescale DDR4 controller.

config SYS_FSL_IFC_BANK_COUNT
	int "Maximum banks of Integrated flash controller"
	depends on ARCH_LS1021A
	default 8

endmenu
```

## arch/arm/cpu/armv7/mx5/Kconfig
```kconfig
if ARCH_MX5

config MX5
	bool
	default y

config MX51
	bool

config MX53
	bool

choice
	prompt "MX5 board select"
	optional

config TARGET_USBARMORY
	bool "Support USB armory"
	select CPU_V7

config TARGET_MX53CX9020
	bool "Support CX9020"
	select CPU_V7
	select MX53
	select DM
	select DM_SERIAL

endchoice

config SYS_SOC
	default "mx5"

source "board/beckhoff/mx53cx9020/Kconfig"
source "board/inversepath/usbarmory/Kconfig"

endif
```
