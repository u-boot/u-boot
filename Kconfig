## arch/arm/cpu/armv7/mx6/Kconfig
```kconfig
if ARCH_MX6

config MX6
	bool
	default y

config MX6D
	bool

config MX6DL
	bool

config MX6Q
	bool

config MX6QDL
	bool

config MX6S
	bool

config MX6SL
	bool

config MX6SX
	select ROM_UNIFIED_SECTIONS
	bool

config MX6UL
	select SYS_L2CACHE_OFF
	select ROM_UNIFIED_SECTIONS
	bool

config MX6ULL
	bool
	select MX6UL

config MX6_DDRCAL
	bool "Include dynamic DDR calibration routines"
	depends on SPL
	default n
	help
	  Say "Y" if your board uses dynamic (per-boot) DDR calibration.
	  If unsure, say N.

choice
	prompt "MX6 board select"
	optional

config TARGET_ADVANTECH_DMS_BA16
	bool "Advantech dms-ba16"
	select MX6Q

config TARGET_ARISTAINETOS
	bool "aristainetos"

config TARGET_ARISTAINETOS2
	bool "aristainetos2"

config TARGET_ARISTAINETOS2B
	bool "Support aristainetos2-revB"

config TARGET_CGTQMX6EVAL
	bool "cgtqmx6eval"
	select SUPPORT_SPL
	select DM
	select DM_THERMAL

config TARGET_CM_FX6
	bool "CM-FX6"
	select SUPPORT_SPL
	select DM
	select DM_SERIAL
	select DM_GPIO

config TARGET_EMBESTMX6BOARDS
	bool "embestmx6boards"

config TARGET_GE_B450V3
	bool "General Electric B450v3"
	select MX6Q

config TARGET_GE_B650V3
	bool "General Electric B650v3"
	select MX6Q

config TARGET_GE_B850V3
	bool "General Electric B850v3"
	select MX6Q

config TARGET_GW_VENTANA
	bool "gw_ventana"
	select SUPPORT_SPL

config TARGET_KOSAGI_NOVENA
	bool "Kosagi Novena"
	select SUPPORT_SPL

config TARGET_MX6CUBOXI
	bool "Solid-run mx6 boards"
	select SUPPORT_SPL

config TARGET_MX6QARM2
	bool "mx6qarm2"

config TARGET_MX6Q_ICORE
	bool "Support Engicam i.Core"
	select MX6QDL
	select OF_CONTROL
	select DM
	select DM_GPIO
	select DM_MMC
	select DM_THERMAL
	select SUPPORT_SPL

config TARGET_MX6QSABREAUTO
	bool "mx6qsabreauto"
	select DM
	select DM_THERMAL

config TARGET_MX6SABRESD
	bool "mx6sabresd"
	select SUPPORT_SPL
	select DM
	select DM_THERMAL

config TARGET_MX6SLEVK
	bool "mx6slevk"
	select SUPPORT_SPL

config TARGET_MX6SXSABRESD
	bool "mx6sxsabresd"
	select MX6SX
	select SUPPORT_SPL
	select DM
	select DM_THERMAL

config TARGET_MX6SXSABREAUTO
        bool "mx6sxsabreauto"
	select MX6SX
        select DM
        select DM_THERMAL

config TARGET_MX6UL_9X9_EVK
	bool "mx6ul_9x9_evk"
	select MX6UL
	select DM
	select DM_THERMAL
	select SUPPORT_SPL

config TARGET_MX6UL_14X14_EVK
	bool "mx6ul_14x14_evk"
	select MX6UL
	select DM
	select DM_THERMAL
	select SUPPORT_SPL

config TARGET_MX6ULL_14X14_EVK
	bool "Support mx6ull_14x14_evk"
	select MX6ULL
	select DM
	select DM_THERMAL

config TARGET_NITROGEN6X
	bool "nitrogen6x"

config TARGET_OT1200
	bool "Bachmann OT1200"
	select SUPPORT_SPL

config TARGET_PICO_IMX6UL
	bool "PICO-IMX6UL-EMMC"
	select MX6UL

config TARGET_PLATINUM_PICON
	bool "platinum-picon"
	select SUPPORT_SPL

config TARGET_PLATINUM_TITANIUM
	bool "platinum-titanium"
	select SUPPORT_SPL

config TARGET_PCM058
	bool "Phytec PCM058 i.MX6 Quad"
	select SUPPORT_SPL

config TARGET_SECOMX6
	bool "secomx6 boards"

config TARGET_TBS2910
	bool "TBS2910 Matrix ARM mini PC"

config TARGET_TITANIUM
	bool "titanium"

config TARGET_TQMA6
	bool "TQ Systems TQMa6 board"

config TARGET_UDOO
	bool "udoo"
	select SUPPORT_SPL

config TARGET_UDOO_NEO
	bool "UDOO Neo"
	select SUPPORT_SPL

config TARGET_SAMTEC_VINING_2000
	bool "samtec VIN|ING 2000"
	select MX6SX
	select DM
	select DM_THERMAL

config TARGET_WANDBOARD
	bool "wandboard"
	select SUPPORT_SPL

config TARGET_WARP
	bool "WaRP"

config TARGET_XPRESS
	bool "CCV xPress"
	select MX6UL
	select DM
	select DM_THERMAL
	select SUPPORT_SPL

config TARGET_ZC5202
	bool "zc5202"
	select SUPPORT_SPL
	select DM
	select DM_THERMAL

config TARGET_ZC5601
	bool "zc5601"
	select SUPPORT_SPL
	select DM
	select DM_THERMAL

endchoice

config SYS_SOC
	default "mx6"

source "board/ge/bx50v3/Kconfig"
source "board/advantech/dms-ba16/Kconfig"
source "board/aristainetos/Kconfig"
source "board/bachmann/ot1200/Kconfig"
source "board/barco/platinum/Kconfig"
source "board/barco/titanium/Kconfig"
source "board/boundary/nitrogen6x/Kconfig"
source "board/ccv/xpress/Kconfig"
source "board/compulab/cm_fx6/Kconfig"
source "board/congatec/cgtqmx6eval/Kconfig"
source "board/el/el6x/Kconfig"
source "board/embest/mx6boards/Kconfig"
source "board/engicam/icorem6/Kconfig"
source "board/freescale/mx6qarm2/Kconfig"
source "board/freescale/mx6qsabreauto/Kconfig"
source "board/freescale/mx6sabresd/Kconfig"
source "board/freescale/mx6slevk/Kconfig"
source "board/freescale/mx6sxsabresd/Kconfig"
source "board/freescale/mx6sxsabreauto/Kconfig"
source "board/freescale/mx6ul_14x14_evk/Kconfig"
source "board/freescale/mx6ullevk/Kconfig"
source "board/phytec/pcm058/Kconfig"
source "board/gateworks/gw_ventana/Kconfig"
source "board/kosagi/novena/Kconfig"
source "board/samtec/vining_2000/Kconfig"
source "board/seco/Kconfig"
source "board/solidrun/mx6cuboxi/Kconfig"
source "board/technexion/pico-imx6ul/Kconfig"
source "board/tbs/tbs2910/Kconfig"
source "board/tqc/tqma6/Kconfig"
source "board/udoo/Kconfig"
source "board/udoo/neo/Kconfig"
source "board/wandboard/Kconfig"
source "board/warp/Kconfig"

endif
```

## arch/arm/cpu/armv7/mx7/Kconfig
```kconfig
if ARCH_MX7

config MX7
	bool
	select ROM_UNIFIED_SECTIONS
	select CPU_V7_HAS_VIRT
	select CPU_V7_HAS_NONSEC
	select ARCH_SUPPORT_PSCI
	default y

config MX7D
	select ROM_UNIFIED_SECTIONS
	bool

choice
	prompt "MX7 board select"
	optional

config TARGET_MX7DSABRESD
	bool "mx7dsabresd"
	select MX7D
	select DM
	select DM_THERMAL

config TARGET_WARP7
	bool "warp7"
	select MX7D
	select DM
	select DM_THERMAL

config TARGET_COLIBRI_IMX7
	bool "Support Colibri iMX7S/iMX7D modules"
	select DM
	select DM_SERIAL
	select DM_THERMAL

endchoice

config SYS_SOC
	default "mx7"

source "board/freescale/mx7dsabresd/Kconfig"
source "board/toradex/colibri_imx7/Kconfig"
source "board/warp7/Kconfig"

endif
```

## arch/arm/cpu/armv7/omap-common/Kconfig
```kconfig
config TI_SECURE_DEVICE
	bool "HS Device Type Support"
	depends on OMAP54XX || AM43XX
	help
	  If a high secure (HS) device type is being used, this config
	  must be set. This option impacts various aspects of the
	  build system (to create signed boot images that can be
	  authenticated) and the code. See the doc/README.ti-secure
	  file for further details.

source "arch/arm/cpu/armv7/omap3/Kconfig"

source "arch/arm/cpu/armv7/omap4/Kconfig"

source "arch/arm/cpu/armv7/omap5/Kconfig"

source "arch/arm/cpu/armv7/am33xx/Kconfig"
```

## arch/arm/cpu/armv7/omap3/Kconfig
```kconfig
if OMAP34XX

choice
	prompt "OMAP3 board select"

config TARGET_AM3517_EVM
	bool "AM3517 EVM"
	select SUPPORT_SPL

config TARGET_MT_VENTOUX
	bool "TeeJet Mt.Ventoux"
	select SUPPORT_SPL

config TARGET_OMAP3_SDP3430
	bool "TI OMAP3430 SDP"

config TARGET_OMAP3_BEAGLE
	bool "TI OMAP3 BeagleBoard"
	select SUPPORT_SPL

config TARGET_CM_T35
	bool "CompuLab CM-T3530 and CM-T3730 boards"
	select SUPPORT_SPL

config TARGET_CM_T3517
	bool "CompuLab CM-T3517 boards"

config TARGET_DEVKIT8000
	bool "TimLL OMAP3 Devkit8000"
	select SUPPORT_SPL

config TARGET_OMAP3_EVM
	bool "TI OMAP3 EVM"
	select SUPPORT_SPL

config TARGET_OMAP3_EVM_QUICK_MMC
	bool "TI OMAP3 EVM Quick MMC"
	select SUPPORT_SPL

config TARGET_OMAP3_EVM_QUICK_NAND
	bool "TI OMAP3 EVM Quick NAND"
	select SUPPORT_SPL

config TARGET_OMAP3_IGEP00X0
	bool "IGEP"
	select SUPPORT_SPL

config TARGET_OMAP3_OVERO
	bool "OMAP35xx Gumstix Overo"
	select SUPPORT_SPL

config TARGET_OMAP3_ZOOM1
	bool "TI Zoom1"

config TARGET_AM3517_CRANE
	bool "am3517_crane"
	select SUPPORT_SPL

config TARGET_OMAP3_PANDORA
	bool "OMAP3 Pandora"

config TARGET_ECO5PK
	bool "ECO5PK"
	select SUPPORT_SPL

config TARGET_DIG297
	bool "DIG297"

config TARGET_TRICORDER
	bool "Tricorder"
	select SUPPORT_SPL

config TARGET_MCX
	bool "MCX"
	select SUPPORT_SPL

config TARGET_OMAP3_LOGIC
	bool "OMAP3 Logic"

config TARGET_OMAP3_MVBLX
	bool "OMAP3 MVBLX"

config TARGET_NOKIA_RX51
	bool "Nokia RX51"

config TARGET_TAO3530
	bool "TAO3530"
	select SUPPORT_SPL

config TARGET_TWISTER
	bool "Twister"
	select SUPPORT_SPL

endchoice

config SYS_SOC
	default "omap3"

source "board/logicpd/am3517evm/Kconfig"
source "board/teejet/mt_ventoux/Kconfig"
source "board/ti/sdp3430/Kconfig"
source "board/ti/beagle/Kconfig"
source "board/compulab/cm_t35/Kconfig"
source "board/compulab/cm_t3517/Kconfig"
source "board/timll/devkit8000/Kconfig"
source "board/ti/evm/Kconfig"
source "board/isee/igep00x0/Kconfig"
source "board/overo/Kconfig"
source "board/logicpd/zoom1/Kconfig"
source "board/ti/am3517crane/Kconfig"
source "board/pandora/Kconfig"
source "board/8dtech/eco5pk/Kconfig"
source "board/comelit/dig297/Kconfig"
source "board/corscience/tricorder/Kconfig"
source "board/htkw/mcx/Kconfig"
source "board/logicpd/omap3som/Kconfig"
source "board/matrix_vision/mvblx/Kconfig"
source "board/nokia/rx51/Kconfig"
source "board/technexion/tao3530/Kconfig"
source "board/technexion/twister/Kconfig"

endif
```

## arch/arm/cpu/armv7/omap4/Kconfig
```kconfig
if OMAP44XX

config SPL_EXT_SUPPORT
	default y

config SPL_FAT_SUPPORT
	default y

config SPL_GPIO_SUPPORT
	default y

config SPL_I2C_SUPPORT
	default y

config SPL_LIBCOMMON_SUPPORT
	default y

config SPL_LIBDISK_SUPPORT
	default y

config SPL_LIBGENERIC_SUPPORT
	default y

config SPL_MMC_SUPPORT
	default y

config SPL_NAND_SUPPORT
	default y

config SPL_POWER_SUPPORT
	default y

config SPL_SERIAL_SUPPORT
	default y

config SPL_DISPLAY_PRINT
	default y

choice
	prompt "OMAP4 board select"
	optional

config TARGET_DUOVERO
	bool "OMAP4430 Gumstix Duovero"

config TARGET_OMAP4_PANDA
	bool "TI OMAP4 PandaBoard"

config TARGET_OMAP4_SDP4430
	bool "TI OMAP4 SDP4430"

config TARGET_KC1
	bool "Amazon Kindle Fire (first generation)"

endchoice

config SYS_SOC
	default "omap4"

source "board/gumstix/duovero/Kconfig"
source "board/ti/panda/Kconfig"
source "board/ti/sdp4430/Kconfig"
source "board/amazon/kc1/Kconfig"

endif
```

## arch/arm/cpu/armv7/omap5/Kconfig
```kconfig
if OMAP54XX

config SPL_EXT_SUPPORT
	default y

config SPL_FAT_SUPPORT
	default y

config SPL_GPIO_SUPPORT
	default y

config SPL_I2C_SUPPORT
	default y

config SPL_LIBCOMMON_SUPPORT
	default y

config SPL_LIBDISK_SUPPORT
	default y

config SPL_LIBGENERIC_SUPPORT
	default y

config SPL_MMC_SUPPORT
	default y

config SPL_NAND_SUPPORT
	default y

config SPL_POWER_SUPPORT
	default y

config SPL_SERIAL_SUPPORT
	default y

config SPL_DISPLAY_PRINT
	default y

choice
	prompt "OMAP5 board select"
	optional

config TARGET_CM_T54
	bool "CompuLab CM-T54"

config TARGET_OMAP5_UEVM
	bool "TI OMAP5 uEVM board"

config TARGET_DRA7XX_EVM
	bool "TI DRA7XX"
	select TI_I2C_BOARD_DETECT
	select PHYS_64BIT

config TARGET_AM57XX_EVM
	bool "AM57XX"
	select TI_I2C_BOARD_DETECT

endchoice

config SYS_SOC
	default "omap5"

config TI_SECURE_EMIF_REGION_START
	hex "Reserved EMIF region start address"
	depends on TI_SECURE_DEVICE
	default 0x0
	help
	  Reserved EMIF region start address. Set to "0" to auto-select
	  to be at the end of the external memory region.

config TI_SECURE_EMIF_TOTAL_REGION_SIZE
	hex "Reserved EMIF region size"
	depends on TI_SECURE_DEVICE
	default 0x0
	help
	  Total reserved EMIF region size. Default is 0, which means no reserved EMIF
	  region on secure devices.

config TI_SECURE_EMIF_PROTECTED_REGION_SIZE
	hex "Size of protected region within reserved EMIF region"
	depends on TI_SECURE_DEVICE
	default 0x0
	help
	  This config option is used to specify the size of the portion of the total
	  reserved EMIF region set aside for secure OS needs that will  be protected
	  using hardware memory firewalls. This value must be smaller than the
	  TI_SECURE_EMIF_TOTAL_REGION_SIZE value.

source "board/compulab/cm_t54/Kconfig"
source "board/ti/omap5_uevm/Kconfig"
source "board/ti/dra7xx/Kconfig"
source "board/ti/am57xx/Kconfig"

endif
```

## arch/arm/cpu/armv7/rmobile/Kconfig
```kconfig
if RMOBILE

choice
	prompt "Renesus ARM SoCs board select"

config TARGET_ARMADILLO_800EVA
	bool "armadillo 800 eva board"

config TARGET_GOSE
	bool "Gose board"

config TARGET_KOELSCH
	bool "Koelsch board"

config TARGET_LAGER
	bool "Lager board"

config TARGET_KZM9G
	bool "KZM9D board"

config TARGET_ALT
	bool "Alt board"

config TARGET_SILK
	bool "Silk board"

config TARGET_PORTER
	bool "Porter board"

endchoice

config SYS_SOC
	default "rmobile"

config RMOBILE_EXTRAM_BOOT
	bool "Enable boot from RAM"
	depends on TARGET_ALT || TARGET_KOELSCH || TARGET_LAGER || TARGET_PORTER || TARGET_SILK
	default n

source "board/atmark-techno/armadillo-800eva/Kconfig"
source "board/renesas/gose/Kconfig"
source "board/renesas/koelsch/Kconfig"
source "board/renesas/lager/Kconfig"
source "board/kmc/kzm9g/Kconfig"
source "board/renesas/alt/Kconfig"
source "board/renesas/silk/Kconfig"
source "board/renesas/porter/Kconfig"

endif
```
