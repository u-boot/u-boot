/*
 * Copyright (C) 2015 Synopsys, Inc. (www.synopsys.com)
 *
 * SPDX-License-Identifier:	GPL-2.0+
 */
/dts-v1/;

#include "skeleton.dtsi"

/ {
	#address-cells = <1>;
	#size-cells = <1>;

	aliases {
		console = &uart0;
	};

	uart0: serial@ff100000 {
			compatible = "snps,dw-apb-uart";
			reg = <0xff100000 0x1000>;
			reg-shift = <2>;
			reg-io-width = <4>;
	};
};
