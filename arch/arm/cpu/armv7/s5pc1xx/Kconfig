## arch/arm/mach-apple/Kconfig
```kconfig
if ARCH_APPLE

config TEXT_BASE
	default 0x00000000

config SYS_SOC
	default "apple"

config SYS_VENDOR
	default "apple"

config SYS_BOARD
	string "Board name"
	default "mac"
	help
	  This option contains information about board name.
	  Based on this option board/<CONFIG_SYS_VENDOR>/<CONFIG_SYS_BOARD> will
	  be used.
	  Apple silicon based devices are expected to use the generic board name
	  "mac".

config SYS_MALLOC_LEN
	default 0x4000000

config SYS_MALLOC_F_LEN
	default 0x4000

config LNX_KRNL_IMG_TEXT_OFFSET_BASE
	default TEXT_BASE

endif
```

## arch/arm/mach-aspeed/Kconfig
```kconfig
if ARCH_ASPEED

config SYS_ARCH
	default "arm"

config SYS_SOC
	default "aspeed"

config TEXT_BASE
	default 0x00000000

choice
	prompt "Aspeed SoC select"
	depends on ARCH_ASPEED
	default ASPEED_AST2500

config ASPEED_AST2500
	bool "Support Aspeed AST2500 SoC"
	select CPU_ARM1176
	select DM_RESET
	select REGMAP
	help
	  The Aspeed AST2500 is a ARM-based SoC with arm1176 CPU.
	  It is used as Board Management Controller on many server boards,
	  which is enabled by support of LPC and eSPI peripherals.

config ASPEED_AST2600
	bool "Support Aspeed AST2600 SoC"
	select CPU_V7A
	select CPU_V7_HAS_NONSEC
	select SYS_ARCH_TIMER
	select SUPPORT_SPL
	select ENABLE_ARM_SOC_BOOT0_HOOK
	help
	  The Aspeed AST2600 is a ARM-based SoC with Cortex-A7 CPU.
	  It is used as Board Management Controller on many server boards,
	  which is enabled by support of LPC and eSPI peripherals.

config ASPEED_AST2700
	bool "Support Aspeed AST2700 SoC"
	select ARM64
	select SYS_ARCH_TIMER
	help
	  Support for the Aspeed AST2700, an arm64 (Cortex-A35) Baseboard
	  Management Controller (BMC) SoC. This is the 8th-generation BMC
	  SoC family from Aspeed and features a dual-die architecture
	  (CPU die + I/O die) connected via an internal coherent bus.

endchoice

source "arch/arm/mach-aspeed/ast2500/Kconfig"
source "arch/arm/mach-aspeed/ast2600/Kconfig"
source "arch/arm/mach-aspeed/ast2700/Kconfig"

endif
```

## arch/arm/mach-aspeed/ast2700/Kconfig
```kconfig
if ASPEED_AST2700

config SYS_CPU
	default "armv8"

config SPI_KERNEL_FIT_ADDR
	hex "SPI address of kernel FIT image"
	default 0x100420000
	help
	  Address in the SPI flash where the kernel FIT image is stored.
	  Used by the bootspi command to load and boot the kernel image
	  from the SPI flash on AST2700 platforms.

choice
	prompt "AST2700 board select"
	depends on ASPEED_AST2700
	default TARGET_EVB_AST2700
	help
	  Select the AST2700 board model. Each board option configures
	  the board-specific Kconfig, defaults and devicetree.

config TARGET_EVB_AST2700
	bool "EVB-AST2700"
	depends on ASPEED_AST2700
	select ARCH_MISC_INIT
	help
	  EVB-AST2700 is Aspeed evaluation board for AST2700A0 chip.
	  It has 512M of RAM, 32M of SPI flash, two Ethernet ports,
	  4 Serial ports, 4 USB ports, VGA port, PCIe, SD card slot,
	  20 pin JTAG, pinouts for 14 I2Cs, 3 SPIs and eSPI, 8 PWMs.

endchoice

source "board/aspeed/evb_ast2700/Kconfig"

endif
```

## arch/arm/mach-at91/Kconfig
```kconfig
if ARCH_AT91

choice
	prompt "Atmel AT91 board select"
	optional

config TARGET_AT91RM9200EK
	bool "Atmel AT91RM9200 evaluation kit"
	select CPU_ARM920T

config TARGET_AT91SAM9260EK
	bool "Atmel at91sam9260 reference board"
	select CPU_ARM926EJS

config TARGET_ETHERNUT5
	bool "Ethernut5 board"
	select CPU_ARM926EJS

config TARGET_SNAPPER9260
	bool "Support snapper9260"
	select CPU_ARM926EJS
	select DM
	select DM_SERIAL
	select DM_GPIO

config TARGET_AT91SAM9261EK
	bool "Atmel at91sam9261 reference board"
	select CPU_ARM926EJS

config TARGET_PM9261
	bool "Ronetix pm9261 board"
	select CPU_ARM926EJS

config TARGET_AT91SAM9263EK
	bool "Atmel at91sam9263 reference board"
	select CPU_ARM926EJS

config TARGET_USB_A9263
	bool "Caloa USB A9260 board"
	select CPU_ARM926EJS

config TARGET_PM9263
	bool "Ronetix pm9263 board"
	select CPU_ARM926EJS

config TARGET_AT91SAM9M10G45EK
	bool "Atmel AT91SAM9M10G45-EK board"
	select CPU_ARM926EJS
	select SUPPORT_SPL

config TARGET_PM9G45
	bool "Ronetix pm9g45 board"
	select CPU_ARM926EJS

config TARGET_PICOSAM9G45
	bool "Mini-box picosam9g45 board"
	select CPU_ARM926EJS
	select SUPPORT_SPL

config TARGET_AT91SAM9N12EK
	bool "Atmel AT91SAM9N12-EK board"
	select CPU_ARM926EJS
	select SUPPORT_SPL

config TARGET_AT91SAM9RLEK
	bool "Atmel at91sam9rl reference board"
	select CPU_ARM926EJS

config TARGET_AT91SAM9X5EK
	bool "Atmel AT91SAM9X5-EK board"
	select CPU_ARM926EJS
	select SUPPORT_SPL

config TARGET_SAMA5D3_XPLAINED
	bool "SAMA5D3 Xplained board"
	select CPU_V7
	select SUPPORT_SPL

config TARGET_SAMA5D3XEK
	bool "SAMA5D3X-EK board"
	select CPU_V7
	select SUPPORT_SPL

config TARGET_SAMA5D4_XPLAINED
	bool "SAMA5D4 Xplained board"
	select CPU_V7
	select SUPPORT_SPL

config TARGET_SAMA5D4EK
	bool "SAMA5D4 Evaluation Kit"
	select CPU_V7
	select SUPPORT_SPL

config TARGET_MEESC
	bool "Support meesc"
	select CPU_ARM926EJS

config TARGET_CORVUS
	bool "Support corvus"
	select CPU_ARM926EJS
	select SUPPORT_SPL

config TARGET_TAURUS
	bool "Support taurus"
	select CPU_ARM926EJS
	select SUPPORT_SPL

config TARGET_SMARTWEB
	bool "Support smartweb"
	select CPU_ARM926EJS
	select SUPPORT_SPL

endchoice

config SYS_SOC
	default "at91"

source "board/atmel/at91rm9200ek/Kconfig"
source "board/atmel/at91sam9260ek/Kconfig"
source "board/atmel/at91sam9261ek/Kconfig"
source "board/atmel/at91sam9263ek/Kconfig"
source "board/atmel/at91sam9m10g45ek/Kconfig"
source "board/atmel/at91sam9n12ek/Kconfig"
source "board/atmel/at91sam9rlek/Kconfig"
source "board/atmel/at91sam9x5ek/Kconfig"
source "board/atmel/sama5d3_xplained/Kconfig"
source "board/atmel/sama5d3xek/Kconfig"
source "board/atmel/sama5d4_xplained/Kconfig"
source "board/atmel/sama5d4ek/Kconfig"
source "board/bluewater/snapper9260/Kconfig"
source "board/calao/usb_a9263/Kconfig"
source "board/egnite/ethernut5/Kconfig"
source "board/esd/meesc/Kconfig"
source "board/mini-box/picosam9g45/Kconfig"
source "board/ronetix/pm9261/Kconfig"
source "board/ronetix/pm9263/Kconfig"
source "board/ronetix/pm9g45/Kconfig"
source "board/siemens/corvus/Kconfig"
source "board/siemens/taurus/Kconfig"
source "board/siemens/smartweb/Kconfig"

endif
```

## arch/arm/mach-axiado/Kconfig
```kconfig
if ARCH_AXIADO

config SYS_ARCH
	default "arm"

config SYS_SOC
	default "axiado"

config AXIADO_AX3005
	bool
	select ARM64
	select ARMV8_SWITCH_TO_EL1
	select DM
	select DM_SERIAL
	select GICV3
	select ZYNQ_SERIAL
	select MMC_SDHCI_AXIADO
	select PHY_AXIADO_EMMC

source "arch/arm/mach-axiado/scm3005/Kconfig"

endif
```

## arch/arm/mach-axiado/scm3005/Kconfig
```kconfig
if AXIADO_AX3005

config TARGET_SCM3005
	bool "Support Axiado AX3005 SCM3005"
	help
	  Support for the Axiado AX3005 SCM3005 board.
	  Based on the Axiado AX3005 quad-core ARMv8 Cortex-A53 SoC.

source "board/axiado/scm3005/Kconfig"

endif
```

## arch/arm/mach-bcm283x/Kconfig
```kconfig
config BCM2835
	bool "Broadcom BCM2835 SoC support"
	depends on ARCH_BCM283X

config BCM2836
	bool "Broadcom BCM2836 SoC support"
	depends on ARCH_BCM283X

config BCM2837
	bool "Broadcom BCM2837 SoC support"
	depends on ARCH_BCM283X

menu "Broadcom BCM283X family"
	depends on ARCH_BCM283X

choice
	prompt "Broadcom BCM283X board select"
	optional

config TARGET_RPI
	bool "Raspberry Pi (all BCM2835 variants)"
	help
	  Support for all ARM1176-/BCM2835-based Raspberry Pi variants, such as
	  the A, A+, B, B+, Compute Module, and Zero. This option cannot
	  support BCM2836/BCM2837-based Raspberry Pis such as the RPi 2 and
	  RPi 3 due to different peripheral address maps.

	  This option creates a build targetting the ARM1176 ISA.
	select BCM2835
	select CPU_ARM1176

config TARGET_RPI_2
	bool "Raspberry Pi 2"
	help
	  Support for all BCM2836-based Raspberry Pi variants, such as
	  the RPi 2 model B.

	  This option also supports BCM2837-based variants such as the RPi 3
	  Model B, when run in 32-bit mode, provided you have configured the
	  VideoCore firmware to select the PL011 UART for the console by:
	  a) config.txt should contain dtoverlay=pi3-miniuart-bt.
	  b) You should run the following to tell the VC FW to process DT when
	  booting, and copy u-boot.bin.img (rather than u-boot.bin) to the SD
	  card as the kernel image:

	       path/to/kernel/scripts/mkknlimg --dtok u-boot.bin u-boot.bin.img

	  This works as of firmware.git commit 046effa13ebc "firmware:
	  arm_loader: emmc clock depends on core clock See:
	  https://github.com/raspberrypi/firmware/issues/572".

	  This option creates a build targetting the ARMv7/AArch32 ISA.
	select ARMV7_LPAE
	select BCM2836
	select CPU_V7

config TARGET_RPI_3_32B
	bool "Raspberry Pi 3 32-bit build"
	help
	  Support for all BCM2837-based Raspberry Pi variants, such as
	  the RPi 3 model B, in AArch32 (32-bit) mode.

	  This option assumes the VideoCore firmware is configured to use the
	  mini UART (rather than PL011) for the serial console. This is the
	  default on the RPi 3. To enable the UART console, the following non-
	  default option must be present in config.txt: enable_uart=1.

	  This option creates a build targetting the ARMv7/AArch32 ISA.
	select ARMV7_LPAE
	select BCM2837
	select CPU_V7

config TARGET_RPI_3
	bool "Raspberry Pi 3 64-bit build"
	select ARM64
	select BCM2837

endchoice

config SYS_BOARD
	default "rpi" if TARGET_RPI
	default "rpi_2" if TARGET_RPI_2
	default "rpi_3_32b" if TARGET_RPI_3_32B
	default "rpi_3" if TARGET_RPI_3

config SYS_VENDOR
	default "raspberrypi"

config SYS_SOC
	default "bcm283x"

config SYS_CONFIG_NAME
	default "rpi" if TARGET_RPI
	default "rpi_2" if TARGET_RPI_2
	default "rpi_3_32b" if TARGET_RPI_3_32B
	default "rpi_3" if TARGET_RPI_3

endmenu
```

## arch/arm/mach-bcmbca/Kconfig
```kconfig
# SPDX-License-Identifier: GPL-2.0+
#
# (C) Copyright 2022 Broadcom Ltd
#

if ARCH_BCMBCA

config BCM47622
	bool "Support for Broadcom 47622 Family"
	select SYS_ARCH_TIMER
	select CPU_V7A
	select DM_SERIAL
	select PL01X_SERIAL

config BCM4908
	bool "Support for Broadcom 4908 Family"
	select ARM64
	select SYS_ARCH_TIMER
	select DM_SERIAL
	select BCM6345_SERIAL

config BCM4912
	bool "Support for Broadcom 4912 Family"
	select ARM64
	select SYS_ARCH_TIMER
	select DM_SERIAL
	select PL01X_SERIAL

config BCM63138
	bool "Support for Broadcom 63138 Family"
	select TIMER
	select ARM_GLOBAL_TIMER
	select CPU_V7A
	select DM_SERIAL
	select BCM6345_SERIAL

config BCM63146
	bool "Support for Broadcom 63146 Family"
	select ARM64
	select SYS_ARCH_TIMER
	select DM_SERIAL
	select PL01X_SERIAL

config BCM63148
	bool "Support for Broadcom 63148 Family"
	select SYS_ARCH_TIMER
	select CPU_V7A
	select DM_SERIAL
	select BCM6345_SERIAL

config BCM63158
	bool "Support for Broadcom 63158 Family"
	select ARM64
	select SYS_ARCH_TIMER
	select DM_SERIAL
	select PL01X_SERIAL

config BCM63178
	bool "Support for Broadcom 63178 Family"
	select SYS_ARCH_TIMER
	select CPU_V7A
	select DM_SERIAL
	select PL01X_SERIAL

config BCM6756
	bool "Support for Broadcom 6756 Family"
	select SYS_ARCH_TIMER
	select CPU_V7A
	select DM_SERIAL
	select PL01X_SERIAL

config BCM6813
	bool "Support for Broadcom 6813 Family"
	select ARM64
	select SYS_ARCH_TIMER
	select DM_SERIAL
	select PL01X_SERIAL

config BCM6846
	bool "Support for Broadcom 6846 Family"
	select SYS_ARCH_TIMER
	select CPU_V7A
	select DM_SERIAL
	select BCM6345_SERIAL

config BCM6855
	bool "Support for Broadcom 6855 Family"
	select SYS_ARCH_TIMER
	select CPU_V7A
	select DM_SERIAL
	select PL01X_SERIAL
	help
	  Broadcom BCM6855 is a triple core Cortex A7 based xPON Gateway
	  SoC. This SoC family includes BCM6855x, BCM68252 and BCM6753.

config BCM6856
	bool "Support for Broadcom 6856 Family"
	select ARM64
	select SYS_ARCH_TIMER
	select DM_SERIAL
	select BCM6345_SERIAL
	help
	  Broadcom BCM6856 is a dual core Brahma-B53 ARMv8 based xPON Gateway
	  SoC. This SoC family includes BCM6856, BCM6836 and BCM4910.

config BCM6858
	bool "Support for Broadcom 6858 Family"
	select ARM64
	select SYS_ARCH_TIMER
	select DM_SERIAL
	select BCM6345_SERIAL
	help
	  Broadcom BCM6858 is a quad core Brahma-B53 ARMv8 based xPON Gateway
	  SoC. This SoC family includes BCM6858, BCM49508, BCM5504X and BCM6545.

config BCM6878
	bool "Support for Broadcom 6878 Family"
	select SYS_ARCH_TIMER
	select CPU_V7A
	select DM_SERIAL
	select PL01X_SERIAL

source "arch/arm/mach-bcmbca/bcm47622/Kconfig"
source "arch/arm/mach-bcmbca/bcm4908/Kconfig"
source "arch/arm/mach-bcmbca/bcm4912/Kconfig"
source "arch/arm/mach-bcmbca/bcm63138/Kconfig"
source "arch/arm/mach-bcmbca/bcm63146/Kconfig"
source "arch/arm/mach-bcmbca/bcm63148/Kconfig"
source "arch/arm/mach-bcmbca/bcm63158/Kconfig"
source "arch/arm/mach-bcmbca/bcm63178/Kconfig"
source "arch/arm/mach-bcmbca/bcm6756/Kconfig"
source "arch/arm/mach-bcmbca/bcm6813/Kconfig"
source "arch/arm/mach-bcmbca/bcm6846/Kconfig"
source "arch/arm/mach-bcmbca/bcm6855/Kconfig"
source "arch/arm/mach-bcmbca/bcm6856/Kconfig"
source "arch/arm/mach-bcmbca/bcm6858/Kconfig"
source "arch/arm/mach-bcmbca/bcm6878/Kconfig"

endif
```

## arch/arm/mach-bcmbca/bcm47622/Kconfig
```kconfig
# SPDX-License-Identifier: GPL-2.0+
#
# (C) Copyright 2022 Broadcom Ltd
#

if BCM47622

config TARGET_BCM947622
	bool "Broadcom 47622 Reference Board"
	depends on ARCH_BCMBCA

config SYS_SOC
	default "bcm47622"

source "board/broadcom/bcmbca/Kconfig"

endif
```

## arch/arm/mach-bcmbca/bcm4908/Kconfig
```kconfig
# SPDX-License-Identifier: GPL-2.0+
#
# (C) Copyright 2022 Broadcom Ltd
#

if BCM4908

config TARGET_BCM94908
	bool "Broadcom 4908 Reference Board"
	depends on ARCH_BCMBCA

config SYS_SOC
	default "bcm4908"

source "board/broadcom/bcmbca/Kconfig"

endif
```

## arch/arm/mach-bcmbca/bcm4912/Kconfig
```kconfig
# SPDX-License-Identifier: GPL-2.0+
#
# (C) Copyright 2022 Broadcom Ltd
#

if BCM4912

config TARGET_BCM94912
	bool "Broadcom 4912 Reference Board"
	depends on ARCH_BCMBCA

config SYS_SOC
	default "bcm4912"

source "board/broadcom/bcmbca/Kconfig"

endif
```

## arch/arm/mach-bcmbca/bcm63138/Kconfig
```kconfig
# SPDX-License-Identifier: GPL-2.0+
#
# (C) Copyright 2022 Broadcom Ltd
#

if BCM63138

config TARGET_BCM963138
	bool "Broadcom 63138 Reference Board"
	depends on ARCH_BCMBCA

config SYS_SOC
	default "bcm63138"

source "board/broadcom/bcmbca/Kconfig"

endif
```

## arch/arm/mach-bcmbca/bcm63146/Kconfig
```kconfig
# SPDX-License-Identifier: GPL-2.0+
#
# (C) Copyright 2022 Broadcom Ltd
#

if BCM63146

config TARGET_BCM963146
	bool "Broadcom 63146 Reference Board"
	depends on ARCH_BCMBCA

config SYS_SOC
	default "bcm63146"

source "board/broadcom/bcmbca/Kconfig"

endif
```

## arch/arm/mach-bcmbca/bcm63148/Kconfig
```kconfig
# SPDX-License-Identifier: GPL-2.0+
#
# (C) Copyright 2022 Broadcom Ltd
#

if BCM63148

config TARGET_BCM963148
	bool "Broadcom 63148 Reference Board"
	depends on ARCH_BCMBCA

config SYS_SOC
	default "bcm63148"

source "board/broadcom/bcmbca/Kconfig"

endif
```
