## arch/arm/cpu/armv7/s5pc1xx/Kconfig
```kconfig
if ARCH_S5PC1XX

choice
	prompt "S5PC1XX board select"

config TARGET_S5P_GONI
	bool "S5P Goni board"
	select OF_CONTROL if !SPL_BUILD

config TARGET_SMDKC100
	bool "Support smdkc100 board"
	select OF_CONTROL if !SPL_BUILD

endchoice

config SYS_CPU
	default "armv7"

config SYS_SOC
	default "s5pc1xx"

source "board/samsung/goni/Kconfig"
source "board/samsung/smdkc100/Kconfig"

endif
```

## arch/arm/cpu/armv7/tegra-common/Kconfig
```kconfig
if TEGRA

choice
	prompt "Tegra SoC select"

config TEGRA20
	bool "Tegra20 family"

config TEGRA30
	bool "Tegra30 family"

config TEGRA114
	bool "Tegra114 family"

config TEGRA124
	bool "Tegra124 family"

endchoice

config SYS_MALLOC_F
	default y

config SYS_MALLOC_F_LEN
	default 0x1800

config USE_PRIVATE_LIBGCC
	default y if SPL_BUILD

config DM
	default y if !SPL_BUILD

config DM_SERIAL
	default y if !SPL_BUILD

config DM_SPI
	default y if !SPL_BUILD

config DM_SPI_FLASH
	default y if !SPL_BUILD

config DM_I2C
	default y if !SPL_BUILD

config DM_GPIO
	default y if !SPL_BUILD

source "arch/arm/cpu/armv7/tegra20/Kconfig"
source "arch/arm/cpu/armv7/tegra30/Kconfig"
source "arch/arm/cpu/armv7/tegra114/Kconfig"
source "arch/arm/cpu/armv7/tegra124/Kconfig"

endif
```

## arch/arm/cpu/armv7/tegra114/Kconfig
```kconfig
if TEGRA114

choice
	prompt "Tegra114 board select"

config TARGET_DALMORE
	bool "NVIDIA Tegra114 Dalmore evaluation board"

endchoice

config SYS_SOC
	default "tegra114"

source "board/nvidia/dalmore/Kconfig"

endif
```

## arch/arm/cpu/armv7/tegra124/Kconfig
```kconfig
if TEGRA124

choice
	prompt "Tegra124 board select"

config TARGET_JETSON_TK1
	bool "NVIDIA Tegra124 Jetson TK1 board"

config TARGET_NYAN_BIG
	bool "Google/NVIDIA Nyan-big Chrombook"
	help
	  Nyan Big is a Tegra124 clamshell board that is very similar
	  to venice2, but it has a different panel, the sdcard CD and WP
	  sense are flipped, and it has a different revision of the AS3722
	  PMIC. The retail name is the Acer Chromebook 13 CB5-311-T7NN
	  (13.3-inch HD, NVIDIA Tegra K1, 2GB).

config TARGET_VENICE2
	bool "NVIDIA Tegra124 Venice2"

endchoice

config SYS_SOC
	default "tegra124"

source "board/nvidia/jetson-tk1/Kconfig"
source "board/nvidia/nyan-big/Kconfig"
source "board/nvidia/venice2/Kconfig"

endif
```

## arch/arm/cpu/armv7/uniphier/Kconfig
```kconfig
menu "Panasonic UniPhier platform"
	depends on ARCH_UNIPHIER

config SYS_SOC
	default "uniphier"

config SYS_CONFIG_NAME
	default "uniphier"

config UNIPHIER_SMP
	bool

choice
	prompt "UniPhier SoC select"

config MACH_PH1_PRO4
	bool "PH1-Pro4"
	select UNIPHIER_SMP

config MACH_PH1_LD4
	bool "PH1-LD4"

config MACH_PH1_SLD8
	bool "PH1-sLD8"

endchoice

choice
	prompt "UniPhier Support Card select"
	optional

config PFC_MICRO_SUPPORT_CARD
	bool "Support card with PFC CPLD"
	help
	  This option provides support for the expansion board with PFC
	  original address mapping.

	  Say Y to use the on-board UART, Ether, LED devices.

config DCC_MICRO_SUPPORT_CARD
	bool "Support card with DCC CPLD"
	help
	  This option provides support for the expansion board with DCC-
	  arranged address mapping that is compatible with legacy UniPhier
	  reference boards.

	  Say Y to use the on-board UART, Ether, LED devices.

endchoice

config SYS_MALLOC_F
	default y

config SYS_MALLOC_F_LEN
	default 0x400

config CMD_PINMON
	bool "Enable boot mode pins monitor command"
	default y
	help
	  The command "pinmon" shows the state of the boot mode pins.
	  The boot mode pins are latched when the system reset is deasserted
	  and determine which device the system should load a boot image from.

config CMD_DDRPHY_DUMP
	bool "Enable dump command of DDR PHY parameters"
	help
	  The command "ddrphy" shows the resulting parameters of DDR PHY
	  training; it is useful for the evaluation of DDR PHY training.

choice
	prompt "DDR3 Frequency select"

config DDR_FREQ_1600
	bool "DDR3 1600"
	depends on MACH_PH1_PRO4 || MACH_PH1_LD4

config DDR_FREQ_1333
	bool "DDR3 1333"
	depends on MACH_PH1_LD4 || MACH_PH1_SLD8

endchoice

config DDR_FREQ
	int
	default 1333 if DDR_FREQ_1333
	default 1600 if DDR_FREQ_1600

endmenu
```

## arch/arm/cpu/armv7/zynq/Kconfig
```kconfig
if ZYNQ

choice
	prompt "Xilinx Zynq board select"

config TARGET_ZYNQ_ZED
	bool "Zynq ZedBoard"

config TARGET_ZYNQ_MICROZED
	bool "Zynq MicroZed"

config TARGET_ZYNQ_ZC70X
	bool "Zynq ZC702/ZC706 Board"

config TARGET_ZYNQ_ZC770
	bool "Zynq ZC770 Board"

endchoice

config SYS_CPU
	default "armv7"

config SYS_BOARD
	default "zynq"

config SYS_VENDOR
	default "xilinx"

config SYS_SOC
	default "zynq"

config SYS_CONFIG_NAME
	default "zynq_zed" if TARGET_ZYNQ_ZED
	default "zynq_microzed" if TARGET_ZYNQ_MICROZED
	default "zynq_zc70x" if TARGET_ZYNQ_ZC70X
	default "zynq_zc770" if TARGET_ZYNQ_ZC770

endif
```

## arch/arm/cpu/armv8/Kconfig
```kconfig
if ARM64

config ARMV8_MULTIENTRY
        bool "Enable multiple CPUs to enter into U-Boot"

config ARMV8_SPIN_TABLE
	bool "Support spin-table enable method"
	depends on ARMV8_MULTIENTRY && OF_LIBFDT
	help
	  Say Y here to support "spin-table" enable method for booting Linux.

	  To use this feature, you must do:
	    - Specify enable-method = "spin-table" in each CPU node in the
	      Device Tree you are using to boot the kernel
	    - Let secondary CPUs in U-Boot (in a board specific manner)
	      before the master CPU jumps to the kernel

	  U-Boot automatically does:
	    - Set "cpu-release-addr" property of each CPU node
	      (overwrites it if already exists).
	    - Reserve the code for the spin-table and the release address
	      via a /memreserve/ region in the Device Tree.

config PSCI_RESET
	bool "Use PSCI for reset and shutdown"
	default y
	depends on !ARCH_EXYNOS7 && !ARCH_BCM283X && !TARGET_LS2080A_EMU && \
		   !TARGET_LS2080A_SIMU && !TARGET_LS2080AQDS && \
		   !TARGET_LS2080ARDB && !TARGET_LS1012AQDS && \
		   !TARGET_LS1012ARDB && !TARGET_LS1012AFRDM && \
		   !TARGET_LS1043ARDB && !TARGET_LS1043AQDS && \
		   !TARGET_LS1046ARDB && !TARGET_LS1046AQDS && \
		   !ARCH_UNIPHIER && !ARCH_SNAPDRAGON && !TARGET_S32V234EVB
	help
	  Most armv8 systems have PSCI support enabled in EL3, either through
	  ARM Trusted Firmware or other firmware.

	  On these systems, we do not need to implement system reset manually,
	  but can instead rely on higher level firmware to deal with it.

	  Select Y here to make use of PSCI calls for system reset

endif
```

## arch/arm/cpu/armv8/fsl-layerscape/Kconfig
```kconfig
config ARCH_LS1012A
	bool
	select FSL_LSCH2
	select SYS_FSL_DDR_BE
	select SYS_FSL_MMDC
	select SYS_FSL_ERRATUM_A010315

config ARCH_LS1043A
	bool
	select FSL_LSCH2
	select SYS_FSL_DDR
	select SYS_FSL_DDR_BE
	select SYS_FSL_DDR_VER_50
	select SYS_FSL_ERRATUM_A008850
	select SYS_FSL_ERRATUM_A009660
	select SYS_FSL_ERRATUM_A009663
	select SYS_FSL_ERRATUM_A009929
	select SYS_FSL_ERRATUM_A009942
	select SYS_FSL_ERRATUM_A010315
	select SYS_FSL_ERRATUM_A010539
	select SYS_FSL_HAS_DDR3
	select SYS_FSL_HAS_DDR4

config ARCH_LS1046A
	bool
	select FSL_LSCH2
	select SYS_FSL_DDR
	select SYS_FSL_DDR_BE
	select SYS_FSL_DDR_VER_50
	select SYS_FSL_ERRATUM_A008511
	select SYS_FSL_ERRATUM_A009801
	select SYS_FSL_ERRATUM_A009803
	select SYS_FSL_ERRATUM_A009942
	select SYS_FSL_ERRATUM_A010165
	select SYS_FSL_ERRATUM_A010539
	select SYS_FSL_HAS_DDR4
	select SYS_FSL_SRDS_2

config ARCH_LS2080A
	bool
	select FSL_LSCH3
	select SYS_FSL_DDR
	select SYS_FSL_DDR_LE
	select SYS_FSL_DDR_VER_50
	select SYS_FSL_HAS_DP_DDR
	select SYS_FSL_HAS_SEC
	select SYS_FSL_HAS_DDR4
	select SYS_FSL_SEC_COMPAT_5
	select SYS_FSL_SEC_LE
	select SYS_FSL_SRDS_2
	select SYS_FSL_ERRATUM_A008336
	select SYS_FSL_ERRATUM_A008511
	select SYS_FSL_ERRATUM_A008514
	select SYS_FSL_ERRATUM_A008585
	select SYS_FSL_ERRATUM_A009635
	select SYS_FSL_ERRATUM_A009663
	select SYS_FSL_ERRATUM_A009801
	select SYS_FSL_ERRATUM_A009803
	select SYS_FSL_ERRATUM_A009942
	select SYS_FSL_ERRATUM_A010165

config FSL_LSCH2
	bool
	select SYS_FSL_HAS_SEC
	select SYS_FSL_SEC_COMPAT_5
	select SYS_FSL_SEC_BE
	select SYS_FSL_SRDS_1
	select SYS_HAS_SERDES

config FSL_LSCH3
	bool
	select SYS_FSL_SRDS_1
	select SYS_HAS_SERDES

menu "Layerscape architecture"
	depends on FSL_LSCH2 || FSL_LSCH3

menu "Layerscape PPA"
config FSL_LS_PPA
	bool "FSL Layerscape PPA firmware support"
	depends on !ARMV8_PSCI
	depends on ARCH_LS1043A || ARCH_LS1046A
	select FSL_PPA_ARMV8_PSCI
	help
	  The FSL Primary Protected Application (PPA) is a software component
	  which is loaded during boot stage, and then remains resident in RAM
	  and runs in the TrustZone after boot.
	  Say y to enable it.

config FSL_PPA_ARMV8_PSCI
	bool "PSCI implementation in PPA firmware"
	depends on FSL_LS_PPA
	help
	  This config enables the ARMv8 PSCI implementation in PPA firmware.
	  This is a private PSCI implementation and different from those
	  implemented under the common ARMv8 PSCI framework.
endmenu

config SYS_FSL_ERRATUM_A010315
	bool "Workaround for PCIe erratum A010315"

config SYS_FSL_ERRATUM_A010539
	bool "Workaround for PIN MUX erratum A010539"

config MAX_CPUS
	int "Maximum number of CPUs permitted for Layerscape"
	default 4 if ARCH_LS1043A
	default 4 if ARCH_LS1046A
	default 16 if ARCH_LS2080A
	default 1
	help
	  Set this number to the maximum number of possible CPUs in the SoC.
	  SoCs may have multiple clusters with each cluster may have multiple
	  ports. If some ports are reserved but higher ports are used for
	  cores, count the reserved ports. This will allocate enough memory
	  in spin table to properly handle all cores.

config SECURE_BOOT
	bool
	help
		Enable Freescale Secure Boot feature

config QSPI_AHB_INIT
	bool "Init the QSPI AHB bus"
	help
	  The default setting for QSPI AHB bus just support 3bytes addressing.
	  But some QSPI flash size up to 64MBytes, so initialize the QSPI AHB
	  bus for those flashes to support the full QSPI flash size.

config SYS_FSL_IFC_BANK_COUNT
	int "Maximum banks of Integrated flash controller"
	depends on ARCH_LS1043A || ARCH_LS1046A || ARCH_LS2080A
	default 4 if ARCH_LS1043A
	default 4 if ARCH_LS1046A
	default 8 if ARCH_LS2080A

config SYS_FSL_HAS_DP_DDR
	bool

config SYS_FSL_SRDS_1
	bool

config SYS_FSL_SRDS_2
	bool

config SYS_HAS_SERDES
	bool

endmenu

config SYS_FSL_ERRATUM_A008336
	bool

config SYS_FSL_ERRATUM_A008514
	bool

config SYS_FSL_ERRATUM_A008585
	bool

config SYS_FSL_ERRATUM_A008850
	bool

config SYS_FSL_ERRATUM_A009635
	bool

config SYS_FSL_ERRATUM_A009660
	bool

config SYS_FSL_ERRATUM_A009929
	bool
```

## arch/arm/cpu/armv8/zynqmp/Kconfig
```kconfig
if ARCH_ZYNQMP

config SPL_FAT_SUPPORT
	default y

config SPL_LIBCOMMON_SUPPORT
	default y

config SPL_LIBDISK_SUPPORT
	default y

config SPL_LIBGENERIC_SUPPORT
	default y

config SPL_MMC_SUPPORT
	default y

config SPL_SERIAL_SUPPORT
	default y

config SPL_SPI_FLASH_SUPPORT
	default y if ZYNQ_QSPI

config SPL_SPI_SUPPORT
	default y if ZYNQ_QSPI

config SYS_BOARD
	default "zynqmp"

config SYS_VENDOR
	default "xilinx"

config SYS_SOC
	default "zynqmp"

config SYS_CONFIG_NAME
	string "Board configuration name"
	default "xilinx_zynqmp"
	help
	  This option contains information about board configuration name.
	  Based on this option include/configs/<CONFIG_SYS_CONFIG_NAME>.h header
	  will be used for board configuration.

config BOOT_INIT_FILE
	string "boot.bin init register filename"
	depends on SPL
	default ""
	help
	  Add register writes to boot.bin format (max 256 pairs).
	  Expect a table of register-value pairs, e.g. "0x12345678 0x4321"

config ZYNQMP_USB
	bool "Configure ZynqMP USB"

config SYS_MALLOC_F_LEN
	default 0x600

config SPL_ZYNQMP_ALT_BOOTMODE_ENABLED
	bool "Overwrite SPL bootmode"
	depends on SPL
	help
	  Overwrite bootmode selected via boot mode pins to tell SPL what should
	  be the next boot device.

config SPL_ZYNQMP_ALT_BOOTMODE
	hex
	default 0x0 if JTAG_MODE
	default 0x1 if QSPI_MODE_24BIT
	default 0x2 if QSPI_MODE_32BIT
	default 0x3 if SD_MODE
	default 0x4 if NAND_MODE
	default 0x5 if SD_MODE1
	default 0x6 if EMMC_MODE
	default 0x7 if USB_MODE
	default 0xa if SW_USBHOST_MODE
	default 0xb if SW_SATA_MODE

choice
	prompt "Boot mode"
	depends on SPL_ZYNQMP_ALT_BOOTMODE_ENABLED
	default JTAG

config JTAG_MODE
	bool "JTAG_MODE"

config QSPI_MODE_24BIT
	bool "QSPI_MODE_24BIT"

config QSPI_MODE_32BIT
	bool "QSPI_MODE_32BIT"

config SD_MODE
	bool "SD_MODE"

config SD_MODE1
	bool "SD_MODE1"

config NAND_MODE
	bool "NAND_MODE"

config EMMC_MODE
	bool "EMMC_MODE"

config USB_MODE
	bool "USB"

config SW_USBHOST_MODE
	bool "SW USBHOST_MODE"

config SW_SATA_MODE
	bool "SW SATA_MODE"

endchoice

endif
```

## arch/arm/imx-common/Kconfig
```kconfig
config IMX_CONFIG
	string

config ROM_UNIFIED_SECTIONS
	bool

config IMX_RDC
	bool "i.MX Resource domain controller driver"
	depends on ARCH_MX6 || ARCH_MX7
	help
	  i.MX Resource domain controller is used to assign masters
	  and peripherals to differet domains. This can be used to
	  isolate resources.

config IMX_BOOTAUX
	bool "Support boot auxiliary core"
	depends on ARCH_MX7 || ARCH_MX6
	help
	  bootaux [addr] to boot auxiliary core.

config USE_IMXIMG_PLUGIN
	bool "Use imximage plugin code"
	depends on ARCH_MX7 || ARCH_MX6
	help
	  i.MX6/7 supports DCD and Plugin. Enable this configuration
	  to use Plugin, otherwise DCD will be used.

config SECURE_BOOT
	bool "Support i.MX HAB features"
	depends on ARCH_MX7 || ARCH_MX6 || ARCH_MX5
	select FSL_CAAM
	imply CMD_DEKBLOB
	help
	  This option enables the support for secure boot (HAB).
	  See doc/README.mxc_hab for more details.

config CMD_BMODE
	bool "Support the 'bmode' command"
	default y
	depends on ARCH_MX7 || ARCH_MX6 || ARCH_MX5
	help
	  This enables the 'bmode' (bootmode) command for forcing
	  a boot from specific media.

	  This is useful for forcing the ROM's usb downloader to
	  activate upon a watchdog reset which is nice when iterating
	  on U-Boot.  Using the reset button or running bmode normal
	  will set it back to normal.  This command currently
	  supports i.MX53 and i.MX6.

config CMD_DEKBLOB
	bool "Support the 'dek_blob' command"
	help
	  This enables the 'dek_blob' command which is used with the
	  Freescale secure boot mechanism. This command encapsulates and
	  creates a blob of data. See also CMD_BLOB and doc/README.mxc_hab for
	  more information.
```

## arch/arm/mach-airoha/Kconfig
```kconfig
if ARCH_AIROHA

config SYS_VENDOR
	default "airoha"

choice
	prompt "Airoha board select"

config TARGET_EN7523
	bool "Airoha EN7523 SoC"
	select CPU_V7A
	select ARMV7_SET_CORTEX_SMPEN
	help
	  The Airoha EN7523 family (en7523/en7529/en7562) is an ARM-based
	  SoCs with a dual-core CPU. It comes with Wi-Fi 5/6 support and
	  connectivity to Ethernet PHY, DDR, PCIe, USB, UART and VoIP.
	  With advanced hardware design, EN7523 provides high processing
	  performance and low power consumption.

config TARGET_AN7581
	bool "Airoha AN7581 SoC"
	select ARM64
	help
	  The Airoha EN7581 is a ARM-based SoC with a quad-core Cortex-A7
	  including NEON and GPU, Mali-450 graphics, several DDR3 options,
	  crypto engine, built-in Wi-Fi / Bluetooth combo chip, JPEG decoder,
	  video interfaces supporting HDMI and MIPI, and video codec support.
	  Peripherals include Gigabit Ethernet, switch, USB3.0 and OTG, PCIe,
	  I2S, PCM, S/PDIF, UART, SPI, I2C, IR TX/RX, and PWM.

endchoice

config SYS_SOC
	default "en7523" if TARGET_EN7523
	default "an7581" if TARGET_AN7581

config SYS_BOARD
	default "en7523" if TARGET_EN7523
	default "an7581" if TARGET_AN7581

config SYS_CONFIG_NAME
	default "en7523" if TARGET_EN7523
	default "an7581" if TARGET_AN7581

endif
```
