// SPDX-License-Identifier: GPL-2.0+
/*
 * am335x-bone-common U-Boot Additions
 *
 * Common u-boot configuration for all BeagleBone variants
 */

#include "am33xx-u-boot.dtsi"

/ {
	chosen {
		tick-timer = &timer2;
	};
};
