// SPDX-License-Identifier: GPL-2.0+
/*
 * am335x-evmsk U-Boot Additions
 *
 * Copyright (C) 2020 Dario Binacchi <dariobin@libero.it>
 */

#include "am33xx-u-boot.dtsi"

/ {
	panel {
		u-boot,dm-pre-reloc;
	};
};
