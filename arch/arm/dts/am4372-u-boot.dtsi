// SPDX-License-Identifier: GPL-2.0+
/*
 * Copyright (C) 2018 Texas Instruments Incorporated - http://www.ti.com/
 */

&am43xx_control_usb2phy1 {
	compatible = "ti,control-phy-usb2-am437", "syscon";
};

&am43xx_control_usb2phy2 {
	compatible = "ti,control-phy-usb2-am437", "syscon";
};

&ocp2scp0 {
	compatible = "ti,am437x-ocp2scp", "ti,omap-ocp2scp", "simple-bus";
};

&ocp2scp1 {
	compatible = "ti,am437x-ocp2scp", "ti,omap-ocp2scp", "simple-bus";
};
