// SPDX-License-Identifier: GPL-2.0
/*
 * Copyright (c) 2024, Linaro Ltd.
 */

/ {
	/* When running as a first-stage bootloader this isn't filled in automatically */
	memory@80000000 {
		reg = <0 0x80000000 0 0x40000000>;
	};
};
