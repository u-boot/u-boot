// SPDX-License-Identifier: GPL-2.0+
/*
 * Copyright (C) 2026 Free Mobile, Vincent Jardin
 */

#ifdef CONFIG_OPTEE
/ {
	firmware {
		optee {
			compatible = "linaro,optee-tz";
			method = "smc";
		};
	};
};
#endif
