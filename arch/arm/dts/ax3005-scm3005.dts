// SPDX-License-Identifier: GPL-2.0+
/*
 * Copyright (c) 2021-2026 Axiado Corporation (or its affiliates).
 */

/dts-v1/;

#include "ax3005.dtsi"

/ {
	model = "Axiado AX3005 SCM3005";
	compatible = "axiado,ax3005-scm3005", "axiado,ax3005";
	#address-cells = <2>;
	#size-cells = <2>;

	chosen {
		stdout-path = "serial3:115200";
	};

	memory@80000000 {
		device_type = "memory";
		reg = <0x00 0x80000000 0x00 0x80000000>;
	};
};

&uart3 {
	status = "okay";
};
