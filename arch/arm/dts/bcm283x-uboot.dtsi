/*
 * U-Boot addition to keep baudrate set by firmware
 * and also initialize before relocation.
 *
 * (C) Copyright 2016 Fabian Vogt <fvogt@suse.com>
 *
 * SPDX-License-Identifier:     GPL-2.0+
 */

&soc {
	u-boot,dm-pre-reloc;
};

&uart0 {
	skip-init;
	u-boot,dm-pre-reloc;
};

&uart1 {
	skip-init;
	u-boot,dm-pre-reloc;
};
