// SPDX-License-Identifier: GPL-2.0+
/*
 * Copyright (C) 2020 Marvell International Ltd.
 */

#include "cn9130-crb-C.dts"
#include "cn9130-crb-r1p3.dtsi"

/ {
	model = "CN9130-CRB-C (PCIe EP)";
	compatible = "marvell,cn9130-crb-C",
		"marvell,cn9130",
		"marvell,armada-ap806-quad",
		"marvell,armada-ap806";
};
