// SPDX-License-Identifier: GPL-2.0+
/*
 * Copyright (C) 2020 Marvell International Ltd.
 */

/*
 * CP related configuration
 */
&cp0_pinctl {
	/* MPP Bus:
	 *	[0-11]	RGMII1
	 *	[12] GPIO
	 *	[13-16] SPI1
	 *	[17-32] GPIO
	 *	[33]	SD_PWR_OFF
	 *	[34]	CP_PCIE0_CLKREQn
	 *	[35-38]	I2C1 I2C0
	 *	[39]	GPIO
	 *	[40-43]	SMI/XSMI
	 *	[44-46]	GPIO
	 *	[47]	UART1_TX
	 *	[48]	GPIO
	 *	[49]	SD_HST_18_EN
	 *	[50]	GPIO
	 *	[51]	SD_PWR_0
	 *	[52]	PCIE_RSTn
	 *	[53]	UART1_RX
	 *	[54]	GPIO
	 *	[55]	SD_DT
	 *	[56-61]	SDIO
	 */
		/*   0   1   2   3   4   5   6   7   8   9 */
	pin-func = < 3   3   3   3   3   3   3   3   3   3
		     3   3   0   3   3   3   3   0   0   0
		     0   0   0   0   0   0   0   0   0   0
		     0   0   0   6   9   2   2   2   2   0
		     8   8   8   8   0   0   0   7   0   0xa
		     0   0xa 9   7   0   0xb 0xe 0xe 0xe 0xe
		     0xe 0xe 0xe>;
};

&cp0_spi1 {
	pinctrl-0 = <&cp0_spi0_pins>;
};
