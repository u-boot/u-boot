/*
 * Copyright (C) 2017 Texas Instruments Incorporated - http://www.ti.com/
 *
 * SPDX-License-Identifier:	GPL-2.0+
 */

#include "omap5-u-boot.dtsi"

&pcf_gpio_21{
	u-boot,i2c-offset-len = <0>;
};

&pcf_hdmi{
	u-boot,i2c-offset-len = <0>;
};

&cpsw_emac0 {
	phy-handle = <&dp83867_0>;
};

&cpsw_emac1 {
	phy-handle = <&dp83867_1>;
};
