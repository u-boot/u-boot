// SPDX-License-Identifier: GPL-2.0
/*
 * Copyright (c) 2026 Kaustabh Chakraborty <kauschluss@disroot.org>
 */

/ {
	/* These properties are required by S-BOOT. */
	model_info-chip = <7870>;
	model_info-hw_rev = <0>;
	model_info-hw_rev_end = <255>;

	chosen {
		#address-cells = <2>;
		#size-cells = <1>;
		ranges;

		framebuffer@67000000 {
			compatible = "simple-framebuffer";
			reg = <0x0 0x67000000 (540 * 960 * 4)>;
			width = <540>;
			height = <960>;
			stride = <(540 * 4)>;
			format = "a8r8g8b8";
		};
	};
};
