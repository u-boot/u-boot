/*
 * Copyright 2016 Freescale Semiconductor
 *
 * SPDX-License-Identifier:	GPL-2.0+	X11
 */

/dts-v1/;
#include "fsl-ls1012a-qds.dtsi"

/ {
       chosen {
               stdout-path = &duart0;
       };
};
