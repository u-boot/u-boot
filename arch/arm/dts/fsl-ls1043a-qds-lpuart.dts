/*
 * Device Tree file for Freescale Layerscape-1043A family SoC.
 *
 * Copyright (C) 2015, Freescale Semiconductor
 *
 * SPDX-License-Identifier:	GPL-2.0+
 */

/dts-v1/;
#include "fsl-ls1043a-qds.dtsi"

/ {
       chosen {
               stdout-path = &lpuart0;
       };
};
