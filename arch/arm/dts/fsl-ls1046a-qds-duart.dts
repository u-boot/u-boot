/*
 * Device Tree file for Freescale Layerscape-1046A family SoC.
 *
 * Copyright (C) 2016, Freescale Semiconductor
 *
 * SPDX-License-Identifier:	GPL-2.0+	X11
 */

/dts-v1/;
#include "fsl-ls1046a-qds.dtsi"

/ {
       chosen {
               stdout-path = &duart0;
       };
};
