// SPDX-License-Identifier: GPL-2.0+ or X11
/*
 * Copyright (C) 2019 Heiko Schocher <hs@denx.de>
 */

#include <imx6qdl-aristainetos2b_csl-u-boot.dtsi>

&lcd_panel {
	pinctrl-names = "default";
	pinctrl-0 = <&pinctrl_ipu_disp>;
	enable-gpios = <&gpio6 15 GPIO_ACTIVE_HIGH>;
	backlight = <&backlight>;
};
