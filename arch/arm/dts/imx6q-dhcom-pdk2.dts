// SPDX-License-Identifier: (GPL-2.0+)
/*
 * Copyright (C) 2015-2019 DH electronics GmbH
 * Copyright (C) 2018 Marek Vasut <marex@denx.de>
 */

/dts-v1/;

#include "imx6q.dtsi"
#include "imx6qdl-dhcom-pdk2.dtsi"

/ {
	model = "Freescale i.MX6 Quad/Dual DHCOM Premium Developer Kit (2)";
	compatible = "dh,imx6q-dhcom-pdk2", "dh,imx6q-dhcom", "fsl,imx6q";
};

&sata {
	status = "okay";
};

