// SPDX-License-Identifier: GPL-2.0
/*
 * Copyright (C) 2017 exceet electronics GmbH
 * Copyright (C) 2018 Kontron Electronics GmbH
 * Copyright (c) 2019 Krzysztof Kozlowski <krzk@kernel.org>
 */

#include "imx6ul.dtsi"
#include "imx6ul-kontron-n6x1x-som-common.dtsi"

/ {
	model = "Kontron N631X SOM";
	compatible = "kontron,imx6ul-n631x-som", "fsl,imx6ul";
};
