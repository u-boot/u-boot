// SPDX-License-Identifier: GPL-2.0
/*
 * Copyright (C) 2017 exceet electronics GmbH
 * Copyright (C) 2019 Kontron Electronics GmbH
 */

/dts-v1/;

#include "imx6ull-kontron-n641x-som.dtsi"
#include "imx6ul-kontron-n6x1x-s.dtsi"

/ {
	model = "Kontron N641X S";
	compatible = "kontron,imx6ull-n641x-s", "kontron,imx6ull-n641x-som",
		     "fsl,imx6ull";
};
