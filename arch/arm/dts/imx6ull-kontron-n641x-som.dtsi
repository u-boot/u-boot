// SPDX-License-Identifier: GPL-2.0
/*
 * Copyright (C) 2017 exceet electronics GmbH
 * Copyright (C) 2018 Kontron Electronics GmbH
 */

#include "imx6ull.dtsi"
#include "imx6ul-kontron-n6x1x-som-common.dtsi"

/ {
	model = "Kontron N641X SOM";
	compatible = "kontron,imx6ull-n641x-som", "fsl,imx6ull";
};
