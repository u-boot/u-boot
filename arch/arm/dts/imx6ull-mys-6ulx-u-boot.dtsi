// SPDX-License-Identifier: GPL-2.0
/*
 * Copyright (C) 2020 Linumiz
 * Author: Parthiban Nallathambi <parthiban@linumiz.com>
 */

&pinctrl_uart1 {
	u-boot,dm-pre-reloc;
};

&gpmi {
	u-boot,dm-spl;
	u-boot,dm-pre-reloc;
};

&usdhc1 {
	u-boot,dm-spl;
	u-boot,dm-pre-reloc;
};

&usdhc2 {
	u-boot,dm-spl;
	u-boot,dm-pre-reloc;
};
