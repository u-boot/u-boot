// SPDX-License-Identifier: GPL-2.0+
/*
 * Copyright 2026 NXP
 */

&ahbbridge0 {
	wdog2: watchdog@40430000 {
		compatible = "fsl,imx7ulp-wdt";
		reg = <0x40430000 0x10000>;
		interrupts = <GIC_SPI 56 IRQ_TYPE_LEVEL_HIGH>;
		clocks = <&pcc2 IMX7ULP_CLK_WDG2>;
		assigned-clocks = <&pcc2 IMX7ULP_CLK_WDG2>;
		assigned-clock-parents = <&scg1 IMX7ULP_CLK_FIRC_BUS_CLK>;
		timeout-sec = <40>;
		status = "disabled";
	};
};
