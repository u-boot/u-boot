// SPDX-License-Identifier: BSD-3-Clause
/*
 * Copyright (c) 2025, Qualcomm Innovation Center, Inc. All rights reserved.
 */

/ {
	/* Will be removed when SMEM parsing is updated */
	memory@40000000 {
		device_type = "memory";
		reg = <0x0 0x40000000 0x0 0x40000000>,
		      <0x0 0x4a500000 0x0 0x00100000>;
	};
};

&sdhc_1 {
	sdhci-caps-mask = <0x0 0x04000000>;
	sdhci-caps = <0x0 0x04000000>;	/* SDHCI_CAN_VDD_180 */

	/*
	 * This reset is needed to clear out the settings done by
	 * previous boot loader. Without this the SDHCI_RESET_ALL
	 * reset done sdhci_init() times out.
	 */
	resets = <&gcc GCC_SDCC_BCR>;
};
