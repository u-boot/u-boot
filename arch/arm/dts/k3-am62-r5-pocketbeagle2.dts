// SPDX-License-Identifier: GPL-2.0-only OR MIT
/*
 * AM625 PocketBeagle 2 dts file for R5 SPL
 * https://www.beagleboard.org/boards/pocketbeagle-2
 *
 * Copyright (C) 2022-2023 Texas Instruments Incorporated - https://www.ti.com/
 * Copyright (C) 2022-2023 Robert Nelson, BeagleBoard.org Foundation
 */

#include "k3-am62-pocketbeagle2.dts"
#include "k3-am62-pocketbeagle2-ddr4-1600MTs.dtsi"
#include "k3-am62-ddr.dtsi"

#include "k3-am62-pocketbeagle2-u-boot.dtsi"
#include "k3-am625-r5.dtsi"

/ {
	aliases {
		serial1 = &main_uart1;
		serial2 = &main_uart6;
		serial3 = &main_uart3;
		serial4 = &main_uart4;
		serial5 = &main_uart5;
		serial6 = &main_uart2;
		serial7 = &main_uart0;
	};
};

&main_pktdma {
	ti,sci = <&dm_tifs>;
};

&main_bcdma {
	ti,sci = <&dm_tifs>;
};
