// SPDX-License-Identifier: GPL-2.0
/*
 * Common AM62D EVM dts file for SPLs
 * Copyright (C) 2025 Texas Instruments Incorporated - https://www.ti.com/
 */

#include "k3-am62d-evm-binman.dtsi"

/ {
	chosen {
		stdout-path = "serial2:115200n8";
	};
};
