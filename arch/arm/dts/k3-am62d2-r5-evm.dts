// SPDX-License-Identifier: GPL-2.0
/*
 * AM62D2 EVM dts file for R5 SPL
 * Copyright (C) 2025 Texas Instruments Incorporated - https://www.ti.com/
 */

#include "k3-am62d2-evm.dts"
#include "k3-am62d-ddr-1866mhz-32bit.dtsi"
#include "k3-am62a-ddr.dtsi"

#include "k3-am62d2-evm-u-boot.dtsi"
#include "k3-am62d2-r5.dtsi"
