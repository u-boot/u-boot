// SPDX-License-Identifier: GPL-2.0
/*
 * Copyright (C) 2020-2023 Texas Instruments Incorporated - https://www.ti.com/
 */

#include "k3-am642-evm.dts"
#include "k3-am64-evm-ddr4-1600MTs.dtsi"
#include "k3-am64-ddr.dtsi"

#include "k3-am642-evm-u-boot.dtsi"
#include "k3-am642-r5.dtsi"

&memorycontroller {
	vtt-supply = <&vtt_supply>;
};

&sdhci0 {
	clocks = <&clk_200mhz>;
	clock-names = "clk_xin";
};

&sdhci1 {
	clocks = <&clk_200mhz>;
	clock-names = "clk_xin";
};
