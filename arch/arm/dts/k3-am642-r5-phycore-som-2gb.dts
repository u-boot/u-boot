// SPDX-License-Identifier: GPL-2.0
/*
 * Copyright (C) 2021 PHYTEC America, LLC - https://www.phytec.com
 * Author: Matt McKee <mmckee@phytec.com>
 *
 * Copyright (C) 2022 - 2024 PHYTEC Messtechnik GmbH
 * Author: Wadim Egorov <w.egorov@phytec.de>
 */

/dts-v1/;

#include "k3-am642-phyboard-electra-rdk.dts"
#include "k3-am64-phycore-som-ddr4-2gb.dtsi"
#include "k3-am64-ddr.dtsi"

#include "k3-am642-phyboard-electra-rdk-u-boot.dtsi"
#include "k3-am642-r5.dtsi"

/ {
	aliases {
		ethernet0 = &cpsw3g;
	};
};

&a53_0 {
	clock-names = "gtc";
	clocks = <&k3_clks 61 0>;
};
