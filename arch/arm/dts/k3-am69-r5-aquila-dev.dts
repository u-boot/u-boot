// SPDX-License-Identifier: GPL-2.0-or-later OR MIT
/*
 * Copyright (C) 2025 Toradex - https://www.toradex.com/
 */

/dts-v1/;

#include "k3-am69-aquila-dev.dts"
#include "k3-am69-aquila-lpddr4-4266.dtsi"
#include "k3-j784s4-ddr.dtsi"
#include "k3-am69-aquila-dev-u-boot.dtsi"
#include "k3-j784s4-r5.dtsi"

&pmic_tps6594 {
	esm: esm {
		compatible = "ti,tps659413-esm";
		bootph-pre-ram;
	};
};
