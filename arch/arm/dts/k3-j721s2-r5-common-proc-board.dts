// SPDX-License-Identifier: GPL-2.0
/*
 * Copyright (C) 2021-2023 Texas Instruments Incorporated - https://www.ti.com/
 */

/dts-v1/;

#include "k3-j721s2-common-proc-board.dts"
#include "k3-j721s2-ddr-evm-lp4-4266.dtsi"
#include "k3-j721s2-ddr.dtsi"
#include "k3-j721s2-common-proc-board-u-boot.dtsi"
#include "k3-j721s2-r5.dtsi"

&tps659411 {
	bootph-pre-ram;
	esm: esm {
		compatible = "ti,tps659413-esm";
		bootph-pre-ram;
	};
};

&wkup_vtm0 {
	bootph-pre-ram;
	vdd-supply-2 = <&bucka1234>;
};
