// SPDX-License-Identifier: GPL-2.0-or-later
/*
 * Copyright (C) 2023 Texas Instruments Incorporated - https://www.ti.com/
 */

#include "k3-j784s4-j742s2-ddr.dtsi"

&msmc0 {
	memorycontroller2: memorycontroller@29d0000 {
		compatible = "ti,j721s2-ddrss";
		reg = <0x0 0x029d0000 0x0 0x4000>,
			  <0x0 0x0114000 0x0 0x100>,
			  <0x0 0x029c0000 0x0 0x200>;
		reg-names = "cfg", "ctrl_mmr_lp4", "ss_cfg";
		power-domains = <&k3_pds 193 TI_SCI_PD_SHARED>,
			<&k3_pds 133 TI_SCI_PD_SHARED>;
		clocks = <&k3_clks 193 1>, <&k3_clks 78 2>;
		ti,ddr-freq0 = <DDRSS_PLL_FREQUENCY_0>;
		ti,ddr-freq1 = <DDRSS_PLL_FREQUENCY_1>;
		ti,ddr-freq2 = <DDRSS_PLL_FREQUENCY_2>;
		ti,ddr-fhs-cnt = <DDRSS_PLL_FHS_CNT>;
		instance = <2>;

		bootph-pre-ram;

		ti,ctl-data = <
			DDRSS2_CTL_00_DATA
			DDRSS2_CTL_01_DATA
			DDRSS2_CTL_02_DATA
			DDRSS2_CTL_03_DATA
			DDRSS2_CTL_04_DATA
			DDRSS2_CTL_05_DATA
			DDRSS2_CTL_06_DATA
			DDRSS2_CTL_07_DATA
			DDRSS2_CTL_08_DATA
			DDRSS2_CTL_09_DATA
			DDRSS2_CTL_10_DATA
			DDRSS2_CTL_11_DATA
			DDRSS2_CTL_12_DATA
			DDRSS2_CTL_13_DATA
			DDRSS2_CTL_14_DATA
			DDRSS2_CTL_15_DATA
			DDRSS2_CTL_16_DATA
			DDRSS2_CTL_17_DATA
			DDRSS2_CTL_18_DATA
			DDRSS2_CTL_19_DATA
			DDRSS2_CTL_20_DATA
			DDRSS2_CTL_21_DATA
			DDRSS2_CTL_22_DATA
			DDRSS2_CTL_23_DATA
			DDRSS2_CTL_24_DATA
			DDRSS2_CTL_25_DATA
			DDRSS2_CTL_26_DATA
			DDRSS2_CTL_27_DATA
			DDRSS2_CTL_28_DATA
			DDRSS2_CTL_29_DATA
			DDRSS2_CTL_30_DATA
			DDRSS2_CTL_31_DATA
			DDRSS2_CTL_32_DATA
			DDRSS2_CTL_33_DATA
			DDRSS2_CTL_34_DATA
			DDRSS2_CTL_35_DATA
			DDRSS2_CTL_36_DATA
			DDRSS2_CTL_37_DATA
			DDRSS2_CTL_38_DATA
			DDRSS2_CTL_39_DATA
			DDRSS2_CTL_40_DATA
			DDRSS2_CTL_41_DATA
			DDRSS2_CTL_42_DATA
			DDRSS2_CTL_43_DATA
			DDRSS2_CTL_44_DATA
			DDRSS2_CTL_45_DATA
			DDRSS2_CTL_46_DATA
			DDRSS2_CTL_47_DATA
			DDRSS2_CTL_48_DATA
			DDRSS2_CTL_49_DATA
			DDRSS2_CTL_50_DATA
			DDRSS2_CTL_51_DATA
			DDRSS2_CTL_52_DATA
			DDRSS2_CTL_53_DATA
			DDRSS2_CTL_54_DATA
			DDRSS2_CTL_55_DATA
			DDRSS2_CTL_56_DATA
			DDRSS2_CTL_57_DATA
			DDRSS2_CTL_58_DATA
			DDRSS2_CTL_59_DATA
			DDRSS2_CTL_60_DATA
			DDRSS2_CTL_61_DATA
			DDRSS2_CTL_62_DATA
			DDRSS2_CTL_63_DATA
			DDRSS2_CTL_64_DATA
			DDRSS2_CTL_65_DATA
			DDRSS2_CTL_66_DATA
			DDRSS2_CTL_67_DATA
			DDRSS2_CTL_68_DATA
			DDRSS2_CTL_69_DATA
			DDRSS2_CTL_70_DATA
			DDRSS2_CTL_71_DATA
			DDRSS2_CTL_72_DATA
			DDRSS2_CTL_73_DATA
			DDRSS2_CTL_74_DATA
			DDRSS2_CTL_75_DATA
			DDRSS2_CTL_76_DATA
			DDRSS2_CTL_77_DATA
			DDRSS2_CTL_78_DATA
			DDRSS2_CTL_79_DATA
			DDRSS2_CTL_80_DATA
			DDRSS2_CTL_81_DATA
			DDRSS2_CTL_82_DATA
			DDRSS2_CTL_83_DATA
			DDRSS2_CTL_84_DATA
			DDRSS2_CTL_85_DATA
			DDRSS2_CTL_86_DATA
			DDRSS2_CTL_87_DATA
			DDRSS2_CTL_88_DATA
			DDRSS2_CTL_89_DATA
			DDRSS2_CTL_90_DATA
			DDRSS2_CTL_91_DATA
			DDRSS2_CTL_92_DATA
			DDRSS2_CTL_93_DATA
			DDRSS2_CTL_94_DATA
			DDRSS2_CTL_95_DATA
			DDRSS2_CTL_96_DATA
			DDRSS2_CTL_97_DATA
			DDRSS2_CTL_98_DATA
			DDRSS2_CTL_99_DATA
			DDRSS2_CTL_100_DATA
			DDRSS2_CTL_101_DATA
			DDRSS2_CTL_102_DATA
			DDRSS2_CTL_103_DATA
			DDRSS2_CTL_104_DATA
			DDRSS2_CTL_105_DATA
			DDRSS2_CTL_106_DATA
			DDRSS2_CTL_107_DATA
			DDRSS2_CTL_108_DATA
			DDRSS2_CTL_109_DATA
			DDRSS2_CTL_110_DATA
			DDRSS2_CTL_111_DATA
			DDRSS2_CTL_112_DATA
			DDRSS2_CTL_113_DATA
			DDRSS2_CTL_114_DATA
			DDRSS2_CTL_115_DATA
			DDRSS2_CTL_116_DATA
			DDRSS2_CTL_117_DATA
			DDRSS2_CTL_118_DATA
			DDRSS2_CTL_119_DATA
			DDRSS2_CTL_120_DATA
			DDRSS2_CTL_121_DATA
			DDRSS2_CTL_122_DATA
			DDRSS2_CTL_123_DATA
			DDRSS2_CTL_124_DATA
			DDRSS2_CTL_125_DATA
			DDRSS2_CTL_126_DATA
			DDRSS2_CTL_127_DATA
			DDRSS2_CTL_128_DATA
			DDRSS2_CTL_129_DATA
			DDRSS2_CTL_130_DATA
			DDRSS2_CTL_131_DATA
			DDRSS2_CTL_132_DATA
			DDRSS2_CTL_133_DATA
			DDRSS2_CTL_134_DATA
			DDRSS2_CTL_135_DATA
			DDRSS2_CTL_136_DATA
			DDRSS2_CTL_137_DATA
			DDRSS2_CTL_138_DATA
			DDRSS2_CTL_139_DATA
			DDRSS2_CTL_140_DATA
			DDRSS2_CTL_141_DATA
			DDRSS2_CTL_142_DATA
			DDRSS2_CTL_143_DATA
			DDRSS2_CTL_144_DATA
			DDRSS2_CTL_145_DATA
			DDRSS2_CTL_146_DATA
			DDRSS2_CTL_147_DATA
			DDRSS2_CTL_148_DATA
			DDRSS2_CTL_149_DATA
			DDRSS2_CTL_150_DATA
			DDRSS2_CTL_151_DATA
			DDRSS2_CTL_152_DATA
			DDRSS2_CTL_153_DATA
			DDRSS2_CTL_154_DATA
			DDRSS2_CTL_155_DATA
			DDRSS2_CTL_156_DATA
			DDRSS2_CTL_157_DATA
			DDRSS2_CTL_158_DATA
			DDRSS2_CTL_159_DATA
			DDRSS2_CTL_160_DATA
			DDRSS2_CTL_161_DATA
			DDRSS2_CTL_162_DATA
			DDRSS2_CTL_163_DATA
			DDRSS2_CTL_164_DATA
			DDRSS2_CTL_165_DATA
			DDRSS2_CTL_166_DATA
			DDRSS2_CTL_167_DATA
			DDRSS2_CTL_168_DATA
			DDRSS2_CTL_169_DATA
			DDRSS2_CTL_170_DATA
			DDRSS2_CTL_171_DATA
			DDRSS2_CTL_172_DATA
			DDRSS2_CTL_173_DATA
			DDRSS2_CTL_174_DATA
			DDRSS2_CTL_175_DATA
			DDRSS2_CTL_176_DATA
			DDRSS2_CTL_177_DATA
			DDRSS2_CTL_178_DATA
			DDRSS2_CTL_179_DATA
			DDRSS2_CTL_180_DATA
			DDRSS2_CTL_181_DATA
			DDRSS2_CTL_182_DATA
			DDRSS2_CTL_183_DATA
			DDRSS2_CTL_184_DATA
			DDRSS2_CTL_185_DATA
			DDRSS2_CTL_186_DATA
			DDRSS2_CTL_187_DATA
			DDRSS2_CTL_188_DATA
			DDRSS2_CTL_189_DATA
			DDRSS2_CTL_190_DATA
			DDRSS2_CTL_191_DATA
			DDRSS2_CTL_192_DATA
			DDRSS2_CTL_193_DATA
			DDRSS2_CTL_194_DATA
			DDRSS2_CTL_195_DATA
			DDRSS2_CTL_196_DATA
			DDRSS2_CTL_197_DATA
			DDRSS2_CTL_198_DATA
			DDRSS2_CTL_199_DATA
			DDRSS2_CTL_200_DATA
			DDRSS2_CTL_201_DATA
			DDRSS2_CTL_202_DATA
			DDRSS2_CTL_203_DATA
			DDRSS2_CTL_204_DATA
			DDRSS2_CTL_205_DATA
			DDRSS2_CTL_206_DATA
			DDRSS2_CTL_207_DATA
			DDRSS2_CTL_208_DATA
			DDRSS2_CTL_209_DATA
			DDRSS2_CTL_210_DATA
			DDRSS2_CTL_211_DATA
			DDRSS2_CTL_212_DATA
			DDRSS2_CTL_213_DATA
			DDRSS2_CTL_214_DATA
			DDRSS2_CTL_215_DATA
			DDRSS2_CTL_216_DATA
			DDRSS2_CTL_217_DATA
			DDRSS2_CTL_218_DATA
			DDRSS2_CTL_219_DATA
			DDRSS2_CTL_220_DATA
			DDRSS2_CTL_221_DATA
			DDRSS2_CTL_222_DATA
			DDRSS2_CTL_223_DATA
			DDRSS2_CTL_224_DATA
			DDRSS2_CTL_225_DATA
			DDRSS2_CTL_226_DATA
			DDRSS2_CTL_227_DATA
			DDRSS2_CTL_228_DATA
			DDRSS2_CTL_229_DATA
			DDRSS2_CTL_230_DATA
			DDRSS2_CTL_231_DATA
			DDRSS2_CTL_232_DATA
			DDRSS2_CTL_233_DATA
			DDRSS2_CTL_234_DATA
			DDRSS2_CTL_235_DATA
			DDRSS2_CTL_236_DATA
			DDRSS2_CTL_237_DATA
			DDRSS2_CTL_238_DATA
			DDRSS2_CTL_239_DATA
			DDRSS2_CTL_240_DATA
			DDRSS2_CTL_241_DATA
			DDRSS2_CTL_242_DATA
			DDRSS2_CTL_243_DATA
			DDRSS2_CTL_244_DATA
			DDRSS2_CTL_245_DATA
			DDRSS2_CTL_246_DATA
			DDRSS2_CTL_247_DATA
			DDRSS2_CTL_248_DATA
			DDRSS2_CTL_249_DATA
			DDRSS2_CTL_250_DATA
			DDRSS2_CTL_251_DATA
			DDRSS2_CTL_252_DATA
			DDRSS2_CTL_253_DATA
			DDRSS2_CTL_254_DATA
			DDRSS2_CTL_255_DATA
			DDRSS2_CTL_256_DATA
			DDRSS2_CTL_257_DATA
			DDRSS2_CTL_258_DATA
			DDRSS2_CTL_259_DATA
			DDRSS2_CTL_260_DATA
			DDRSS2_CTL_261_DATA
			DDRSS2_CTL_262_DATA
			DDRSS2_CTL_263_DATA
			DDRSS2_CTL_264_DATA
			DDRSS2_CTL_265_DATA
			DDRSS2_CTL_266_DATA
			DDRSS2_CTL_267_DATA
			DDRSS2_CTL_268_DATA
			DDRSS2_CTL_269_DATA
			DDRSS2_CTL_270_DATA
			DDRSS2_CTL_271_DATA
			DDRSS2_CTL_272_DATA
			DDRSS2_CTL_273_DATA
			DDRSS2_CTL_274_DATA
			DDRSS2_CTL_275_DATA
			DDRSS2_CTL_276_DATA
			DDRSS2_CTL_277_DATA
			DDRSS2_CTL_278_DATA
			DDRSS2_CTL_279_DATA
			DDRSS2_CTL_280_DATA
			DDRSS2_CTL_281_DATA
			DDRSS2_CTL_282_DATA
			DDRSS2_CTL_283_DATA
			DDRSS2_CTL_284_DATA
			DDRSS2_CTL_285_DATA
			DDRSS2_CTL_286_DATA
			DDRSS2_CTL_287_DATA
			DDRSS2_CTL_288_DATA
			DDRSS2_CTL_289_DATA
			DDRSS2_CTL_290_DATA
			DDRSS2_CTL_291_DATA
			DDRSS2_CTL_292_DATA
			DDRSS2_CTL_293_DATA
			DDRSS2_CTL_294_DATA
			DDRSS2_CTL_295_DATA
			DDRSS2_CTL_296_DATA
			DDRSS2_CTL_297_DATA
			DDRSS2_CTL_298_DATA
			DDRSS2_CTL_299_DATA
			DDRSS2_CTL_300_DATA
			DDRSS2_CTL_301_DATA
			DDRSS2_CTL_302_DATA
			DDRSS2_CTL_303_DATA
			DDRSS2_CTL_304_DATA
			DDRSS2_CTL_305_DATA
			DDRSS2_CTL_306_DATA
			DDRSS2_CTL_307_DATA
			DDRSS2_CTL_308_DATA
			DDRSS2_CTL_309_DATA
			DDRSS2_CTL_310_DATA
			DDRSS2_CTL_311_DATA
			DDRSS2_CTL_312_DATA
			DDRSS2_CTL_313_DATA
			DDRSS2_CTL_314_DATA
			DDRSS2_CTL_315_DATA
			DDRSS2_CTL_316_DATA
			DDRSS2_CTL_317_DATA
			DDRSS2_CTL_318_DATA
			DDRSS2_CTL_319_DATA
			DDRSS2_CTL_320_DATA
			DDRSS2_CTL_321_DATA
			DDRSS2_CTL_322_DATA
			DDRSS2_CTL_323_DATA
			DDRSS2_CTL_324_DATA
			DDRSS2_CTL_325_DATA
			DDRSS2_CTL_326_DATA
			DDRSS2_CTL_327_DATA
			DDRSS2_CTL_328_DATA
			DDRSS2_CTL_329_DATA
			DDRSS2_CTL_330_DATA
			DDRSS2_CTL_331_DATA
			DDRSS2_CTL_332_DATA
			DDRSS2_CTL_333_DATA
			DDRSS2_CTL_334_DATA
			DDRSS2_CTL_335_DATA
			DDRSS2_CTL_336_DATA
			DDRSS2_CTL_337_DATA
			DDRSS2_CTL_338_DATA
			DDRSS2_CTL_339_DATA
			DDRSS2_CTL_340_DATA
			DDRSS2_CTL_341_DATA
			DDRSS2_CTL_342_DATA
			DDRSS2_CTL_343_DATA
			DDRSS2_CTL_344_DATA
			DDRSS2_CTL_345_DATA
			DDRSS2_CTL_346_DATA
			DDRSS2_CTL_347_DATA
			DDRSS2_CTL_348_DATA
			DDRSS2_CTL_349_DATA
			DDRSS2_CTL_350_DATA
			DDRSS2_CTL_351_DATA
			DDRSS2_CTL_352_DATA
			DDRSS2_CTL_353_DATA
			DDRSS2_CTL_354_DATA
			DDRSS2_CTL_355_DATA
			DDRSS2_CTL_356_DATA
			DDRSS2_CTL_357_DATA
			DDRSS2_CTL_358_DATA
			DDRSS2_CTL_359_DATA
			DDRSS2_CTL_360_DATA
			DDRSS2_CTL_361_DATA
			DDRSS2_CTL_362_DATA
			DDRSS2_CTL_363_DATA
			DDRSS2_CTL_364_DATA
			DDRSS2_CTL_365_DATA
			DDRSS2_CTL_366_DATA
			DDRSS2_CTL_367_DATA
			DDRSS2_CTL_368_DATA
			DDRSS2_CTL_369_DATA
			DDRSS2_CTL_370_DATA
			DDRSS2_CTL_371_DATA
			DDRSS2_CTL_372_DATA
			DDRSS2_CTL_373_DATA
			DDRSS2_CTL_374_DATA
			DDRSS2_CTL_375_DATA
			DDRSS2_CTL_376_DATA
			DDRSS2_CTL_377_DATA
			DDRSS2_CTL_378_DATA
			DDRSS2_CTL_379_DATA
			DDRSS2_CTL_380_DATA
			DDRSS2_CTL_381_DATA
			DDRSS2_CTL_382_DATA
			DDRSS2_CTL_383_DATA
			DDRSS2_CTL_384_DATA
			DDRSS2_CTL_385_DATA
			DDRSS2_CTL_386_DATA
			DDRSS2_CTL_387_DATA
			DDRSS2_CTL_388_DATA
			DDRSS2_CTL_389_DATA
			DDRSS2_CTL_390_DATA
			DDRSS2_CTL_391_DATA
			DDRSS2_CTL_392_DATA
			DDRSS2_CTL_393_DATA
			DDRSS2_CTL_394_DATA
			DDRSS2_CTL_395_DATA
			DDRSS2_CTL_396_DATA
			DDRSS2_CTL_397_DATA
			DDRSS2_CTL_398_DATA
			DDRSS2_CTL_399_DATA
			DDRSS2_CTL_400_DATA
			DDRSS2_CTL_401_DATA
			DDRSS2_CTL_402_DATA
			DDRSS2_CTL_403_DATA
			DDRSS2_CTL_404_DATA
			DDRSS2_CTL_405_DATA
			DDRSS2_CTL_406_DATA
			DDRSS2_CTL_407_DATA
			DDRSS2_CTL_408_DATA
			DDRSS2_CTL_409_DATA
			DDRSS2_CTL_410_DATA
			DDRSS2_CTL_411_DATA
			DDRSS2_CTL_412_DATA
			DDRSS2_CTL_413_DATA
			DDRSS2_CTL_414_DATA
			DDRSS2_CTL_415_DATA
			DDRSS2_CTL_416_DATA
			DDRSS2_CTL_417_DATA
			DDRSS2_CTL_418_DATA
			DDRSS2_CTL_419_DATA
			DDRSS2_CTL_420_DATA
			DDRSS2_CTL_421_DATA
			DDRSS2_CTL_422_DATA
			DDRSS2_CTL_423_DATA
			DDRSS2_CTL_424_DATA
			DDRSS2_CTL_425_DATA
			DDRSS2_CTL_426_DATA
			DDRSS2_CTL_427_DATA
			DDRSS2_CTL_428_DATA
			DDRSS2_CTL_429_DATA
			DDRSS2_CTL_430_DATA
			DDRSS2_CTL_431_DATA
			DDRSS2_CTL_432_DATA
			DDRSS2_CTL_433_DATA
			DDRSS2_CTL_434_DATA
			DDRSS2_CTL_435_DATA
			DDRSS2_CTL_436_DATA
			DDRSS2_CTL_437_DATA
			DDRSS2_CTL_438_DATA
			DDRSS2_CTL_439_DATA
			DDRSS2_CTL_440_DATA
			DDRSS2_CTL_441_DATA
			DDRSS2_CTL_442_DATA
			DDRSS2_CTL_443_DATA
			DDRSS2_CTL_444_DATA
			DDRSS2_CTL_445_DATA
			DDRSS2_CTL_446_DATA
			DDRSS2_CTL_447_DATA
			DDRSS2_CTL_448_DATA
			DDRSS2_CTL_449_DATA
			DDRSS2_CTL_450_DATA
			DDRSS2_CTL_451_DATA
			DDRSS2_CTL_452_DATA
			DDRSS2_CTL_453_DATA
			DDRSS2_CTL_454_DATA
			DDRSS2_CTL_455_DATA
			DDRSS2_CTL_456_DATA
			DDRSS2_CTL_457_DATA
			DDRSS2_CTL_458_DATA
		>;

		ti,pi-data = <
			DDRSS2_PI_00_DATA
			DDRSS2_PI_01_DATA
			DDRSS2_PI_02_DATA
			DDRSS2_PI_03_DATA
			DDRSS2_PI_04_DATA
			DDRSS2_PI_05_DATA
			DDRSS2_PI_06_DATA
			DDRSS2_PI_07_DATA
			DDRSS2_PI_08_DATA
			DDRSS2_PI_09_DATA
			DDRSS2_PI_10_DATA
			DDRSS2_PI_11_DATA
			DDRSS2_PI_12_DATA
			DDRSS2_PI_13_DATA
			DDRSS2_PI_14_DATA
			DDRSS2_PI_15_DATA
			DDRSS2_PI_16_DATA
			DDRSS2_PI_17_DATA
			DDRSS2_PI_18_DATA
			DDRSS2_PI_19_DATA
			DDRSS2_PI_20_DATA
			DDRSS2_PI_21_DATA
			DDRSS2_PI_22_DATA
			DDRSS2_PI_23_DATA
			DDRSS2_PI_24_DATA
			DDRSS2_PI_25_DATA
			DDRSS2_PI_26_DATA
			DDRSS2_PI_27_DATA
			DDRSS2_PI_28_DATA
			DDRSS2_PI_29_DATA
			DDRSS2_PI_30_DATA
			DDRSS2_PI_31_DATA
			DDRSS2_PI_32_DATA
			DDRSS2_PI_33_DATA
			DDRSS2_PI_34_DATA
			DDRSS2_PI_35_DATA
			DDRSS2_PI_36_DATA
			DDRSS2_PI_37_DATA
			DDRSS2_PI_38_DATA
			DDRSS2_PI_39_DATA
			DDRSS2_PI_40_DATA
			DDRSS2_PI_41_DATA
			DDRSS2_PI_42_DATA
			DDRSS2_PI_43_DATA
			DDRSS2_PI_44_DATA
			DDRSS2_PI_45_DATA
			DDRSS2_PI_46_DATA
			DDRSS2_PI_47_DATA
			DDRSS2_PI_48_DATA
			DDRSS2_PI_49_DATA
			DDRSS2_PI_50_DATA
			DDRSS2_PI_51_DATA
			DDRSS2_PI_52_DATA
			DDRSS2_PI_53_DATA
			DDRSS2_PI_54_DATA
			DDRSS2_PI_55_DATA
			DDRSS2_PI_56_DATA
			DDRSS2_PI_57_DATA
			DDRSS2_PI_58_DATA
			DDRSS2_PI_59_DATA
			DDRSS2_PI_60_DATA
			DDRSS2_PI_61_DATA
			DDRSS2_PI_62_DATA
			DDRSS2_PI_63_DATA
			DDRSS2_PI_64_DATA
			DDRSS2_PI_65_DATA
			DDRSS2_PI_66_DATA
			DDRSS2_PI_67_DATA
			DDRSS2_PI_68_DATA
			DDRSS2_PI_69_DATA
			DDRSS2_PI_70_DATA
			DDRSS2_PI_71_DATA
			DDRSS2_PI_72_DATA
			DDRSS2_PI_73_DATA
			DDRSS2_PI_74_DATA
			DDRSS2_PI_75_DATA
			DDRSS2_PI_76_DATA
			DDRSS2_PI_77_DATA
			DDRSS2_PI_78_DATA
			DDRSS2_PI_79_DATA
			DDRSS2_PI_80_DATA
			DDRSS2_PI_81_DATA
			DDRSS2_PI_82_DATA
			DDRSS2_PI_83_DATA
			DDRSS2_PI_84_DATA
			DDRSS2_PI_85_DATA
			DDRSS2_PI_86_DATA
			DDRSS2_PI_87_DATA
			DDRSS2_PI_88_DATA
			DDRSS2_PI_89_DATA
			DDRSS2_PI_90_DATA
			DDRSS2_PI_91_DATA
			DDRSS2_PI_92_DATA
			DDRSS2_PI_93_DATA
			DDRSS2_PI_94_DATA
			DDRSS2_PI_95_DATA
			DDRSS2_PI_96_DATA
			DDRSS2_PI_97_DATA
			DDRSS2_PI_98_DATA
			DDRSS2_PI_99_DATA
			DDRSS2_PI_100_DATA
			DDRSS2_PI_101_DATA
			DDRSS2_PI_102_DATA
			DDRSS2_PI_103_DATA
			DDRSS2_PI_104_DATA
			DDRSS2_PI_105_DATA
			DDRSS2_PI_106_DATA
			DDRSS2_PI_107_DATA
			DDRSS2_PI_108_DATA
			DDRSS2_PI_109_DATA
			DDRSS2_PI_110_DATA
			DDRSS2_PI_111_DATA
			DDRSS2_PI_112_DATA
			DDRSS2_PI_113_DATA
			DDRSS2_PI_114_DATA
			DDRSS2_PI_115_DATA
			DDRSS2_PI_116_DATA
			DDRSS2_PI_117_DATA
			DDRSS2_PI_118_DATA
			DDRSS2_PI_119_DATA
			DDRSS2_PI_120_DATA
			DDRSS2_PI_121_DATA
			DDRSS2_PI_122_DATA
			DDRSS2_PI_123_DATA
			DDRSS2_PI_124_DATA
			DDRSS2_PI_125_DATA
			DDRSS2_PI_126_DATA
			DDRSS2_PI_127_DATA
			DDRSS2_PI_128_DATA
			DDRSS2_PI_129_DATA
			DDRSS2_PI_130_DATA
			DDRSS2_PI_131_DATA
			DDRSS2_PI_132_DATA
			DDRSS2_PI_133_DATA
			DDRSS2_PI_134_DATA
			DDRSS2_PI_135_DATA
			DDRSS2_PI_136_DATA
			DDRSS2_PI_137_DATA
			DDRSS2_PI_138_DATA
			DDRSS2_PI_139_DATA
			DDRSS2_PI_140_DATA
			DDRSS2_PI_141_DATA
			DDRSS2_PI_142_DATA
			DDRSS2_PI_143_DATA
			DDRSS2_PI_144_DATA
			DDRSS2_PI_145_DATA
			DDRSS2_PI_146_DATA
			DDRSS2_PI_147_DATA
			DDRSS2_PI_148_DATA
			DDRSS2_PI_149_DATA
			DDRSS2_PI_150_DATA
			DDRSS2_PI_151_DATA
			DDRSS2_PI_152_DATA
			DDRSS2_PI_153_DATA
			DDRSS2_PI_154_DATA
			DDRSS2_PI_155_DATA
			DDRSS2_PI_156_DATA
			DDRSS2_PI_157_DATA
			DDRSS2_PI_158_DATA
			DDRSS2_PI_159_DATA
			DDRSS2_PI_160_DATA
			DDRSS2_PI_161_DATA
			DDRSS2_PI_162_DATA
			DDRSS2_PI_163_DATA
			DDRSS2_PI_164_DATA
			DDRSS2_PI_165_DATA
			DDRSS2_PI_166_DATA
			DDRSS2_PI_167_DATA
			DDRSS2_PI_168_DATA
			DDRSS2_PI_169_DATA
			DDRSS2_PI_170_DATA
			DDRSS2_PI_171_DATA
			DDRSS2_PI_172_DATA
			DDRSS2_PI_173_DATA
			DDRSS2_PI_174_DATA
			DDRSS2_PI_175_DATA
			DDRSS2_PI_176_DATA
			DDRSS2_PI_177_DATA
			DDRSS2_PI_178_DATA
			DDRSS2_PI_179_DATA
			DDRSS2_PI_180_DATA
			DDRSS2_PI_181_DATA
			DDRSS2_PI_182_DATA
			DDRSS2_PI_183_DATA
			DDRSS2_PI_184_DATA
			DDRSS2_PI_185_DATA
			DDRSS2_PI_186_DATA
			DDRSS2_PI_187_DATA
			DDRSS2_PI_188_DATA
			DDRSS2_PI_189_DATA
			DDRSS2_PI_190_DATA
			DDRSS2_PI_191_DATA
			DDRSS2_PI_192_DATA
			DDRSS2_PI_193_DATA
			DDRSS2_PI_194_DATA
			DDRSS2_PI_195_DATA
			DDRSS2_PI_196_DATA
			DDRSS2_PI_197_DATA
			DDRSS2_PI_198_DATA
			DDRSS2_PI_199_DATA
			DDRSS2_PI_200_DATA
			DDRSS2_PI_201_DATA
			DDRSS2_PI_202_DATA
			DDRSS2_PI_203_DATA
			DDRSS2_PI_204_DATA
			DDRSS2_PI_205_DATA
			DDRSS2_PI_206_DATA
			DDRSS2_PI_207_DATA
			DDRSS2_PI_208_DATA
			DDRSS2_PI_209_DATA
			DDRSS2_PI_210_DATA
			DDRSS2_PI_211_DATA
			DDRSS2_PI_212_DATA
			DDRSS2_PI_213_DATA
			DDRSS2_PI_214_DATA
			DDRSS2_PI_215_DATA
			DDRSS2_PI_216_DATA
			DDRSS2_PI_217_DATA
			DDRSS2_PI_218_DATA
			DDRSS2_PI_219_DATA
			DDRSS2_PI_220_DATA
			DDRSS2_PI_221_DATA
			DDRSS2_PI_222_DATA
			DDRSS2_PI_223_DATA
			DDRSS2_PI_224_DATA
			DDRSS2_PI_225_DATA
			DDRSS2_PI_226_DATA
			DDRSS2_PI_227_DATA
			DDRSS2_PI_228_DATA
			DDRSS2_PI_229_DATA
			DDRSS2_PI_230_DATA
			DDRSS2_PI_231_DATA
			DDRSS2_PI_232_DATA
			DDRSS2_PI_233_DATA
			DDRSS2_PI_234_DATA
			DDRSS2_PI_235_DATA
			DDRSS2_PI_236_DATA
			DDRSS2_PI_237_DATA
			DDRSS2_PI_238_DATA
			DDRSS2_PI_239_DATA
			DDRSS2_PI_240_DATA
			DDRSS2_PI_241_DATA
			DDRSS2_PI_242_DATA
			DDRSS2_PI_243_DATA
			DDRSS2_PI_244_DATA
			DDRSS2_PI_245_DATA
			DDRSS2_PI_246_DATA
			DDRSS2_PI_247_DATA
			DDRSS2_PI_248_DATA
			DDRSS2_PI_249_DATA
			DDRSS2_PI_250_DATA
			DDRSS2_PI_251_DATA
			DDRSS2_PI_252_DATA
			DDRSS2_PI_253_DATA
			DDRSS2_PI_254_DATA
			DDRSS2_PI_255_DATA
			DDRSS2_PI_256_DATA
			DDRSS2_PI_257_DATA
			DDRSS2_PI_258_DATA
			DDRSS2_PI_259_DATA
			DDRSS2_PI_260_DATA
			DDRSS2_PI_261_DATA
			DDRSS2_PI_262_DATA
			DDRSS2_PI_263_DATA
			DDRSS2_PI_264_DATA
			DDRSS2_PI_265_DATA
			DDRSS2_PI_266_DATA
			DDRSS2_PI_267_DATA
			DDRSS2_PI_268_DATA
			DDRSS2_PI_269_DATA
			DDRSS2_PI_270_DATA
			DDRSS2_PI_271_DATA
			DDRSS2_PI_272_DATA
			DDRSS2_PI_273_DATA
			DDRSS2_PI_274_DATA
			DDRSS2_PI_275_DATA
			DDRSS2_PI_276_DATA
			DDRSS2_PI_277_DATA
			DDRSS2_PI_278_DATA
			DDRSS2_PI_279_DATA
			DDRSS2_PI_280_DATA
			DDRSS2_PI_281_DATA
			DDRSS2_PI_282_DATA
			DDRSS2_PI_283_DATA
			DDRSS2_PI_284_DATA
			DDRSS2_PI_285_DATA
			DDRSS2_PI_286_DATA
			DDRSS2_PI_287_DATA
			DDRSS2_PI_288_DATA
			DDRSS2_PI_289_DATA
			DDRSS2_PI_290_DATA
			DDRSS2_PI_291_DATA
			DDRSS2_PI_292_DATA
			DDRSS2_PI_293_DATA
			DDRSS2_PI_294_DATA
			DDRSS2_PI_295_DATA
			DDRSS2_PI_296_DATA
			DDRSS2_PI_297_DATA
			DDRSS2_PI_298_DATA
			DDRSS2_PI_299_DATA
		>;

		ti,phy-data = <
			DDRSS2_PHY_00_DATA
			DDRSS2_PHY_01_DATA
			DDRSS2_PHY_02_DATA
			DDRSS2_PHY_03_DATA
			DDRSS2_PHY_04_DATA
			DDRSS2_PHY_05_DATA
			DDRSS2_PHY_06_DATA
			DDRSS2_PHY_07_DATA
			DDRSS2_PHY_08_DATA
			DDRSS2_PHY_09_DATA
			DDRSS2_PHY_10_DATA
			DDRSS2_PHY_11_DATA
			DDRSS2_PHY_12_DATA
			DDRSS2_PHY_13_DATA
			DDRSS2_PHY_14_DATA
			DDRSS2_PHY_15_DATA
			DDRSS2_PHY_16_DATA
			DDRSS2_PHY_17_DATA
			DDRSS2_PHY_18_DATA
			DDRSS2_PHY_19_DATA
			DDRSS2_PHY_20_DATA
			DDRSS2_PHY_21_DATA
			DDRSS2_PHY_22_DATA
			DDRSS2_PHY_23_DATA
			DDRSS2_PHY_24_DATA
			DDRSS2_PHY_25_DATA
			DDRSS2_PHY_26_DATA
			DDRSS2_PHY_27_DATA
			DDRSS2_PHY_28_DATA
			DDRSS2_PHY_29_DATA
			DDRSS2_PHY_30_DATA
			DDRSS2_PHY_31_DATA
			DDRSS2_PHY_32_DATA
			DDRSS2_PHY_33_DATA
			DDRSS2_PHY_34_DATA
			DDRSS2_PHY_35_DATA
			DDRSS2_PHY_36_DATA
			DDRSS2_PHY_37_DATA
			DDRSS2_PHY_38_DATA
			DDRSS2_PHY_39_DATA
			DDRSS2_PHY_40_DATA
			DDRSS2_PHY_41_DATA
			DDRSS2_PHY_42_DATA
			DDRSS2_PHY_43_DATA
			DDRSS2_PHY_44_DATA
			DDRSS2_PHY_45_DATA
			DDRSS2_PHY_46_DATA
			DDRSS2_PHY_47_DATA
			DDRSS2_PHY_48_DATA
			DDRSS2_PHY_49_DATA
			DDRSS2_PHY_50_DATA
			DDRSS2_PHY_51_DATA
			DDRSS2_PHY_52_DATA
			DDRSS2_PHY_53_DATA
			DDRSS2_PHY_54_DATA
			DDRSS2_PHY_55_DATA
			DDRSS2_PHY_56_DATA
			DDRSS2_PHY_57_DATA
			DDRSS2_PHY_58_DATA
			DDRSS2_PHY_59_DATA
			DDRSS2_PHY_60_DATA
			DDRSS2_PHY_61_DATA
			DDRSS2_PHY_62_DATA
			DDRSS2_PHY_63_DATA
			DDRSS2_PHY_64_DATA
			DDRSS2_PHY_65_DATA
			DDRSS2_PHY_66_DATA
			DDRSS2_PHY_67_DATA
			DDRSS2_PHY_68_DATA
			DDRSS2_PHY_69_DATA
			DDRSS2_PHY_70_DATA
			DDRSS2_PHY_71_DATA
			DDRSS2_PHY_72_DATA
			DDRSS2_PHY_73_DATA
			DDRSS2_PHY_74_DATA
			DDRSS2_PHY_75_DATA
			DDRSS2_PHY_76_DATA
			DDRSS2_PHY_77_DATA
			DDRSS2_PHY_78_DATA
			DDRSS2_PHY_79_DATA
			DDRSS2_PHY_80_DATA
			DDRSS2_PHY_81_DATA
			DDRSS2_PHY_82_DATA
			DDRSS2_PHY_83_DATA
			DDRSS2_PHY_84_DATA
			DDRSS2_PHY_85_DATA
			DDRSS2_PHY_86_DATA
			DDRSS2_PHY_87_DATA
			DDRSS2_PHY_88_DATA
			DDRSS2_PHY_89_DATA
			DDRSS2_PHY_90_DATA
			DDRSS2_PHY_91_DATA
			DDRSS2_PHY_92_DATA
			DDRSS2_PHY_93_DATA
			DDRSS2_PHY_94_DATA
			DDRSS2_PHY_95_DATA
			DDRSS2_PHY_96_DATA
			DDRSS2_PHY_97_DATA
			DDRSS2_PHY_98_DATA
			DDRSS2_PHY_99_DATA
			DDRSS2_PHY_100_DATA
			DDRSS2_PHY_101_DATA
			DDRSS2_PHY_102_DATA
			DDRSS2_PHY_103_DATA
			DDRSS2_PHY_104_DATA
			DDRSS2_PHY_105_DATA
			DDRSS2_PHY_106_DATA
			DDRSS2_PHY_107_DATA
			DDRSS2_PHY_108_DATA
			DDRSS2_PHY_109_DATA
			DDRSS2_PHY_110_DATA
			DDRSS2_PHY_111_DATA
			DDRSS2_PHY_112_DATA
			DDRSS2_PHY_113_DATA
			DDRSS2_PHY_114_DATA
			DDRSS2_PHY_115_DATA
			DDRSS2_PHY_116_DATA
			DDRSS2_PHY_117_DATA
			DDRSS2_PHY_118_DATA
			DDRSS2_PHY_119_DATA
			DDRSS2_PHY_120_DATA
			DDRSS2_PHY_121_DATA
			DDRSS2_PHY_122_DATA
			DDRSS2_PHY_123_DATA
			DDRSS2_PHY_124_DATA
			DDRSS2_PHY_125_DATA
			DDRSS2_PHY_126_DATA
			DDRSS2_PHY_127_DATA
			DDRSS2_PHY_128_DATA
			DDRSS2_PHY_129_DATA
			DDRSS2_PHY_130_DATA
			DDRSS2_PHY_131_DATA
			DDRSS2_PHY_132_DATA
			DDRSS2_PHY_133_DATA
			DDRSS2_PHY_134_DATA
			DDRSS2_PHY_135_DATA
			DDRSS2_PHY_136_DATA
			DDRSS2_PHY_137_DATA
			DDRSS2_PHY_138_DATA
			DDRSS2_PHY_139_DATA
			DDRSS2_PHY_140_DATA
			DDRSS2_PHY_141_DATA
			DDRSS2_PHY_142_DATA
			DDRSS2_PHY_143_DATA
			DDRSS2_PHY_144_DATA
			DDRSS2_PHY_145_DATA
			DDRSS2_PHY_146_DATA
			DDRSS2_PHY_147_DATA
			DDRSS2_PHY_148_DATA
			DDRSS2_PHY_149_DATA
			DDRSS2_PHY_150_DATA
			DDRSS2_PHY_151_DATA
			DDRSS2_PHY_152_DATA
			DDRSS2_PHY_153_DATA
			DDRSS2_PHY_154_DATA
			DDRSS2_PHY_155_DATA
			DDRSS2_PHY_156_DATA
			DDRSS2_PHY_157_DATA
			DDRSS2_PHY_158_DATA
			DDRSS2_PHY_159_DATA
			DDRSS2_PHY_160_DATA
			DDRSS2_PHY_161_DATA
			DDRSS2_PHY_162_DATA
			DDRSS2_PHY_163_DATA
			DDRSS2_PHY_164_DATA
			DDRSS2_PHY_165_DATA
			DDRSS2_PHY_166_DATA
			DDRSS2_PHY_167_DATA
			DDRSS2_PHY_168_DATA
			DDRSS2_PHY_169_DATA
			DDRSS2_PHY_170_DATA
			DDRSS2_PHY_171_DATA
			DDRSS2_PHY_172_DATA
			DDRSS2_PHY_173_DATA
			DDRSS2_PHY_174_DATA
			DDRSS2_PHY_175_DATA
			DDRSS2_PHY_176_DATA
			DDRSS2_PHY_177_DATA
			DDRSS2_PHY_178_DATA
			DDRSS2_PHY_179_DATA
			DDRSS2_PHY_180_DATA
			DDRSS2_PHY_181_DATA
			DDRSS2_PHY_182_DATA
			DDRSS2_PHY_183_DATA
			DDRSS2_PHY_184_DATA
			DDRSS2_PHY_185_DATA
			DDRSS2_PHY_186_DATA
			DDRSS2_PHY_187_DATA
			DDRSS2_PHY_188_DATA
			DDRSS2_PHY_189_DATA
			DDRSS2_PHY_190_DATA
			DDRSS2_PHY_191_DATA
			DDRSS2_PHY_192_DATA
			DDRSS2_PHY_193_DATA
			DDRSS2_PHY_194_DATA
			DDRSS2_PHY_195_DATA
			DDRSS2_PHY_196_DATA
			DDRSS2_PHY_197_DATA
			DDRSS2_PHY_198_DATA
			DDRSS2_PHY_199_DATA
			DDRSS2_PHY_200_DATA
			DDRSS2_PHY_201_DATA
			DDRSS2_PHY_202_DATA
			DDRSS2_PHY_203_DATA
			DDRSS2_PHY_204_DATA
			DDRSS2_PHY_205_DATA
			DDRSS2_PHY_206_DATA
			DDRSS2_PHY_207_DATA
			DDRSS2_PHY_208_DATA
			DDRSS2_PHY_209_DATA
			DDRSS2_PHY_210_DATA
			DDRSS2_PHY_211_DATA
			DDRSS2_PHY_212_DATA
			DDRSS2_PHY_213_DATA
			DDRSS2_PHY_214_DATA
			DDRSS2_PHY_215_DATA
			DDRSS2_PHY_216_DATA
			DDRSS2_PHY_217_DATA
			DDRSS2_PHY_218_DATA
			DDRSS2_PHY_219_DATA
			DDRSS2_PHY_220_DATA
			DDRSS2_PHY_221_DATA
			DDRSS2_PHY_222_DATA
			DDRSS2_PHY_223_DATA
			DDRSS2_PHY_224_DATA
			DDRSS2_PHY_225_DATA
			DDRSS2_PHY_226_DATA
			DDRSS2_PHY_227_DATA
			DDRSS2_PHY_228_DATA
			DDRSS2_PHY_229_DATA
			DDRSS2_PHY_230_DATA
			DDRSS2_PHY_231_DATA
			DDRSS2_PHY_232_DATA
			DDRSS2_PHY_233_DATA
			DDRSS2_PHY_234_DATA
			DDRSS2_PHY_235_DATA
			DDRSS2_PHY_236_DATA
			DDRSS2_PHY_237_DATA
			DDRSS2_PHY_238_DATA
			DDRSS2_PHY_239_DATA
			DDRSS2_PHY_240_DATA
			DDRSS2_PHY_241_DATA
			DDRSS2_PHY_242_DATA
			DDRSS2_PHY_243_DATA
			DDRSS2_PHY_244_DATA
			DDRSS2_PHY_245_DATA
			DDRSS2_PHY_246_DATA
			DDRSS2_PHY_247_DATA
			DDRSS2_PHY_248_DATA
			DDRSS2_PHY_249_DATA
			DDRSS2_PHY_250_DATA
			DDRSS2_PHY_251_DATA
			DDRSS2_PHY_252_DATA
			DDRSS2_PHY_253_DATA
			DDRSS2_PHY_254_DATA
			DDRSS2_PHY_255_DATA
			DDRSS2_PHY_256_DATA
			DDRSS2_PHY_257_DATA
			DDRSS2_PHY_258_DATA
			DDRSS2_PHY_259_DATA
			DDRSS2_PHY_260_DATA
			DDRSS2_PHY_261_DATA
			DDRSS2_PHY_262_DATA
			DDRSS2_PHY_263_DATA
			DDRSS2_PHY_264_DATA
			DDRSS2_PHY_265_DATA
			DDRSS2_PHY_266_DATA
			DDRSS2_PHY_267_DATA
			DDRSS2_PHY_268_DATA
			DDRSS2_PHY_269_DATA
			DDRSS2_PHY_270_DATA
			DDRSS2_PHY_271_DATA
			DDRSS2_PHY_272_DATA
			DDRSS2_PHY_273_DATA
			DDRSS2_PHY_274_DATA
			DDRSS2_PHY_275_DATA
			DDRSS2_PHY_276_DATA
			DDRSS2_PHY_277_DATA
			DDRSS2_PHY_278_DATA
			DDRSS2_PHY_279_DATA
			DDRSS2_PHY_280_DATA
			DDRSS2_PHY_281_DATA
			DDRSS2_PHY_282_DATA
			DDRSS2_PHY_283_DATA
			DDRSS2_PHY_284_DATA
			DDRSS2_PHY_285_DATA
			DDRSS2_PHY_286_DATA
			DDRSS2_PHY_287_DATA
			DDRSS2_PHY_288_DATA
			DDRSS2_PHY_289_DATA
			DDRSS2_PHY_290_DATA
			DDRSS2_PHY_291_DATA
			DDRSS2_PHY_292_DATA
			DDRSS2_PHY_293_DATA
			DDRSS2_PHY_294_DATA
			DDRSS2_PHY_295_DATA
			DDRSS2_PHY_296_DATA
			DDRSS2_PHY_297_DATA
			DDRSS2_PHY_298_DATA
			DDRSS2_PHY_299_DATA
			DDRSS2_PHY_300_DATA
			DDRSS2_PHY_301_DATA
			DDRSS2_PHY_302_DATA
			DDRSS2_PHY_303_DATA
			DDRSS2_PHY_304_DATA
			DDRSS2_PHY_305_DATA
			DDRSS2_PHY_306_DATA
			DDRSS2_PHY_307_DATA
			DDRSS2_PHY_308_DATA
			DDRSS2_PHY_309_DATA
			DDRSS2_PHY_310_DATA
			DDRSS2_PHY_311_DATA
			DDRSS2_PHY_312_DATA
			DDRSS2_PHY_313_DATA
			DDRSS2_PHY_314_DATA
			DDRSS2_PHY_315_DATA
			DDRSS2_PHY_316_DATA
			DDRSS2_PHY_317_DATA
			DDRSS2_PHY_318_DATA
			DDRSS2_PHY_319_DATA
			DDRSS2_PHY_320_DATA
			DDRSS2_PHY_321_DATA
			DDRSS2_PHY_322_DATA
			DDRSS2_PHY_323_DATA
			DDRSS2_PHY_324_DATA
			DDRSS2_PHY_325_DATA
			DDRSS2_PHY_326_DATA
			DDRSS2_PHY_327_DATA
			DDRSS2_PHY_328_DATA
			DDRSS2_PHY_329_DATA
			DDRSS2_PHY_330_DATA
			DDRSS2_PHY_331_DATA
			DDRSS2_PHY_332_DATA
			DDRSS2_PHY_333_DATA
			DDRSS2_PHY_334_DATA
			DDRSS2_PHY_335_DATA
			DDRSS2_PHY_336_DATA
			DDRSS2_PHY_337_DATA
			DDRSS2_PHY_338_DATA
			DDRSS2_PHY_339_DATA
			DDRSS2_PHY_340_DATA
			DDRSS2_PHY_341_DATA
			DDRSS2_PHY_342_DATA
			DDRSS2_PHY_343_DATA
			DDRSS2_PHY_344_DATA
			DDRSS2_PHY_345_DATA
			DDRSS2_PHY_346_DATA
			DDRSS2_PHY_347_DATA
			DDRSS2_PHY_348_DATA
			DDRSS2_PHY_349_DATA
			DDRSS2_PHY_350_DATA
			DDRSS2_PHY_351_DATA
			DDRSS2_PHY_352_DATA
			DDRSS2_PHY_353_DATA
			DDRSS2_PHY_354_DATA
			DDRSS2_PHY_355_DATA
			DDRSS2_PHY_356_DATA
			DDRSS2_PHY_357_DATA
			DDRSS2_PHY_358_DATA
			DDRSS2_PHY_359_DATA
			DDRSS2_PHY_360_DATA
			DDRSS2_PHY_361_DATA
			DDRSS2_PHY_362_DATA
			DDRSS2_PHY_363_DATA
			DDRSS2_PHY_364_DATA
			DDRSS2_PHY_365_DATA
			DDRSS2_PHY_366_DATA
			DDRSS2_PHY_367_DATA
			DDRSS2_PHY_368_DATA
			DDRSS2_PHY_369_DATA
			DDRSS2_PHY_370_DATA
			DDRSS2_PHY_371_DATA
			DDRSS2_PHY_372_DATA
			DDRSS2_PHY_373_DATA
			DDRSS2_PHY_374_DATA
			DDRSS2_PHY_375_DATA
			DDRSS2_PHY_376_DATA
			DDRSS2_PHY_377_DATA
			DDRSS2_PHY_378_DATA
			DDRSS2_PHY_379_DATA
			DDRSS2_PHY_380_DATA
			DDRSS2_PHY_381_DATA
			DDRSS2_PHY_382_DATA
			DDRSS2_PHY_383_DATA
			DDRSS2_PHY_384_DATA
			DDRSS2_PHY_385_DATA
			DDRSS2_PHY_386_DATA
			DDRSS2_PHY_387_DATA
			DDRSS2_PHY_388_DATA
			DDRSS2_PHY_389_DATA
			DDRSS2_PHY_390_DATA
			DDRSS2_PHY_391_DATA
			DDRSS2_PHY_392_DATA
			DDRSS2_PHY_393_DATA
			DDRSS2_PHY_394_DATA
			DDRSS2_PHY_395_DATA
			DDRSS2_PHY_396_DATA
			DDRSS2_PHY_397_DATA
			DDRSS2_PHY_398_DATA
			DDRSS2_PHY_399_DATA
			DDRSS2_PHY_400_DATA
			DDRSS2_PHY_401_DATA
			DDRSS2_PHY_402_DATA
			DDRSS2_PHY_403_DATA
			DDRSS2_PHY_404_DATA
			DDRSS2_PHY_405_DATA
			DDRSS2_PHY_406_DATA
			DDRSS2_PHY_407_DATA
			DDRSS2_PHY_408_DATA
			DDRSS2_PHY_409_DATA
			DDRSS2_PHY_410_DATA
			DDRSS2_PHY_411_DATA
			DDRSS2_PHY_412_DATA
			DDRSS2_PHY_413_DATA
			DDRSS2_PHY_414_DATA
			DDRSS2_PHY_415_DATA
			DDRSS2_PHY_416_DATA
			DDRSS2_PHY_417_DATA
			DDRSS2_PHY_418_DATA
			DDRSS2_PHY_419_DATA
			DDRSS2_PHY_420_DATA
			DDRSS2_PHY_421_DATA
			DDRSS2_PHY_422_DATA
			DDRSS2_PHY_423_DATA
			DDRSS2_PHY_424_DATA
			DDRSS2_PHY_425_DATA
			DDRSS2_PHY_426_DATA
			DDRSS2_PHY_427_DATA
			DDRSS2_PHY_428_DATA
			DDRSS2_PHY_429_DATA
			DDRSS2_PHY_430_DATA
			DDRSS2_PHY_431_DATA
			DDRSS2_PHY_432_DATA
			DDRSS2_PHY_433_DATA
			DDRSS2_PHY_434_DATA
			DDRSS2_PHY_435_DATA
			DDRSS2_PHY_436_DATA
			DDRSS2_PHY_437_DATA
			DDRSS2_PHY_438_DATA
			DDRSS2_PHY_439_DATA
			DDRSS2_PHY_440_DATA
			DDRSS2_PHY_441_DATA
			DDRSS2_PHY_442_DATA
			DDRSS2_PHY_443_DATA
			DDRSS2_PHY_444_DATA
			DDRSS2_PHY_445_DATA
			DDRSS2_PHY_446_DATA
			DDRSS2_PHY_447_DATA
			DDRSS2_PHY_448_DATA
			DDRSS2_PHY_449_DATA
			DDRSS2_PHY_450_DATA
			DDRSS2_PHY_451_DATA
			DDRSS2_PHY_452_DATA
			DDRSS2_PHY_453_DATA
			DDRSS2_PHY_454_DATA
			DDRSS2_PHY_455_DATA
			DDRSS2_PHY_456_DATA
			DDRSS2_PHY_457_DATA
			DDRSS2_PHY_458_DATA
			DDRSS2_PHY_459_DATA
			DDRSS2_PHY_460_DATA
			DDRSS2_PHY_461_DATA
			DDRSS2_PHY_462_DATA
			DDRSS2_PHY_463_DATA
			DDRSS2_PHY_464_DATA
			DDRSS2_PHY_465_DATA
			DDRSS2_PHY_466_DATA
			DDRSS2_PHY_467_DATA
			DDRSS2_PHY_468_DATA
			DDRSS2_PHY_469_DATA
			DDRSS2_PHY_470_DATA
			DDRSS2_PHY_471_DATA
			DDRSS2_PHY_472_DATA
			DDRSS2_PHY_473_DATA
			DDRSS2_PHY_474_DATA
			DDRSS2_PHY_475_DATA
			DDRSS2_PHY_476_DATA
			DDRSS2_PHY_477_DATA
			DDRSS2_PHY_478_DATA
			DDRSS2_PHY_479_DATA
			DDRSS2_PHY_480_DATA
			DDRSS2_PHY_481_DATA
			DDRSS2_PHY_482_DATA
			DDRSS2_PHY_483_DATA
			DDRSS2_PHY_484_DATA
			DDRSS2_PHY_485_DATA
			DDRSS2_PHY_486_DATA
			DDRSS2_PHY_487_DATA
			DDRSS2_PHY_488_DATA
			DDRSS2_PHY_489_DATA
			DDRSS2_PHY_490_DATA
			DDRSS2_PHY_491_DATA
			DDRSS2_PHY_492_DATA
			DDRSS2_PHY_493_DATA
			DDRSS2_PHY_494_DATA
			DDRSS2_PHY_495_DATA
			DDRSS2_PHY_496_DATA
			DDRSS2_PHY_497_DATA
			DDRSS2_PHY_498_DATA
			DDRSS2_PHY_499_DATA
			DDRSS2_PHY_500_DATA
			DDRSS2_PHY_501_DATA
			DDRSS2_PHY_502_DATA
			DDRSS2_PHY_503_DATA
			DDRSS2_PHY_504_DATA
			DDRSS2_PHY_505_DATA
			DDRSS2_PHY_506_DATA
			DDRSS2_PHY_507_DATA
			DDRSS2_PHY_508_DATA
			DDRSS2_PHY_509_DATA
			DDRSS2_PHY_510_DATA
			DDRSS2_PHY_511_DATA
			DDRSS2_PHY_512_DATA
			DDRSS2_PHY_513_DATA
			DDRSS2_PHY_514_DATA
			DDRSS2_PHY_515_DATA
			DDRSS2_PHY_516_DATA
			DDRSS2_PHY_517_DATA
			DDRSS2_PHY_518_DATA
			DDRSS2_PHY_519_DATA
			DDRSS2_PHY_520_DATA
			DDRSS2_PHY_521_DATA
			DDRSS2_PHY_522_DATA
			DDRSS2_PHY_523_DATA
			DDRSS2_PHY_524_DATA
			DDRSS2_PHY_525_DATA
			DDRSS2_PHY_526_DATA
			DDRSS2_PHY_527_DATA
			DDRSS2_PHY_528_DATA
			DDRSS2_PHY_529_DATA
			DDRSS2_PHY_530_DATA
			DDRSS2_PHY_531_DATA
			DDRSS2_PHY_532_DATA
			DDRSS2_PHY_533_DATA
			DDRSS2_PHY_534_DATA
			DDRSS2_PHY_535_DATA
			DDRSS2_PHY_536_DATA
			DDRSS2_PHY_537_DATA
			DDRSS2_PHY_538_DATA
			DDRSS2_PHY_539_DATA
			DDRSS2_PHY_540_DATA
			DDRSS2_PHY_541_DATA
			DDRSS2_PHY_542_DATA
			DDRSS2_PHY_543_DATA
			DDRSS2_PHY_544_DATA
			DDRSS2_PHY_545_DATA
			DDRSS2_PHY_546_DATA
			DDRSS2_PHY_547_DATA
			DDRSS2_PHY_548_DATA
			DDRSS2_PHY_549_DATA
			DDRSS2_PHY_550_DATA
			DDRSS2_PHY_551_DATA
			DDRSS2_PHY_552_DATA
			DDRSS2_PHY_553_DATA
			DDRSS2_PHY_554_DATA
			DDRSS2_PHY_555_DATA
			DDRSS2_PHY_556_DATA
			DDRSS2_PHY_557_DATA
			DDRSS2_PHY_558_DATA
			DDRSS2_PHY_559_DATA
			DDRSS2_PHY_560_DATA
			DDRSS2_PHY_561_DATA
			DDRSS2_PHY_562_DATA
			DDRSS2_PHY_563_DATA
			DDRSS2_PHY_564_DATA
			DDRSS2_PHY_565_DATA
			DDRSS2_PHY_566_DATA
			DDRSS2_PHY_567_DATA
			DDRSS2_PHY_568_DATA
			DDRSS2_PHY_569_DATA
			DDRSS2_PHY_570_DATA
			DDRSS2_PHY_571_DATA
			DDRSS2_PHY_572_DATA
			DDRSS2_PHY_573_DATA
			DDRSS2_PHY_574_DATA
			DDRSS2_PHY_575_DATA
			DDRSS2_PHY_576_DATA
			DDRSS2_PHY_577_DATA
			DDRSS2_PHY_578_DATA
			DDRSS2_PHY_579_DATA
			DDRSS2_PHY_580_DATA
			DDRSS2_PHY_581_DATA
			DDRSS2_PHY_582_DATA
			DDRSS2_PHY_583_DATA
			DDRSS2_PHY_584_DATA
			DDRSS2_PHY_585_DATA
			DDRSS2_PHY_586_DATA
			DDRSS2_PHY_587_DATA
			DDRSS2_PHY_588_DATA
			DDRSS2_PHY_589_DATA
			DDRSS2_PHY_590_DATA
			DDRSS2_PHY_591_DATA
			DDRSS2_PHY_592_DATA
			DDRSS2_PHY_593_DATA
			DDRSS2_PHY_594_DATA
			DDRSS2_PHY_595_DATA
			DDRSS2_PHY_596_DATA
			DDRSS2_PHY_597_DATA
			DDRSS2_PHY_598_DATA
			DDRSS2_PHY_599_DATA
			DDRSS2_PHY_600_DATA
			DDRSS2_PHY_601_DATA
			DDRSS2_PHY_602_DATA
			DDRSS2_PHY_603_DATA
			DDRSS2_PHY_604_DATA
			DDRSS2_PHY_605_DATA
			DDRSS2_PHY_606_DATA
			DDRSS2_PHY_607_DATA
			DDRSS2_PHY_608_DATA
			DDRSS2_PHY_609_DATA
			DDRSS2_PHY_610_DATA
			DDRSS2_PHY_611_DATA
			DDRSS2_PHY_612_DATA
			DDRSS2_PHY_613_DATA
			DDRSS2_PHY_614_DATA
			DDRSS2_PHY_615_DATA
			DDRSS2_PHY_616_DATA
			DDRSS2_PHY_617_DATA
			DDRSS2_PHY_618_DATA
			DDRSS2_PHY_619_DATA
			DDRSS2_PHY_620_DATA
			DDRSS2_PHY_621_DATA
			DDRSS2_PHY_622_DATA
			DDRSS2_PHY_623_DATA
			DDRSS2_PHY_624_DATA
			DDRSS2_PHY_625_DATA
			DDRSS2_PHY_626_DATA
			DDRSS2_PHY_627_DATA
			DDRSS2_PHY_628_DATA
			DDRSS2_PHY_629_DATA
			DDRSS2_PHY_630_DATA
			DDRSS2_PHY_631_DATA
			DDRSS2_PHY_632_DATA
			DDRSS2_PHY_633_DATA
			DDRSS2_PHY_634_DATA
			DDRSS2_PHY_635_DATA
			DDRSS2_PHY_636_DATA
			DDRSS2_PHY_637_DATA
			DDRSS2_PHY_638_DATA
			DDRSS2_PHY_639_DATA
			DDRSS2_PHY_640_DATA
			DDRSS2_PHY_641_DATA
			DDRSS2_PHY_642_DATA
			DDRSS2_PHY_643_DATA
			DDRSS2_PHY_644_DATA
			DDRSS2_PHY_645_DATA
			DDRSS2_PHY_646_DATA
			DDRSS2_PHY_647_DATA
			DDRSS2_PHY_648_DATA
			DDRSS2_PHY_649_DATA
			DDRSS2_PHY_650_DATA
			DDRSS2_PHY_651_DATA
			DDRSS2_PHY_652_DATA
			DDRSS2_PHY_653_DATA
			DDRSS2_PHY_654_DATA
			DDRSS2_PHY_655_DATA
			DDRSS2_PHY_656_DATA
			DDRSS2_PHY_657_DATA
			DDRSS2_PHY_658_DATA
			DDRSS2_PHY_659_DATA
			DDRSS2_PHY_660_DATA
			DDRSS2_PHY_661_DATA
			DDRSS2_PHY_662_DATA
			DDRSS2_PHY_663_DATA
			DDRSS2_PHY_664_DATA
			DDRSS2_PHY_665_DATA
			DDRSS2_PHY_666_DATA
			DDRSS2_PHY_667_DATA
			DDRSS2_PHY_668_DATA
			DDRSS2_PHY_669_DATA
			DDRSS2_PHY_670_DATA
			DDRSS2_PHY_671_DATA
			DDRSS2_PHY_672_DATA
			DDRSS2_PHY_673_DATA
			DDRSS2_PHY_674_DATA
			DDRSS2_PHY_675_DATA
			DDRSS2_PHY_676_DATA
			DDRSS2_PHY_677_DATA
			DDRSS2_PHY_678_DATA
			DDRSS2_PHY_679_DATA
			DDRSS2_PHY_680_DATA
			DDRSS2_PHY_681_DATA
			DDRSS2_PHY_682_DATA
			DDRSS2_PHY_683_DATA
			DDRSS2_PHY_684_DATA
			DDRSS2_PHY_685_DATA
			DDRSS2_PHY_686_DATA
			DDRSS2_PHY_687_DATA
			DDRSS2_PHY_688_DATA
			DDRSS2_PHY_689_DATA
			DDRSS2_PHY_690_DATA
			DDRSS2_PHY_691_DATA
			DDRSS2_PHY_692_DATA
			DDRSS2_PHY_693_DATA
			DDRSS2_PHY_694_DATA
			DDRSS2_PHY_695_DATA
			DDRSS2_PHY_696_DATA
			DDRSS2_PHY_697_DATA
			DDRSS2_PHY_698_DATA
			DDRSS2_PHY_699_DATA
			DDRSS2_PHY_700_DATA
			DDRSS2_PHY_701_DATA
			DDRSS2_PHY_702_DATA
			DDRSS2_PHY_703_DATA
			DDRSS2_PHY_704_DATA
			DDRSS2_PHY_705_DATA
			DDRSS2_PHY_706_DATA
			DDRSS2_PHY_707_DATA
			DDRSS2_PHY_708_DATA
			DDRSS2_PHY_709_DATA
			DDRSS2_PHY_710_DATA
			DDRSS2_PHY_711_DATA
			DDRSS2_PHY_712_DATA
			DDRSS2_PHY_713_DATA
			DDRSS2_PHY_714_DATA
			DDRSS2_PHY_715_DATA
			DDRSS2_PHY_716_DATA
			DDRSS2_PHY_717_DATA
			DDRSS2_PHY_718_DATA
			DDRSS2_PHY_719_DATA
			DDRSS2_PHY_720_DATA
			DDRSS2_PHY_721_DATA
			DDRSS2_PHY_722_DATA
			DDRSS2_PHY_723_DATA
			DDRSS2_PHY_724_DATA
			DDRSS2_PHY_725_DATA
			DDRSS2_PHY_726_DATA
			DDRSS2_PHY_727_DATA
			DDRSS2_PHY_728_DATA
			DDRSS2_PHY_729_DATA
			DDRSS2_PHY_730_DATA
			DDRSS2_PHY_731_DATA
			DDRSS2_PHY_732_DATA
			DDRSS2_PHY_733_DATA
			DDRSS2_PHY_734_DATA
			DDRSS2_PHY_735_DATA
			DDRSS2_PHY_736_DATA
			DDRSS2_PHY_737_DATA
			DDRSS2_PHY_738_DATA
			DDRSS2_PHY_739_DATA
			DDRSS2_PHY_740_DATA
			DDRSS2_PHY_741_DATA
			DDRSS2_PHY_742_DATA
			DDRSS2_PHY_743_DATA
			DDRSS2_PHY_744_DATA
			DDRSS2_PHY_745_DATA
			DDRSS2_PHY_746_DATA
			DDRSS2_PHY_747_DATA
			DDRSS2_PHY_748_DATA
			DDRSS2_PHY_749_DATA
			DDRSS2_PHY_750_DATA
			DDRSS2_PHY_751_DATA
			DDRSS2_PHY_752_DATA
			DDRSS2_PHY_753_DATA
			DDRSS2_PHY_754_DATA
			DDRSS2_PHY_755_DATA
			DDRSS2_PHY_756_DATA
			DDRSS2_PHY_757_DATA
			DDRSS2_PHY_758_DATA
			DDRSS2_PHY_759_DATA
			DDRSS2_PHY_760_DATA
			DDRSS2_PHY_761_DATA
			DDRSS2_PHY_762_DATA
			DDRSS2_PHY_763_DATA
			DDRSS2_PHY_764_DATA
			DDRSS2_PHY_765_DATA
			DDRSS2_PHY_766_DATA
			DDRSS2_PHY_767_DATA
			DDRSS2_PHY_768_DATA
			DDRSS2_PHY_769_DATA
			DDRSS2_PHY_770_DATA
			DDRSS2_PHY_771_DATA
			DDRSS2_PHY_772_DATA
			DDRSS2_PHY_773_DATA
			DDRSS2_PHY_774_DATA
			DDRSS2_PHY_775_DATA
			DDRSS2_PHY_776_DATA
			DDRSS2_PHY_777_DATA
			DDRSS2_PHY_778_DATA
			DDRSS2_PHY_779_DATA
			DDRSS2_PHY_780_DATA
			DDRSS2_PHY_781_DATA
			DDRSS2_PHY_782_DATA
			DDRSS2_PHY_783_DATA
			DDRSS2_PHY_784_DATA
			DDRSS2_PHY_785_DATA
			DDRSS2_PHY_786_DATA
			DDRSS2_PHY_787_DATA
			DDRSS2_PHY_788_DATA
			DDRSS2_PHY_789_DATA
			DDRSS2_PHY_790_DATA
			DDRSS2_PHY_791_DATA
			DDRSS2_PHY_792_DATA
			DDRSS2_PHY_793_DATA
			DDRSS2_PHY_794_DATA
			DDRSS2_PHY_795_DATA
			DDRSS2_PHY_796_DATA
			DDRSS2_PHY_797_DATA
			DDRSS2_PHY_798_DATA
			DDRSS2_PHY_799_DATA
			DDRSS2_PHY_800_DATA
			DDRSS2_PHY_801_DATA
			DDRSS2_PHY_802_DATA
			DDRSS2_PHY_803_DATA
			DDRSS2_PHY_804_DATA
			DDRSS2_PHY_805_DATA
			DDRSS2_PHY_806_DATA
			DDRSS2_PHY_807_DATA
			DDRSS2_PHY_808_DATA
			DDRSS2_PHY_809_DATA
			DDRSS2_PHY_810_DATA
			DDRSS2_PHY_811_DATA
			DDRSS2_PHY_812_DATA
			DDRSS2_PHY_813_DATA
			DDRSS2_PHY_814_DATA
			DDRSS2_PHY_815_DATA
			DDRSS2_PHY_816_DATA
			DDRSS2_PHY_817_DATA
			DDRSS2_PHY_818_DATA
			DDRSS2_PHY_819_DATA
			DDRSS2_PHY_820_DATA
			DDRSS2_PHY_821_DATA
			DDRSS2_PHY_822_DATA
			DDRSS2_PHY_823_DATA
			DDRSS2_PHY_824_DATA
			DDRSS2_PHY_825_DATA
			DDRSS2_PHY_826_DATA
			DDRSS2_PHY_827_DATA
			DDRSS2_PHY_828_DATA
			DDRSS2_PHY_829_DATA
			DDRSS2_PHY_830_DATA
			DDRSS2_PHY_831_DATA
			DDRSS2_PHY_832_DATA
			DDRSS2_PHY_833_DATA
			DDRSS2_PHY_834_DATA
			DDRSS2_PHY_835_DATA
			DDRSS2_PHY_836_DATA
			DDRSS2_PHY_837_DATA
			DDRSS2_PHY_838_DATA
			DDRSS2_PHY_839_DATA
			DDRSS2_PHY_840_DATA
			DDRSS2_PHY_841_DATA
			DDRSS2_PHY_842_DATA
			DDRSS2_PHY_843_DATA
			DDRSS2_PHY_844_DATA
			DDRSS2_PHY_845_DATA
			DDRSS2_PHY_846_DATA
			DDRSS2_PHY_847_DATA
			DDRSS2_PHY_848_DATA
			DDRSS2_PHY_849_DATA
			DDRSS2_PHY_850_DATA
			DDRSS2_PHY_851_DATA
			DDRSS2_PHY_852_DATA
			DDRSS2_PHY_853_DATA
			DDRSS2_PHY_854_DATA
			DDRSS2_PHY_855_DATA
			DDRSS2_PHY_856_DATA
			DDRSS2_PHY_857_DATA
			DDRSS2_PHY_858_DATA
			DDRSS2_PHY_859_DATA
			DDRSS2_PHY_860_DATA
			DDRSS2_PHY_861_DATA
			DDRSS2_PHY_862_DATA
			DDRSS2_PHY_863_DATA
			DDRSS2_PHY_864_DATA
			DDRSS2_PHY_865_DATA
			DDRSS2_PHY_866_DATA
			DDRSS2_PHY_867_DATA
			DDRSS2_PHY_868_DATA
			DDRSS2_PHY_869_DATA
			DDRSS2_PHY_870_DATA
			DDRSS2_PHY_871_DATA
			DDRSS2_PHY_872_DATA
			DDRSS2_PHY_873_DATA
			DDRSS2_PHY_874_DATA
			DDRSS2_PHY_875_DATA
			DDRSS2_PHY_876_DATA
			DDRSS2_PHY_877_DATA
			DDRSS2_PHY_878_DATA
			DDRSS2_PHY_879_DATA
			DDRSS2_PHY_880_DATA
			DDRSS2_PHY_881_DATA
			DDRSS2_PHY_882_DATA
			DDRSS2_PHY_883_DATA
			DDRSS2_PHY_884_DATA
			DDRSS2_PHY_885_DATA
			DDRSS2_PHY_886_DATA
			DDRSS2_PHY_887_DATA
			DDRSS2_PHY_888_DATA
			DDRSS2_PHY_889_DATA
			DDRSS2_PHY_890_DATA
			DDRSS2_PHY_891_DATA
			DDRSS2_PHY_892_DATA
			DDRSS2_PHY_893_DATA
			DDRSS2_PHY_894_DATA
			DDRSS2_PHY_895_DATA
			DDRSS2_PHY_896_DATA
			DDRSS2_PHY_897_DATA
			DDRSS2_PHY_898_DATA
			DDRSS2_PHY_899_DATA
			DDRSS2_PHY_900_DATA
			DDRSS2_PHY_901_DATA
			DDRSS2_PHY_902_DATA
			DDRSS2_PHY_903_DATA
			DDRSS2_PHY_904_DATA
			DDRSS2_PHY_905_DATA
			DDRSS2_PHY_906_DATA
			DDRSS2_PHY_907_DATA
			DDRSS2_PHY_908_DATA
			DDRSS2_PHY_909_DATA
			DDRSS2_PHY_910_DATA
			DDRSS2_PHY_911_DATA
			DDRSS2_PHY_912_DATA
			DDRSS2_PHY_913_DATA
			DDRSS2_PHY_914_DATA
			DDRSS2_PHY_915_DATA
			DDRSS2_PHY_916_DATA
			DDRSS2_PHY_917_DATA
			DDRSS2_PHY_918_DATA
			DDRSS2_PHY_919_DATA
			DDRSS2_PHY_920_DATA
			DDRSS2_PHY_921_DATA
			DDRSS2_PHY_922_DATA
			DDRSS2_PHY_923_DATA
			DDRSS2_PHY_924_DATA
			DDRSS2_PHY_925_DATA
			DDRSS2_PHY_926_DATA
			DDRSS2_PHY_927_DATA
			DDRSS2_PHY_928_DATA
			DDRSS2_PHY_929_DATA
			DDRSS2_PHY_930_DATA
			DDRSS2_PHY_931_DATA
			DDRSS2_PHY_932_DATA
			DDRSS2_PHY_933_DATA
			DDRSS2_PHY_934_DATA
			DDRSS2_PHY_935_DATA
			DDRSS2_PHY_936_DATA
			DDRSS2_PHY_937_DATA
			DDRSS2_PHY_938_DATA
			DDRSS2_PHY_939_DATA
			DDRSS2_PHY_940_DATA
			DDRSS2_PHY_941_DATA
			DDRSS2_PHY_942_DATA
			DDRSS2_PHY_943_DATA
			DDRSS2_PHY_944_DATA
			DDRSS2_PHY_945_DATA
			DDRSS2_PHY_946_DATA
			DDRSS2_PHY_947_DATA
			DDRSS2_PHY_948_DATA
			DDRSS2_PHY_949_DATA
			DDRSS2_PHY_950_DATA
			DDRSS2_PHY_951_DATA
			DDRSS2_PHY_952_DATA
			DDRSS2_PHY_953_DATA
			DDRSS2_PHY_954_DATA
			DDRSS2_PHY_955_DATA
			DDRSS2_PHY_956_DATA
			DDRSS2_PHY_957_DATA
			DDRSS2_PHY_958_DATA
			DDRSS2_PHY_959_DATA
			DDRSS2_PHY_960_DATA
			DDRSS2_PHY_961_DATA
			DDRSS2_PHY_962_DATA
			DDRSS2_PHY_963_DATA
			DDRSS2_PHY_964_DATA
			DDRSS2_PHY_965_DATA
			DDRSS2_PHY_966_DATA
			DDRSS2_PHY_967_DATA
			DDRSS2_PHY_968_DATA
			DDRSS2_PHY_969_DATA
			DDRSS2_PHY_970_DATA
			DDRSS2_PHY_971_DATA
			DDRSS2_PHY_972_DATA
			DDRSS2_PHY_973_DATA
			DDRSS2_PHY_974_DATA
			DDRSS2_PHY_975_DATA
			DDRSS2_PHY_976_DATA
			DDRSS2_PHY_977_DATA
			DDRSS2_PHY_978_DATA
			DDRSS2_PHY_979_DATA
			DDRSS2_PHY_980_DATA
			DDRSS2_PHY_981_DATA
			DDRSS2_PHY_982_DATA
			DDRSS2_PHY_983_DATA
			DDRSS2_PHY_984_DATA
			DDRSS2_PHY_985_DATA
			DDRSS2_PHY_986_DATA
			DDRSS2_PHY_987_DATA
			DDRSS2_PHY_988_DATA
			DDRSS2_PHY_989_DATA
			DDRSS2_PHY_990_DATA
			DDRSS2_PHY_991_DATA
			DDRSS2_PHY_992_DATA
			DDRSS2_PHY_993_DATA
			DDRSS2_PHY_994_DATA
			DDRSS2_PHY_995_DATA
			DDRSS2_PHY_996_DATA
			DDRSS2_PHY_997_DATA
			DDRSS2_PHY_998_DATA
			DDRSS2_PHY_999_DATA
			DDRSS2_PHY_1000_DATA
			DDRSS2_PHY_1001_DATA
			DDRSS2_PHY_1002_DATA
			DDRSS2_PHY_1003_DATA
			DDRSS2_PHY_1004_DATA
			DDRSS2_PHY_1005_DATA
			DDRSS2_PHY_1006_DATA
			DDRSS2_PHY_1007_DATA
			DDRSS2_PHY_1008_DATA
			DDRSS2_PHY_1009_DATA
			DDRSS2_PHY_1010_DATA
			DDRSS2_PHY_1011_DATA
			DDRSS2_PHY_1012_DATA
			DDRSS2_PHY_1013_DATA
			DDRSS2_PHY_1014_DATA
			DDRSS2_PHY_1015_DATA
			DDRSS2_PHY_1016_DATA
			DDRSS2_PHY_1017_DATA
			DDRSS2_PHY_1018_DATA
			DDRSS2_PHY_1019_DATA
			DDRSS2_PHY_1020_DATA
			DDRSS2_PHY_1021_DATA
			DDRSS2_PHY_1022_DATA
			DDRSS2_PHY_1023_DATA
			DDRSS2_PHY_1024_DATA
			DDRSS2_PHY_1025_DATA
			DDRSS2_PHY_1026_DATA
			DDRSS2_PHY_1027_DATA
			DDRSS2_PHY_1028_DATA
			DDRSS2_PHY_1029_DATA
			DDRSS2_PHY_1030_DATA
			DDRSS2_PHY_1031_DATA
			DDRSS2_PHY_1032_DATA
			DDRSS2_PHY_1033_DATA
			DDRSS2_PHY_1034_DATA
			DDRSS2_PHY_1035_DATA
			DDRSS2_PHY_1036_DATA
			DDRSS2_PHY_1037_DATA
			DDRSS2_PHY_1038_DATA
			DDRSS2_PHY_1039_DATA
			DDRSS2_PHY_1040_DATA
			DDRSS2_PHY_1041_DATA
			DDRSS2_PHY_1042_DATA
			DDRSS2_PHY_1043_DATA
			DDRSS2_PHY_1044_DATA
			DDRSS2_PHY_1045_DATA
			DDRSS2_PHY_1046_DATA
			DDRSS2_PHY_1047_DATA
			DDRSS2_PHY_1048_DATA
			DDRSS2_PHY_1049_DATA
			DDRSS2_PHY_1050_DATA
			DDRSS2_PHY_1051_DATA
			DDRSS2_PHY_1052_DATA
			DDRSS2_PHY_1053_DATA
			DDRSS2_PHY_1054_DATA
			DDRSS2_PHY_1055_DATA
			DDRSS2_PHY_1056_DATA
			DDRSS2_PHY_1057_DATA
			DDRSS2_PHY_1058_DATA
			DDRSS2_PHY_1059_DATA
			DDRSS2_PHY_1060_DATA
			DDRSS2_PHY_1061_DATA
			DDRSS2_PHY_1062_DATA
			DDRSS2_PHY_1063_DATA
			DDRSS2_PHY_1064_DATA
			DDRSS2_PHY_1065_DATA
			DDRSS2_PHY_1066_DATA
			DDRSS2_PHY_1067_DATA
			DDRSS2_PHY_1068_DATA
			DDRSS2_PHY_1069_DATA
			DDRSS2_PHY_1070_DATA
			DDRSS2_PHY_1071_DATA
			DDRSS2_PHY_1072_DATA
			DDRSS2_PHY_1073_DATA
			DDRSS2_PHY_1074_DATA
			DDRSS2_PHY_1075_DATA
			DDRSS2_PHY_1076_DATA
			DDRSS2_PHY_1077_DATA
			DDRSS2_PHY_1078_DATA
			DDRSS2_PHY_1079_DATA
			DDRSS2_PHY_1080_DATA
			DDRSS2_PHY_1081_DATA
			DDRSS2_PHY_1082_DATA
			DDRSS2_PHY_1083_DATA
			DDRSS2_PHY_1084_DATA
			DDRSS2_PHY_1085_DATA
			DDRSS2_PHY_1086_DATA
			DDRSS2_PHY_1087_DATA
			DDRSS2_PHY_1088_DATA
			DDRSS2_PHY_1089_DATA
			DDRSS2_PHY_1090_DATA
			DDRSS2_PHY_1091_DATA
			DDRSS2_PHY_1092_DATA
			DDRSS2_PHY_1093_DATA
			DDRSS2_PHY_1094_DATA
			DDRSS2_PHY_1095_DATA
			DDRSS2_PHY_1096_DATA
			DDRSS2_PHY_1097_DATA
			DDRSS2_PHY_1098_DATA
			DDRSS2_PHY_1099_DATA
			DDRSS2_PHY_1100_DATA
			DDRSS2_PHY_1101_DATA
			DDRSS2_PHY_1102_DATA
			DDRSS2_PHY_1103_DATA
			DDRSS2_PHY_1104_DATA
			DDRSS2_PHY_1105_DATA
			DDRSS2_PHY_1106_DATA
			DDRSS2_PHY_1107_DATA
			DDRSS2_PHY_1108_DATA
			DDRSS2_PHY_1109_DATA
			DDRSS2_PHY_1110_DATA
			DDRSS2_PHY_1111_DATA
			DDRSS2_PHY_1112_DATA
			DDRSS2_PHY_1113_DATA
			DDRSS2_PHY_1114_DATA
			DDRSS2_PHY_1115_DATA
			DDRSS2_PHY_1116_DATA
			DDRSS2_PHY_1117_DATA
			DDRSS2_PHY_1118_DATA
			DDRSS2_PHY_1119_DATA
			DDRSS2_PHY_1120_DATA
			DDRSS2_PHY_1121_DATA
			DDRSS2_PHY_1122_DATA
			DDRSS2_PHY_1123_DATA
			DDRSS2_PHY_1124_DATA
			DDRSS2_PHY_1125_DATA
			DDRSS2_PHY_1126_DATA
			DDRSS2_PHY_1127_DATA
			DDRSS2_PHY_1128_DATA
			DDRSS2_PHY_1129_DATA
			DDRSS2_PHY_1130_DATA
			DDRSS2_PHY_1131_DATA
			DDRSS2_PHY_1132_DATA
			DDRSS2_PHY_1133_DATA
			DDRSS2_PHY_1134_DATA
			DDRSS2_PHY_1135_DATA
			DDRSS2_PHY_1136_DATA
			DDRSS2_PHY_1137_DATA
			DDRSS2_PHY_1138_DATA
			DDRSS2_PHY_1139_DATA
			DDRSS2_PHY_1140_DATA
			DDRSS2_PHY_1141_DATA
			DDRSS2_PHY_1142_DATA
			DDRSS2_PHY_1143_DATA
			DDRSS2_PHY_1144_DATA
			DDRSS2_PHY_1145_DATA
			DDRSS2_PHY_1146_DATA
			DDRSS2_PHY_1147_DATA
			DDRSS2_PHY_1148_DATA
			DDRSS2_PHY_1149_DATA
			DDRSS2_PHY_1150_DATA
			DDRSS2_PHY_1151_DATA
			DDRSS2_PHY_1152_DATA
			DDRSS2_PHY_1153_DATA
			DDRSS2_PHY_1154_DATA
			DDRSS2_PHY_1155_DATA
			DDRSS2_PHY_1156_DATA
			DDRSS2_PHY_1157_DATA
			DDRSS2_PHY_1158_DATA
			DDRSS2_PHY_1159_DATA
			DDRSS2_PHY_1160_DATA
			DDRSS2_PHY_1161_DATA
			DDRSS2_PHY_1162_DATA
			DDRSS2_PHY_1163_DATA
			DDRSS2_PHY_1164_DATA
			DDRSS2_PHY_1165_DATA
			DDRSS2_PHY_1166_DATA
			DDRSS2_PHY_1167_DATA
			DDRSS2_PHY_1168_DATA
			DDRSS2_PHY_1169_DATA
			DDRSS2_PHY_1170_DATA
			DDRSS2_PHY_1171_DATA
			DDRSS2_PHY_1172_DATA
			DDRSS2_PHY_1173_DATA
			DDRSS2_PHY_1174_DATA
			DDRSS2_PHY_1175_DATA
			DDRSS2_PHY_1176_DATA
			DDRSS2_PHY_1177_DATA
			DDRSS2_PHY_1178_DATA
			DDRSS2_PHY_1179_DATA
			DDRSS2_PHY_1180_DATA
			DDRSS2_PHY_1181_DATA
			DDRSS2_PHY_1182_DATA
			DDRSS2_PHY_1183_DATA
			DDRSS2_PHY_1184_DATA
			DDRSS2_PHY_1185_DATA
			DDRSS2_PHY_1186_DATA
			DDRSS2_PHY_1187_DATA
			DDRSS2_PHY_1188_DATA
			DDRSS2_PHY_1189_DATA
			DDRSS2_PHY_1190_DATA
			DDRSS2_PHY_1191_DATA
			DDRSS2_PHY_1192_DATA
			DDRSS2_PHY_1193_DATA
			DDRSS2_PHY_1194_DATA
			DDRSS2_PHY_1195_DATA
			DDRSS2_PHY_1196_DATA
			DDRSS2_PHY_1197_DATA
			DDRSS2_PHY_1198_DATA
			DDRSS2_PHY_1199_DATA
			DDRSS2_PHY_1200_DATA
			DDRSS2_PHY_1201_DATA
			DDRSS2_PHY_1202_DATA
			DDRSS2_PHY_1203_DATA
			DDRSS2_PHY_1204_DATA
			DDRSS2_PHY_1205_DATA
			DDRSS2_PHY_1206_DATA
			DDRSS2_PHY_1207_DATA
			DDRSS2_PHY_1208_DATA
			DDRSS2_PHY_1209_DATA
			DDRSS2_PHY_1210_DATA
			DDRSS2_PHY_1211_DATA
			DDRSS2_PHY_1212_DATA
			DDRSS2_PHY_1213_DATA
			DDRSS2_PHY_1214_DATA
			DDRSS2_PHY_1215_DATA
			DDRSS2_PHY_1216_DATA
			DDRSS2_PHY_1217_DATA
			DDRSS2_PHY_1218_DATA
			DDRSS2_PHY_1219_DATA
			DDRSS2_PHY_1220_DATA
			DDRSS2_PHY_1221_DATA
			DDRSS2_PHY_1222_DATA
			DDRSS2_PHY_1223_DATA
			DDRSS2_PHY_1224_DATA
			DDRSS2_PHY_1225_DATA
			DDRSS2_PHY_1226_DATA
			DDRSS2_PHY_1227_DATA
			DDRSS2_PHY_1228_DATA
			DDRSS2_PHY_1229_DATA
			DDRSS2_PHY_1230_DATA
			DDRSS2_PHY_1231_DATA
			DDRSS2_PHY_1232_DATA
			DDRSS2_PHY_1233_DATA
			DDRSS2_PHY_1234_DATA
			DDRSS2_PHY_1235_DATA
			DDRSS2_PHY_1236_DATA
			DDRSS2_PHY_1237_DATA
			DDRSS2_PHY_1238_DATA
			DDRSS2_PHY_1239_DATA
			DDRSS2_PHY_1240_DATA
			DDRSS2_PHY_1241_DATA
			DDRSS2_PHY_1242_DATA
			DDRSS2_PHY_1243_DATA
			DDRSS2_PHY_1244_DATA
			DDRSS2_PHY_1245_DATA
			DDRSS2_PHY_1246_DATA
			DDRSS2_PHY_1247_DATA
			DDRSS2_PHY_1248_DATA
			DDRSS2_PHY_1249_DATA
			DDRSS2_PHY_1250_DATA
			DDRSS2_PHY_1251_DATA
			DDRSS2_PHY_1252_DATA
			DDRSS2_PHY_1253_DATA
			DDRSS2_PHY_1254_DATA
			DDRSS2_PHY_1255_DATA
			DDRSS2_PHY_1256_DATA
			DDRSS2_PHY_1257_DATA
			DDRSS2_PHY_1258_DATA
			DDRSS2_PHY_1259_DATA
			DDRSS2_PHY_1260_DATA
			DDRSS2_PHY_1261_DATA
			DDRSS2_PHY_1262_DATA
			DDRSS2_PHY_1263_DATA
			DDRSS2_PHY_1264_DATA
			DDRSS2_PHY_1265_DATA
			DDRSS2_PHY_1266_DATA
			DDRSS2_PHY_1267_DATA
			DDRSS2_PHY_1268_DATA
			DDRSS2_PHY_1269_DATA
			DDRSS2_PHY_1270_DATA
			DDRSS2_PHY_1271_DATA
			DDRSS2_PHY_1272_DATA
			DDRSS2_PHY_1273_DATA
			DDRSS2_PHY_1274_DATA
			DDRSS2_PHY_1275_DATA
			DDRSS2_PHY_1276_DATA
			DDRSS2_PHY_1277_DATA
			DDRSS2_PHY_1278_DATA
			DDRSS2_PHY_1279_DATA
			DDRSS2_PHY_1280_DATA
			DDRSS2_PHY_1281_DATA
			DDRSS2_PHY_1282_DATA
			DDRSS2_PHY_1283_DATA
			DDRSS2_PHY_1284_DATA
			DDRSS2_PHY_1285_DATA
			DDRSS2_PHY_1286_DATA
			DDRSS2_PHY_1287_DATA
			DDRSS2_PHY_1288_DATA
			DDRSS2_PHY_1289_DATA
			DDRSS2_PHY_1290_DATA
			DDRSS2_PHY_1291_DATA
			DDRSS2_PHY_1292_DATA
			DDRSS2_PHY_1293_DATA
			DDRSS2_PHY_1294_DATA
			DDRSS2_PHY_1295_DATA
			DDRSS2_PHY_1296_DATA
			DDRSS2_PHY_1297_DATA
			DDRSS2_PHY_1298_DATA
			DDRSS2_PHY_1299_DATA
			DDRSS2_PHY_1300_DATA
			DDRSS2_PHY_1301_DATA
			DDRSS2_PHY_1302_DATA
			DDRSS2_PHY_1303_DATA
			DDRSS2_PHY_1304_DATA
			DDRSS2_PHY_1305_DATA
			DDRSS2_PHY_1306_DATA
			DDRSS2_PHY_1307_DATA
			DDRSS2_PHY_1308_DATA
			DDRSS2_PHY_1309_DATA
			DDRSS2_PHY_1310_DATA
			DDRSS2_PHY_1311_DATA
			DDRSS2_PHY_1312_DATA
			DDRSS2_PHY_1313_DATA
			DDRSS2_PHY_1314_DATA
			DDRSS2_PHY_1315_DATA
			DDRSS2_PHY_1316_DATA
			DDRSS2_PHY_1317_DATA
			DDRSS2_PHY_1318_DATA
			DDRSS2_PHY_1319_DATA
			DDRSS2_PHY_1320_DATA
			DDRSS2_PHY_1321_DATA
			DDRSS2_PHY_1322_DATA
			DDRSS2_PHY_1323_DATA
			DDRSS2_PHY_1324_DATA
			DDRSS2_PHY_1325_DATA
			DDRSS2_PHY_1326_DATA
			DDRSS2_PHY_1327_DATA
			DDRSS2_PHY_1328_DATA
			DDRSS2_PHY_1329_DATA
			DDRSS2_PHY_1330_DATA
			DDRSS2_PHY_1331_DATA
			DDRSS2_PHY_1332_DATA
			DDRSS2_PHY_1333_DATA
			DDRSS2_PHY_1334_DATA
			DDRSS2_PHY_1335_DATA
			DDRSS2_PHY_1336_DATA
			DDRSS2_PHY_1337_DATA
			DDRSS2_PHY_1338_DATA
			DDRSS2_PHY_1339_DATA
			DDRSS2_PHY_1340_DATA
			DDRSS2_PHY_1341_DATA
			DDRSS2_PHY_1342_DATA
			DDRSS2_PHY_1343_DATA
			DDRSS2_PHY_1344_DATA
			DDRSS2_PHY_1345_DATA
			DDRSS2_PHY_1346_DATA
			DDRSS2_PHY_1347_DATA
			DDRSS2_PHY_1348_DATA
			DDRSS2_PHY_1349_DATA
			DDRSS2_PHY_1350_DATA
			DDRSS2_PHY_1351_DATA
			DDRSS2_PHY_1352_DATA
			DDRSS2_PHY_1353_DATA
			DDRSS2_PHY_1354_DATA
			DDRSS2_PHY_1355_DATA
			DDRSS2_PHY_1356_DATA
			DDRSS2_PHY_1357_DATA
			DDRSS2_PHY_1358_DATA
			DDRSS2_PHY_1359_DATA
			DDRSS2_PHY_1360_DATA
			DDRSS2_PHY_1361_DATA
			DDRSS2_PHY_1362_DATA
			DDRSS2_PHY_1363_DATA
			DDRSS2_PHY_1364_DATA
			DDRSS2_PHY_1365_DATA
			DDRSS2_PHY_1366_DATA
			DDRSS2_PHY_1367_DATA
			DDRSS2_PHY_1368_DATA
			DDRSS2_PHY_1369_DATA
			DDRSS2_PHY_1370_DATA
			DDRSS2_PHY_1371_DATA
			DDRSS2_PHY_1372_DATA
			DDRSS2_PHY_1373_DATA
			DDRSS2_PHY_1374_DATA
			DDRSS2_PHY_1375_DATA
			DDRSS2_PHY_1376_DATA
			DDRSS2_PHY_1377_DATA
			DDRSS2_PHY_1378_DATA
			DDRSS2_PHY_1379_DATA
			DDRSS2_PHY_1380_DATA
			DDRSS2_PHY_1381_DATA
			DDRSS2_PHY_1382_DATA
			DDRSS2_PHY_1383_DATA
			DDRSS2_PHY_1384_DATA
			DDRSS2_PHY_1385_DATA
			DDRSS2_PHY_1386_DATA
			DDRSS2_PHY_1387_DATA
			DDRSS2_PHY_1388_DATA
			DDRSS2_PHY_1389_DATA
			DDRSS2_PHY_1390_DATA
			DDRSS2_PHY_1391_DATA
			DDRSS2_PHY_1392_DATA
			DDRSS2_PHY_1393_DATA
			DDRSS2_PHY_1394_DATA
			DDRSS2_PHY_1395_DATA
			DDRSS2_PHY_1396_DATA
			DDRSS2_PHY_1397_DATA
			DDRSS2_PHY_1398_DATA
			DDRSS2_PHY_1399_DATA
			DDRSS2_PHY_1400_DATA
			DDRSS2_PHY_1401_DATA
			DDRSS2_PHY_1402_DATA
			DDRSS2_PHY_1403_DATA
			DDRSS2_PHY_1404_DATA
			DDRSS2_PHY_1405_DATA
			DDRSS2_PHY_1406_DATA
			DDRSS2_PHY_1407_DATA
			DDRSS2_PHY_1408_DATA
			DDRSS2_PHY_1409_DATA
			DDRSS2_PHY_1410_DATA
			DDRSS2_PHY_1411_DATA
			DDRSS2_PHY_1412_DATA
			DDRSS2_PHY_1413_DATA
			DDRSS2_PHY_1414_DATA
			DDRSS2_PHY_1415_DATA
			DDRSS2_PHY_1416_DATA
			DDRSS2_PHY_1417_DATA
			DDRSS2_PHY_1418_DATA
			DDRSS2_PHY_1419_DATA
			DDRSS2_PHY_1420_DATA
			DDRSS2_PHY_1421_DATA
			DDRSS2_PHY_1422_DATA
		>;
	};

	memorycontroller3: memorycontroller@29f0000 {
		compatible = "ti,j721s2-ddrss";
		reg = <0x0 0x029f0000 0x0 0x4000>,
			  <0x0 0x0114000 0x0 0x100>,
			  <0x0 0x29e0000 0x0 0x200>;
		reg-names = "cfg", "ctrl_mmr_lp4", "ss_cfg";
		power-domains = <&k3_pds 194 TI_SCI_PD_SHARED>,
			<&k3_pds 139 TI_SCI_PD_SHARED>;
		clocks = <&k3_clks 194 1>, <&k3_clks 78 2>;
		ti,ddr-freq0 = <DDRSS_PLL_FREQUENCY_0>;
		ti,ddr-freq1 = <DDRSS_PLL_FREQUENCY_1>;
		ti,ddr-freq2 = <DDRSS_PLL_FREQUENCY_2>;
		ti,ddr-fhs-cnt = <DDRSS_PLL_FHS_CNT>;
		instance = <3>;

		bootph-pre-ram;

		ti,ctl-data = <
			DDRSS3_CTL_00_DATA
			DDRSS3_CTL_01_DATA
			DDRSS3_CTL_02_DATA
			DDRSS3_CTL_03_DATA
			DDRSS3_CTL_04_DATA
			DDRSS3_CTL_05_DATA
			DDRSS3_CTL_06_DATA
			DDRSS3_CTL_07_DATA
			DDRSS3_CTL_08_DATA
			DDRSS3_CTL_09_DATA
			DDRSS3_CTL_10_DATA
			DDRSS3_CTL_11_DATA
			DDRSS3_CTL_12_DATA
			DDRSS3_CTL_13_DATA
			DDRSS3_CTL_14_DATA
			DDRSS3_CTL_15_DATA
			DDRSS3_CTL_16_DATA
			DDRSS3_CTL_17_DATA
			DDRSS3_CTL_18_DATA
			DDRSS3_CTL_19_DATA
			DDRSS3_CTL_20_DATA
			DDRSS3_CTL_21_DATA
			DDRSS3_CTL_22_DATA
			DDRSS3_CTL_23_DATA
			DDRSS3_CTL_24_DATA
			DDRSS3_CTL_25_DATA
			DDRSS3_CTL_26_DATA
			DDRSS3_CTL_27_DATA
			DDRSS3_CTL_28_DATA
			DDRSS3_CTL_29_DATA
			DDRSS3_CTL_30_DATA
			DDRSS3_CTL_31_DATA
			DDRSS3_CTL_32_DATA
			DDRSS3_CTL_33_DATA
			DDRSS3_CTL_34_DATA
			DDRSS3_CTL_35_DATA
			DDRSS3_CTL_36_DATA
			DDRSS3_CTL_37_DATA
			DDRSS3_CTL_38_DATA
			DDRSS3_CTL_39_DATA
			DDRSS3_CTL_40_DATA
			DDRSS3_CTL_41_DATA
			DDRSS3_CTL_42_DATA
			DDRSS3_CTL_43_DATA
			DDRSS3_CTL_44_DATA
			DDRSS3_CTL_45_DATA
			DDRSS3_CTL_46_DATA
			DDRSS3_CTL_47_DATA
			DDRSS3_CTL_48_DATA
			DDRSS3_CTL_49_DATA
			DDRSS3_CTL_50_DATA
			DDRSS3_CTL_51_DATA
			DDRSS3_CTL_52_DATA
			DDRSS3_CTL_53_DATA
			DDRSS3_CTL_54_DATA
			DDRSS3_CTL_55_DATA
			DDRSS3_CTL_56_DATA
			DDRSS3_CTL_57_DATA
			DDRSS3_CTL_58_DATA
			DDRSS3_CTL_59_DATA
			DDRSS3_CTL_60_DATA
			DDRSS3_CTL_61_DATA
			DDRSS3_CTL_62_DATA
			DDRSS3_CTL_63_DATA
			DDRSS3_CTL_64_DATA
			DDRSS3_CTL_65_DATA
			DDRSS3_CTL_66_DATA
			DDRSS3_CTL_67_DATA
			DDRSS3_CTL_68_DATA
			DDRSS3_CTL_69_DATA
			DDRSS3_CTL_70_DATA
			DDRSS3_CTL_71_DATA
			DDRSS3_CTL_72_DATA
			DDRSS3_CTL_73_DATA
			DDRSS3_CTL_74_DATA
			DDRSS3_CTL_75_DATA
			DDRSS3_CTL_76_DATA
			DDRSS3_CTL_77_DATA
			DDRSS3_CTL_78_DATA
			DDRSS3_CTL_79_DATA
			DDRSS3_CTL_80_DATA
			DDRSS3_CTL_81_DATA
			DDRSS3_CTL_82_DATA
			DDRSS3_CTL_83_DATA
			DDRSS3_CTL_84_DATA
			DDRSS3_CTL_85_DATA
			DDRSS3_CTL_86_DATA
			DDRSS3_CTL_87_DATA
			DDRSS3_CTL_88_DATA
			DDRSS3_CTL_89_DATA
			DDRSS3_CTL_90_DATA
			DDRSS3_CTL_91_DATA
			DDRSS3_CTL_92_DATA
			DDRSS3_CTL_93_DATA
			DDRSS3_CTL_94_DATA
			DDRSS3_CTL_95_DATA
			DDRSS3_CTL_96_DATA
			DDRSS3_CTL_97_DATA
			DDRSS3_CTL_98_DATA
			DDRSS3_CTL_99_DATA
			DDRSS3_CTL_100_DATA
			DDRSS3_CTL_101_DATA
			DDRSS3_CTL_102_DATA
			DDRSS3_CTL_103_DATA
			DDRSS3_CTL_104_DATA
			DDRSS3_CTL_105_DATA
			DDRSS3_CTL_106_DATA
			DDRSS3_CTL_107_DATA
			DDRSS3_CTL_108_DATA
			DDRSS3_CTL_109_DATA
			DDRSS3_CTL_110_DATA
			DDRSS3_CTL_111_DATA
			DDRSS3_CTL_112_DATA
			DDRSS3_CTL_113_DATA
			DDRSS3_CTL_114_DATA
			DDRSS3_CTL_115_DATA
			DDRSS3_CTL_116_DATA
			DDRSS3_CTL_117_DATA
			DDRSS3_CTL_118_DATA
			DDRSS3_CTL_119_DATA
			DDRSS3_CTL_120_DATA
			DDRSS3_CTL_121_DATA
			DDRSS3_CTL_122_DATA
			DDRSS3_CTL_123_DATA
			DDRSS3_CTL_124_DATA
			DDRSS3_CTL_125_DATA
			DDRSS3_CTL_126_DATA
			DDRSS3_CTL_127_DATA
			DDRSS3_CTL_128_DATA
			DDRSS3_CTL_129_DATA
			DDRSS3_CTL_130_DATA
			DDRSS3_CTL_131_DATA
			DDRSS3_CTL_132_DATA
			DDRSS3_CTL_133_DATA
			DDRSS3_CTL_134_DATA
			DDRSS3_CTL_135_DATA
			DDRSS3_CTL_136_DATA
			DDRSS3_CTL_137_DATA
			DDRSS3_CTL_138_DATA
			DDRSS3_CTL_139_DATA
			DDRSS3_CTL_140_DATA
			DDRSS3_CTL_141_DATA
			DDRSS3_CTL_142_DATA
			DDRSS3_CTL_143_DATA
			DDRSS3_CTL_144_DATA
			DDRSS3_CTL_145_DATA
			DDRSS3_CTL_146_DATA
			DDRSS3_CTL_147_DATA
			DDRSS3_CTL_148_DATA
			DDRSS3_CTL_149_DATA
			DDRSS3_CTL_150_DATA
			DDRSS3_CTL_151_DATA
			DDRSS3_CTL_152_DATA
			DDRSS3_CTL_153_DATA
			DDRSS3_CTL_154_DATA
			DDRSS3_CTL_155_DATA
			DDRSS3_CTL_156_DATA
			DDRSS3_CTL_157_DATA
			DDRSS3_CTL_158_DATA
			DDRSS3_CTL_159_DATA
			DDRSS3_CTL_160_DATA
			DDRSS3_CTL_161_DATA
			DDRSS3_CTL_162_DATA
			DDRSS3_CTL_163_DATA
			DDRSS3_CTL_164_DATA
			DDRSS3_CTL_165_DATA
			DDRSS3_CTL_166_DATA
			DDRSS3_CTL_167_DATA
			DDRSS3_CTL_168_DATA
			DDRSS3_CTL_169_DATA
			DDRSS3_CTL_170_DATA
			DDRSS3_CTL_171_DATA
			DDRSS3_CTL_172_DATA
			DDRSS3_CTL_173_DATA
			DDRSS3_CTL_174_DATA
			DDRSS3_CTL_175_DATA
			DDRSS3_CTL_176_DATA
			DDRSS3_CTL_177_DATA
			DDRSS3_CTL_178_DATA
			DDRSS3_CTL_179_DATA
			DDRSS3_CTL_180_DATA
			DDRSS3_CTL_181_DATA
			DDRSS3_CTL_182_DATA
			DDRSS3_CTL_183_DATA
			DDRSS3_CTL_184_DATA
			DDRSS3_CTL_185_DATA
			DDRSS3_CTL_186_DATA
			DDRSS3_CTL_187_DATA
			DDRSS3_CTL_188_DATA
			DDRSS3_CTL_189_DATA
			DDRSS3_CTL_190_DATA
			DDRSS3_CTL_191_DATA
			DDRSS3_CTL_192_DATA
			DDRSS3_CTL_193_DATA
			DDRSS3_CTL_194_DATA
			DDRSS3_CTL_195_DATA
			DDRSS3_CTL_196_DATA
			DDRSS3_CTL_197_DATA
			DDRSS3_CTL_198_DATA
			DDRSS3_CTL_199_DATA
			DDRSS3_CTL_200_DATA
			DDRSS3_CTL_201_DATA
			DDRSS3_CTL_202_DATA
			DDRSS3_CTL_203_DATA
			DDRSS3_CTL_204_DATA
			DDRSS3_CTL_205_DATA
			DDRSS3_CTL_206_DATA
			DDRSS3_CTL_207_DATA
			DDRSS3_CTL_208_DATA
			DDRSS3_CTL_209_DATA
			DDRSS3_CTL_210_DATA
			DDRSS3_CTL_211_DATA
			DDRSS3_CTL_212_DATA
			DDRSS3_CTL_213_DATA
			DDRSS3_CTL_214_DATA
			DDRSS3_CTL_215_DATA
			DDRSS3_CTL_216_DATA
			DDRSS3_CTL_217_DATA
			DDRSS3_CTL_218_DATA
			DDRSS3_CTL_219_DATA
			DDRSS3_CTL_220_DATA
			DDRSS3_CTL_221_DATA
			DDRSS3_CTL_222_DATA
			DDRSS3_CTL_223_DATA
			DDRSS3_CTL_224_DATA
			DDRSS3_CTL_225_DATA
			DDRSS3_CTL_226_DATA
			DDRSS3_CTL_227_DATA
			DDRSS3_CTL_228_DATA
			DDRSS3_CTL_229_DATA
			DDRSS3_CTL_230_DATA
			DDRSS3_CTL_231_DATA
			DDRSS3_CTL_232_DATA
			DDRSS3_CTL_233_DATA
			DDRSS3_CTL_234_DATA
			DDRSS3_CTL_235_DATA
			DDRSS3_CTL_236_DATA
			DDRSS3_CTL_237_DATA
			DDRSS3_CTL_238_DATA
			DDRSS3_CTL_239_DATA
			DDRSS3_CTL_240_DATA
			DDRSS3_CTL_241_DATA
			DDRSS3_CTL_242_DATA
			DDRSS3_CTL_243_DATA
			DDRSS3_CTL_244_DATA
			DDRSS3_CTL_245_DATA
			DDRSS3_CTL_246_DATA
			DDRSS3_CTL_247_DATA
			DDRSS3_CTL_248_DATA
			DDRSS3_CTL_249_DATA
			DDRSS3_CTL_250_DATA
			DDRSS3_CTL_251_DATA
			DDRSS3_CTL_252_DATA
			DDRSS3_CTL_253_DATA
			DDRSS3_CTL_254_DATA
			DDRSS3_CTL_255_DATA
			DDRSS3_CTL_256_DATA
			DDRSS3_CTL_257_DATA
			DDRSS3_CTL_258_DATA
			DDRSS3_CTL_259_DATA
			DDRSS3_CTL_260_DATA
			DDRSS3_CTL_261_DATA
			DDRSS3_CTL_262_DATA
			DDRSS3_CTL_263_DATA
			DDRSS3_CTL_264_DATA
			DDRSS3_CTL_265_DATA
			DDRSS3_CTL_266_DATA
			DDRSS3_CTL_267_DATA
			DDRSS3_CTL_268_DATA
			DDRSS3_CTL_269_DATA
			DDRSS3_CTL_270_DATA
			DDRSS3_CTL_271_DATA
			DDRSS3_CTL_272_DATA
			DDRSS3_CTL_273_DATA
			DDRSS3_CTL_274_DATA
			DDRSS3_CTL_275_DATA
			DDRSS3_CTL_276_DATA
			DDRSS3_CTL_277_DATA
			DDRSS3_CTL_278_DATA
			DDRSS3_CTL_279_DATA
			DDRSS3_CTL_280_DATA
			DDRSS3_CTL_281_DATA
			DDRSS3_CTL_282_DATA
			DDRSS3_CTL_283_DATA
			DDRSS3_CTL_284_DATA
			DDRSS3_CTL_285_DATA
			DDRSS3_CTL_286_DATA
			DDRSS3_CTL_287_DATA
			DDRSS3_CTL_288_DATA
			DDRSS3_CTL_289_DATA
			DDRSS3_CTL_290_DATA
			DDRSS3_CTL_291_DATA
			DDRSS3_CTL_292_DATA
			DDRSS3_CTL_293_DATA
			DDRSS3_CTL_294_DATA
			DDRSS3_CTL_295_DATA
			DDRSS3_CTL_296_DATA
			DDRSS3_CTL_297_DATA
			DDRSS3_CTL_298_DATA
			DDRSS3_CTL_299_DATA
			DDRSS3_CTL_300_DATA
			DDRSS3_CTL_301_DATA
			DDRSS3_CTL_302_DATA
			DDRSS3_CTL_303_DATA
			DDRSS3_CTL_304_DATA
			DDRSS3_CTL_305_DATA
			DDRSS3_CTL_306_DATA
			DDRSS3_CTL_307_DATA
			DDRSS3_CTL_308_DATA
			DDRSS3_CTL_309_DATA
			DDRSS3_CTL_310_DATA
			DDRSS3_CTL_311_DATA
			DDRSS3_CTL_312_DATA
			DDRSS3_CTL_313_DATA
			DDRSS3_CTL_314_DATA
			DDRSS3_CTL_315_DATA
			DDRSS3_CTL_316_DATA
			DDRSS3_CTL_317_DATA
			DDRSS3_CTL_318_DATA
			DDRSS3_CTL_319_DATA
			DDRSS3_CTL_320_DATA
			DDRSS3_CTL_321_DATA
			DDRSS3_CTL_322_DATA
			DDRSS3_CTL_323_DATA
			DDRSS3_CTL_324_DATA
			DDRSS3_CTL_325_DATA
			DDRSS3_CTL_326_DATA
			DDRSS3_CTL_327_DATA
			DDRSS3_CTL_328_DATA
			DDRSS3_CTL_329_DATA
			DDRSS3_CTL_330_DATA
			DDRSS3_CTL_331_DATA
			DDRSS3_CTL_332_DATA
			DDRSS3_CTL_333_DATA
			DDRSS3_CTL_334_DATA
			DDRSS3_CTL_335_DATA
			DDRSS3_CTL_336_DATA
			DDRSS3_CTL_337_DATA
			DDRSS3_CTL_338_DATA
			DDRSS3_CTL_339_DATA
			DDRSS3_CTL_340_DATA
			DDRSS3_CTL_341_DATA
			DDRSS3_CTL_342_DATA
			DDRSS3_CTL_343_DATA
			DDRSS3_CTL_344_DATA
			DDRSS3_CTL_345_DATA
			DDRSS3_CTL_346_DATA
			DDRSS3_CTL_347_DATA
			DDRSS3_CTL_348_DATA
			DDRSS3_CTL_349_DATA
			DDRSS3_CTL_350_DATA
			DDRSS3_CTL_351_DATA
			DDRSS3_CTL_352_DATA
			DDRSS3_CTL_353_DATA
			DDRSS3_CTL_354_DATA
			DDRSS3_CTL_355_DATA
			DDRSS3_CTL_356_DATA
			DDRSS3_CTL_357_DATA
			DDRSS3_CTL_358_DATA
			DDRSS3_CTL_359_DATA
			DDRSS3_CTL_360_DATA
			DDRSS3_CTL_361_DATA
			DDRSS3_CTL_362_DATA
			DDRSS3_CTL_363_DATA
			DDRSS3_CTL_364_DATA
			DDRSS3_CTL_365_DATA
			DDRSS3_CTL_366_DATA
			DDRSS3_CTL_367_DATA
			DDRSS3_CTL_368_DATA
			DDRSS3_CTL_369_DATA
			DDRSS3_CTL_370_DATA
			DDRSS3_CTL_371_DATA
			DDRSS3_CTL_372_DATA
			DDRSS3_CTL_373_DATA
			DDRSS3_CTL_374_DATA
			DDRSS3_CTL_375_DATA
			DDRSS3_CTL_376_DATA
			DDRSS3_CTL_377_DATA
			DDRSS3_CTL_378_DATA
			DDRSS3_CTL_379_DATA
			DDRSS3_CTL_380_DATA
			DDRSS3_CTL_381_DATA
			DDRSS3_CTL_382_DATA
			DDRSS3_CTL_383_DATA
			DDRSS3_CTL_384_DATA
			DDRSS3_CTL_385_DATA
			DDRSS3_CTL_386_DATA
			DDRSS3_CTL_387_DATA
			DDRSS3_CTL_388_DATA
			DDRSS3_CTL_389_DATA
			DDRSS3_CTL_390_DATA
			DDRSS3_CTL_391_DATA
			DDRSS3_CTL_392_DATA
			DDRSS3_CTL_393_DATA
			DDRSS3_CTL_394_DATA
			DDRSS3_CTL_395_DATA
			DDRSS3_CTL_396_DATA
			DDRSS3_CTL_397_DATA
			DDRSS3_CTL_398_DATA
			DDRSS3_CTL_399_DATA
			DDRSS3_CTL_400_DATA
			DDRSS3_CTL_401_DATA
			DDRSS3_CTL_402_DATA
			DDRSS3_CTL_403_DATA
			DDRSS3_CTL_404_DATA
			DDRSS3_CTL_405_DATA
			DDRSS3_CTL_406_DATA
			DDRSS3_CTL_407_DATA
			DDRSS3_CTL_408_DATA
			DDRSS3_CTL_409_DATA
			DDRSS3_CTL_410_DATA
			DDRSS3_CTL_411_DATA
			DDRSS3_CTL_412_DATA
			DDRSS3_CTL_413_DATA
			DDRSS3_CTL_414_DATA
			DDRSS3_CTL_415_DATA
			DDRSS3_CTL_416_DATA
			DDRSS3_CTL_417_DATA
			DDRSS3_CTL_418_DATA
			DDRSS3_CTL_419_DATA
			DDRSS3_CTL_420_DATA
			DDRSS3_CTL_421_DATA
			DDRSS3_CTL_422_DATA
			DDRSS3_CTL_423_DATA
			DDRSS3_CTL_424_DATA
			DDRSS3_CTL_425_DATA
			DDRSS3_CTL_426_DATA
			DDRSS3_CTL_427_DATA
			DDRSS3_CTL_428_DATA
			DDRSS3_CTL_429_DATA
			DDRSS3_CTL_430_DATA
			DDRSS3_CTL_431_DATA
			DDRSS3_CTL_432_DATA
			DDRSS3_CTL_433_DATA
			DDRSS3_CTL_434_DATA
			DDRSS3_CTL_435_DATA
			DDRSS3_CTL_436_DATA
			DDRSS3_CTL_437_DATA
			DDRSS3_CTL_438_DATA
			DDRSS3_CTL_439_DATA
			DDRSS3_CTL_440_DATA
			DDRSS3_CTL_441_DATA
			DDRSS3_CTL_442_DATA
			DDRSS3_CTL_443_DATA
			DDRSS3_CTL_444_DATA
			DDRSS3_CTL_445_DATA
			DDRSS3_CTL_446_DATA
			DDRSS3_CTL_447_DATA
			DDRSS3_CTL_448_DATA
			DDRSS3_CTL_449_DATA
			DDRSS3_CTL_450_DATA
			DDRSS3_CTL_451_DATA
			DDRSS3_CTL_452_DATA
			DDRSS3_CTL_453_DATA
			DDRSS3_CTL_454_DATA
			DDRSS3_CTL_455_DATA
			DDRSS3_CTL_456_DATA
			DDRSS3_CTL_457_DATA
			DDRSS3_CTL_458_DATA
		>;

		ti,pi-data = <
			DDRSS3_PI_00_DATA
			DDRSS3_PI_01_DATA
			DDRSS3_PI_02_DATA
			DDRSS3_PI_03_DATA
			DDRSS3_PI_04_DATA
			DDRSS3_PI_05_DATA
			DDRSS3_PI_06_DATA
			DDRSS3_PI_07_DATA
			DDRSS3_PI_08_DATA
			DDRSS3_PI_09_DATA
			DDRSS3_PI_10_DATA
			DDRSS3_PI_11_DATA
			DDRSS3_PI_12_DATA
			DDRSS3_PI_13_DATA
			DDRSS3_PI_14_DATA
			DDRSS3_PI_15_DATA
			DDRSS3_PI_16_DATA
			DDRSS3_PI_17_DATA
			DDRSS3_PI_18_DATA
			DDRSS3_PI_19_DATA
			DDRSS3_PI_20_DATA
			DDRSS3_PI_21_DATA
			DDRSS3_PI_22_DATA
			DDRSS3_PI_23_DATA
			DDRSS3_PI_24_DATA
			DDRSS3_PI_25_DATA
			DDRSS3_PI_26_DATA
			DDRSS3_PI_27_DATA
			DDRSS3_PI_28_DATA
			DDRSS3_PI_29_DATA
			DDRSS3_PI_30_DATA
			DDRSS3_PI_31_DATA
			DDRSS3_PI_32_DATA
			DDRSS3_PI_33_DATA
			DDRSS3_PI_34_DATA
			DDRSS3_PI_35_DATA
			DDRSS3_PI_36_DATA
			DDRSS3_PI_37_DATA
			DDRSS3_PI_38_DATA
			DDRSS3_PI_39_DATA
			DDRSS3_PI_40_DATA
			DDRSS3_PI_41_DATA
			DDRSS3_PI_42_DATA
			DDRSS3_PI_43_DATA
			DDRSS3_PI_44_DATA
			DDRSS3_PI_45_DATA
			DDRSS3_PI_46_DATA
			DDRSS3_PI_47_DATA
			DDRSS3_PI_48_DATA
			DDRSS3_PI_49_DATA
			DDRSS3_PI_50_DATA
			DDRSS3_PI_51_DATA
			DDRSS3_PI_52_DATA
			DDRSS3_PI_53_DATA
			DDRSS3_PI_54_DATA
			DDRSS3_PI_55_DATA
			DDRSS3_PI_56_DATA
			DDRSS3_PI_57_DATA
			DDRSS3_PI_58_DATA
			DDRSS3_PI_59_DATA
			DDRSS3_PI_60_DATA
			DDRSS3_PI_61_DATA
			DDRSS3_PI_62_DATA
			DDRSS3_PI_63_DATA
			DDRSS3_PI_64_DATA
			DDRSS3_PI_65_DATA
			DDRSS3_PI_66_DATA
			DDRSS3_PI_67_DATA
			DDRSS3_PI_68_DATA
			DDRSS3_PI_69_DATA
			DDRSS3_PI_70_DATA
			DDRSS3_PI_71_DATA
			DDRSS3_PI_72_DATA
			DDRSS3_PI_73_DATA
			DDRSS3_PI_74_DATA
			DDRSS3_PI_75_DATA
			DDRSS3_PI_76_DATA
			DDRSS3_PI_77_DATA
			DDRSS3_PI_78_DATA
			DDRSS3_PI_79_DATA
			DDRSS3_PI_80_DATA
			DDRSS3_PI_81_DATA
			DDRSS3_PI_82_DATA
			DDRSS3_PI_83_DATA
			DDRSS3_PI_84_DATA
			DDRSS3_PI_85_DATA
			DDRSS3_PI_86_DATA
			DDRSS3_PI_87_DATA
			DDRSS3_PI_88_DATA
			DDRSS3_PI_89_DATA
			DDRSS3_PI_90_DATA
			DDRSS3_PI_91_DATA
			DDRSS3_PI_92_DATA
			DDRSS3_PI_93_DATA
			DDRSS3_PI_94_DATA
			DDRSS3_PI_95_DATA
			DDRSS3_PI_96_DATA
			DDRSS3_PI_97_DATA
			DDRSS3_PI_98_DATA
			DDRSS3_PI_99_DATA
			DDRSS3_PI_100_DATA
			DDRSS3_PI_101_DATA
			DDRSS3_PI_102_DATA
			DDRSS3_PI_103_DATA
			DDRSS3_PI_104_DATA
			DDRSS3_PI_105_DATA
			DDRSS3_PI_106_DATA
			DDRSS3_PI_107_DATA
			DDRSS3_PI_108_DATA
			DDRSS3_PI_109_DATA
			DDRSS3_PI_110_DATA
			DDRSS3_PI_111_DATA
			DDRSS3_PI_112_DATA
			DDRSS3_PI_113_DATA
			DDRSS3_PI_114_DATA
			DDRSS3_PI_115_DATA
			DDRSS3_PI_116_DATA
			DDRSS3_PI_117_DATA
			DDRSS3_PI_118_DATA
			DDRSS3_PI_119_DATA
			DDRSS3_PI_120_DATA
			DDRSS3_PI_121_DATA
			DDRSS3_PI_122_DATA
			DDRSS3_PI_123_DATA
			DDRSS3_PI_124_DATA
			DDRSS3_PI_125_DATA
			DDRSS3_PI_126_DATA
			DDRSS3_PI_127_DATA
			DDRSS3_PI_128_DATA
			DDRSS3_PI_129_DATA
			DDRSS3_PI_130_DATA
			DDRSS3_PI_131_DATA
			DDRSS3_PI_132_DATA
			DDRSS3_PI_133_DATA
			DDRSS3_PI_134_DATA
			DDRSS3_PI_135_DATA
			DDRSS3_PI_136_DATA
			DDRSS3_PI_137_DATA
			DDRSS3_PI_138_DATA
			DDRSS3_PI_139_DATA
			DDRSS3_PI_140_DATA
			DDRSS3_PI_141_DATA
			DDRSS3_PI_142_DATA
			DDRSS3_PI_143_DATA
			DDRSS3_PI_144_DATA
			DDRSS3_PI_145_DATA
			DDRSS3_PI_146_DATA
			DDRSS3_PI_147_DATA
			DDRSS3_PI_148_DATA
			DDRSS3_PI_149_DATA
			DDRSS3_PI_150_DATA
			DDRSS3_PI_151_DATA
			DDRSS3_PI_152_DATA
			DDRSS3_PI_153_DATA
			DDRSS3_PI_154_DATA
			DDRSS3_PI_155_DATA
			DDRSS3_PI_156_DATA
			DDRSS3_PI_157_DATA
			DDRSS3_PI_158_DATA
			DDRSS3_PI_159_DATA
			DDRSS3_PI_160_DATA
			DDRSS3_PI_161_DATA
			DDRSS3_PI_162_DATA
			DDRSS3_PI_163_DATA
			DDRSS3_PI_164_DATA
			DDRSS3_PI_165_DATA
			DDRSS3_PI_166_DATA
			DDRSS3_PI_167_DATA
			DDRSS3_PI_168_DATA
			DDRSS3_PI_169_DATA
			DDRSS3_PI_170_DATA
			DDRSS3_PI_171_DATA
			DDRSS3_PI_172_DATA
			DDRSS3_PI_173_DATA
			DDRSS3_PI_174_DATA
			DDRSS3_PI_175_DATA
			DDRSS3_PI_176_DATA
			DDRSS3_PI_177_DATA
			DDRSS3_PI_178_DATA
			DDRSS3_PI_179_DATA
			DDRSS3_PI_180_DATA
			DDRSS3_PI_181_DATA
			DDRSS3_PI_182_DATA
			DDRSS3_PI_183_DATA
			DDRSS3_PI_184_DATA
			DDRSS3_PI_185_DATA
			DDRSS3_PI_186_DATA
			DDRSS3_PI_187_DATA
			DDRSS3_PI_188_DATA
			DDRSS3_PI_189_DATA
			DDRSS3_PI_190_DATA
			DDRSS3_PI_191_DATA
			DDRSS3_PI_192_DATA
			DDRSS3_PI_193_DATA
			DDRSS3_PI_194_DATA
			DDRSS3_PI_195_DATA
			DDRSS3_PI_196_DATA
			DDRSS3_PI_197_DATA
			DDRSS3_PI_198_DATA
			DDRSS3_PI_199_DATA
			DDRSS3_PI_200_DATA
			DDRSS3_PI_201_DATA
			DDRSS3_PI_202_DATA
			DDRSS3_PI_203_DATA
			DDRSS3_PI_204_DATA
			DDRSS3_PI_205_DATA
			DDRSS3_PI_206_DATA
			DDRSS3_PI_207_DATA
			DDRSS3_PI_208_DATA
			DDRSS3_PI_209_DATA
			DDRSS3_PI_210_DATA
			DDRSS3_PI_211_DATA
			DDRSS3_PI_212_DATA
			DDRSS3_PI_213_DATA
			DDRSS3_PI_214_DATA
			DDRSS3_PI_215_DATA
			DDRSS3_PI_216_DATA
			DDRSS3_PI_217_DATA
			DDRSS3_PI_218_DATA
			DDRSS3_PI_219_DATA
			DDRSS3_PI_220_DATA
			DDRSS3_PI_221_DATA
			DDRSS3_PI_222_DATA
			DDRSS3_PI_223_DATA
			DDRSS3_PI_224_DATA
			DDRSS3_PI_225_DATA
			DDRSS3_PI_226_DATA
			DDRSS3_PI_227_DATA
			DDRSS3_PI_228_DATA
			DDRSS3_PI_229_DATA
			DDRSS3_PI_230_DATA
			DDRSS3_PI_231_DATA
			DDRSS3_PI_232_DATA
			DDRSS3_PI_233_DATA
			DDRSS3_PI_234_DATA
			DDRSS3_PI_235_DATA
			DDRSS3_PI_236_DATA
			DDRSS3_PI_237_DATA
			DDRSS3_PI_238_DATA
			DDRSS3_PI_239_DATA
			DDRSS3_PI_240_DATA
			DDRSS3_PI_241_DATA
			DDRSS3_PI_242_DATA
			DDRSS3_PI_243_DATA
			DDRSS3_PI_244_DATA
			DDRSS3_PI_245_DATA
			DDRSS3_PI_246_DATA
			DDRSS3_PI_247_DATA
			DDRSS3_PI_248_DATA
			DDRSS3_PI_249_DATA
			DDRSS3_PI_250_DATA
			DDRSS3_PI_251_DATA
			DDRSS3_PI_252_DATA
			DDRSS3_PI_253_DATA
			DDRSS3_PI_254_DATA
			DDRSS3_PI_255_DATA
			DDRSS3_PI_256_DATA
			DDRSS3_PI_257_DATA
			DDRSS3_PI_258_DATA
			DDRSS3_PI_259_DATA
			DDRSS3_PI_260_DATA
			DDRSS3_PI_261_DATA
			DDRSS3_PI_262_DATA
			DDRSS3_PI_263_DATA
			DDRSS3_PI_264_DATA
			DDRSS3_PI_265_DATA
			DDRSS3_PI_266_DATA
			DDRSS3_PI_267_DATA
			DDRSS3_PI_268_DATA
			DDRSS3_PI_269_DATA
			DDRSS3_PI_270_DATA
			DDRSS3_PI_271_DATA
			DDRSS3_PI_272_DATA
			DDRSS3_PI_273_DATA
			DDRSS3_PI_274_DATA
			DDRSS3_PI_275_DATA
			DDRSS3_PI_276_DATA
			DDRSS3_PI_277_DATA
			DDRSS3_PI_278_DATA
			DDRSS3_PI_279_DATA
			DDRSS3_PI_280_DATA
			DDRSS3_PI_281_DATA
			DDRSS3_PI_282_DATA
			DDRSS3_PI_283_DATA
			DDRSS3_PI_284_DATA
			DDRSS3_PI_285_DATA
			DDRSS3_PI_286_DATA
			DDRSS3_PI_287_DATA
			DDRSS3_PI_288_DATA
			DDRSS3_PI_289_DATA
			DDRSS3_PI_290_DATA
			DDRSS3_PI_291_DATA
			DDRSS3_PI_292_DATA
			DDRSS3_PI_293_DATA
			DDRSS3_PI_294_DATA
			DDRSS3_PI_295_DATA
			DDRSS3_PI_296_DATA
			DDRSS3_PI_297_DATA
			DDRSS3_PI_298_DATA
			DDRSS3_PI_299_DATA
		>;

		ti,phy-data = <
			DDRSS3_PHY_00_DATA
			DDRSS3_PHY_01_DATA
			DDRSS3_PHY_02_DATA
			DDRSS3_PHY_03_DATA
			DDRSS3_PHY_04_DATA
			DDRSS3_PHY_05_DATA
			DDRSS3_PHY_06_DATA
			DDRSS3_PHY_07_DATA
			DDRSS3_PHY_08_DATA
			DDRSS3_PHY_09_DATA
			DDRSS3_PHY_10_DATA
			DDRSS3_PHY_11_DATA
			DDRSS3_PHY_12_DATA
			DDRSS3_PHY_13_DATA
			DDRSS3_PHY_14_DATA
			DDRSS3_PHY_15_DATA
			DDRSS3_PHY_16_DATA
			DDRSS3_PHY_17_DATA
			DDRSS3_PHY_18_DATA
			DDRSS3_PHY_19_DATA
			DDRSS3_PHY_20_DATA
			DDRSS3_PHY_21_DATA
			DDRSS3_PHY_22_DATA
			DDRSS3_PHY_23_DATA
			DDRSS3_PHY_24_DATA
			DDRSS3_PHY_25_DATA
			DDRSS3_PHY_26_DATA
			DDRSS3_PHY_27_DATA
			DDRSS3_PHY_28_DATA
			DDRSS3_PHY_29_DATA
			DDRSS3_PHY_30_DATA
			DDRSS3_PHY_31_DATA
			DDRSS3_PHY_32_DATA
			DDRSS3_PHY_33_DATA
			DDRSS3_PHY_34_DATA
			DDRSS3_PHY_35_DATA
			DDRSS3_PHY_36_DATA
			DDRSS3_PHY_37_DATA
			DDRSS3_PHY_38_DATA
			DDRSS3_PHY_39_DATA
			DDRSS3_PHY_40_DATA
			DDRSS3_PHY_41_DATA
			DDRSS3_PHY_42_DATA
			DDRSS3_PHY_43_DATA
			DDRSS3_PHY_44_DATA
			DDRSS3_PHY_45_DATA
			DDRSS3_PHY_46_DATA
			DDRSS3_PHY_47_DATA
			DDRSS3_PHY_48_DATA
			DDRSS3_PHY_49_DATA
			DDRSS3_PHY_50_DATA
			DDRSS3_PHY_51_DATA
			DDRSS3_PHY_52_DATA
			DDRSS3_PHY_53_DATA
			DDRSS3_PHY_54_DATA
			DDRSS3_PHY_55_DATA
			DDRSS3_PHY_56_DATA
			DDRSS3_PHY_57_DATA
			DDRSS3_PHY_58_DATA
			DDRSS3_PHY_59_DATA
			DDRSS3_PHY_60_DATA
			DDRSS3_PHY_61_DATA
			DDRSS3_PHY_62_DATA
			DDRSS3_PHY_63_DATA
			DDRSS3_PHY_64_DATA
			DDRSS3_PHY_65_DATA
			DDRSS3_PHY_66_DATA
			DDRSS3_PHY_67_DATA
			DDRSS3_PHY_68_DATA
			DDRSS3_PHY_69_DATA
			DDRSS3_PHY_70_DATA
			DDRSS3_PHY_71_DATA
			DDRSS3_PHY_72_DATA
			DDRSS3_PHY_73_DATA
			DDRSS3_PHY_74_DATA
			DDRSS3_PHY_75_DATA
			DDRSS3_PHY_76_DATA
			DDRSS3_PHY_77_DATA
			DDRSS3_PHY_78_DATA
			DDRSS3_PHY_79_DATA
			DDRSS3_PHY_80_DATA
			DDRSS3_PHY_81_DATA
			DDRSS3_PHY_82_DATA
			DDRSS3_PHY_83_DATA
			DDRSS3_PHY_84_DATA
			DDRSS3_PHY_85_DATA
			DDRSS3_PHY_86_DATA
			DDRSS3_PHY_87_DATA
			DDRSS3_PHY_88_DATA
			DDRSS3_PHY_89_DATA
			DDRSS3_PHY_90_DATA
			DDRSS3_PHY_91_DATA
			DDRSS3_PHY_92_DATA
			DDRSS3_PHY_93_DATA
			DDRSS3_PHY_94_DATA
			DDRSS3_PHY_95_DATA
			DDRSS3_PHY_96_DATA
			DDRSS3_PHY_97_DATA
			DDRSS3_PHY_98_DATA
			DDRSS3_PHY_99_DATA
			DDRSS3_PHY_100_DATA
			DDRSS3_PHY_101_DATA
			DDRSS3_PHY_102_DATA
			DDRSS3_PHY_103_DATA
			DDRSS3_PHY_104_DATA
			DDRSS3_PHY_105_DATA
			DDRSS3_PHY_106_DATA
			DDRSS3_PHY_107_DATA
			DDRSS3_PHY_108_DATA
			DDRSS3_PHY_109_DATA
			DDRSS3_PHY_110_DATA
			DDRSS3_PHY_111_DATA
			DDRSS3_PHY_112_DATA
			DDRSS3_PHY_113_DATA
			DDRSS3_PHY_114_DATA
			DDRSS3_PHY_115_DATA
			DDRSS3_PHY_116_DATA
			DDRSS3_PHY_117_DATA
			DDRSS3_PHY_118_DATA
			DDRSS3_PHY_119_DATA
			DDRSS3_PHY_120_DATA
			DDRSS3_PHY_121_DATA
			DDRSS3_PHY_122_DATA
			DDRSS3_PHY_123_DATA
			DDRSS3_PHY_124_DATA
			DDRSS3_PHY_125_DATA
			DDRSS3_PHY_126_DATA
			DDRSS3_PHY_127_DATA
			DDRSS3_PHY_128_DATA
			DDRSS3_PHY_129_DATA
			DDRSS3_PHY_130_DATA
			DDRSS3_PHY_131_DATA
			DDRSS3_PHY_132_DATA
			DDRSS3_PHY_133_DATA
			DDRSS3_PHY_134_DATA
			DDRSS3_PHY_135_DATA
			DDRSS3_PHY_136_DATA
			DDRSS3_PHY_137_DATA
			DDRSS3_PHY_138_DATA
			DDRSS3_PHY_139_DATA
			DDRSS3_PHY_140_DATA
			DDRSS3_PHY_141_DATA
			DDRSS3_PHY_142_DATA
			DDRSS3_PHY_143_DATA
			DDRSS3_PHY_144_DATA
			DDRSS3_PHY_145_DATA
			DDRSS3_PHY_146_DATA
			DDRSS3_PHY_147_DATA
			DDRSS3_PHY_148_DATA
			DDRSS3_PHY_149_DATA
			DDRSS3_PHY_150_DATA
			DDRSS3_PHY_151_DATA
			DDRSS3_PHY_152_DATA
			DDRSS3_PHY_153_DATA
			DDRSS3_PHY_154_DATA
			DDRSS3_PHY_155_DATA
			DDRSS3_PHY_156_DATA
			DDRSS3_PHY_157_DATA
			DDRSS3_PHY_158_DATA
			DDRSS3_PHY_159_DATA
			DDRSS3_PHY_160_DATA
			DDRSS3_PHY_161_DATA
			DDRSS3_PHY_162_DATA
			DDRSS3_PHY_163_DATA
			DDRSS3_PHY_164_DATA
			DDRSS3_PHY_165_DATA
			DDRSS3_PHY_166_DATA
			DDRSS3_PHY_167_DATA
			DDRSS3_PHY_168_DATA
			DDRSS3_PHY_169_DATA
			DDRSS3_PHY_170_DATA
			DDRSS3_PHY_171_DATA
			DDRSS3_PHY_172_DATA
			DDRSS3_PHY_173_DATA
			DDRSS3_PHY_174_DATA
			DDRSS3_PHY_175_DATA
			DDRSS3_PHY_176_DATA
			DDRSS3_PHY_177_DATA
			DDRSS3_PHY_178_DATA
			DDRSS3_PHY_179_DATA
			DDRSS3_PHY_180_DATA
			DDRSS3_PHY_181_DATA
			DDRSS3_PHY_182_DATA
			DDRSS3_PHY_183_DATA
			DDRSS3_PHY_184_DATA
			DDRSS3_PHY_185_DATA
			DDRSS3_PHY_186_DATA
			DDRSS3_PHY_187_DATA
			DDRSS3_PHY_188_DATA
			DDRSS3_PHY_189_DATA
			DDRSS3_PHY_190_DATA
			DDRSS3_PHY_191_DATA
			DDRSS3_PHY_192_DATA
			DDRSS3_PHY_193_DATA
			DDRSS3_PHY_194_DATA
			DDRSS3_PHY_195_DATA
			DDRSS3_PHY_196_DATA
			DDRSS3_PHY_197_DATA
			DDRSS3_PHY_198_DATA
			DDRSS3_PHY_199_DATA
			DDRSS3_PHY_200_DATA
			DDRSS3_PHY_201_DATA
			DDRSS3_PHY_202_DATA
			DDRSS3_PHY_203_DATA
			DDRSS3_PHY_204_DATA
			DDRSS3_PHY_205_DATA
			DDRSS3_PHY_206_DATA
			DDRSS3_PHY_207_DATA
			DDRSS3_PHY_208_DATA
			DDRSS3_PHY_209_DATA
			DDRSS3_PHY_210_DATA
			DDRSS3_PHY_211_DATA
			DDRSS3_PHY_212_DATA
			DDRSS3_PHY_213_DATA
			DDRSS3_PHY_214_DATA
			DDRSS3_PHY_215_DATA
			DDRSS3_PHY_216_DATA
			DDRSS3_PHY_217_DATA
			DDRSS3_PHY_218_DATA
			DDRSS3_PHY_219_DATA
			DDRSS3_PHY_220_DATA
			DDRSS3_PHY_221_DATA
			DDRSS3_PHY_222_DATA
			DDRSS3_PHY_223_DATA
			DDRSS3_PHY_224_DATA
			DDRSS3_PHY_225_DATA
			DDRSS3_PHY_226_DATA
			DDRSS3_PHY_227_DATA
			DDRSS3_PHY_228_DATA
			DDRSS3_PHY_229_DATA
			DDRSS3_PHY_230_DATA
			DDRSS3_PHY_231_DATA
			DDRSS3_PHY_232_DATA
			DDRSS3_PHY_233_DATA
			DDRSS3_PHY_234_DATA
			DDRSS3_PHY_235_DATA
			DDRSS3_PHY_236_DATA
			DDRSS3_PHY_237_DATA
			DDRSS3_PHY_238_DATA
			DDRSS3_PHY_239_DATA
			DDRSS3_PHY_240_DATA
			DDRSS3_PHY_241_DATA
			DDRSS3_PHY_242_DATA
			DDRSS3_PHY_243_DATA
			DDRSS3_PHY_244_DATA
			DDRSS3_PHY_245_DATA
			DDRSS3_PHY_246_DATA
			DDRSS3_PHY_247_DATA
			DDRSS3_PHY_248_DATA
			DDRSS3_PHY_249_DATA
			DDRSS3_PHY_250_DATA
			DDRSS3_PHY_251_DATA
			DDRSS3_PHY_252_DATA
			DDRSS3_PHY_253_DATA
			DDRSS3_PHY_254_DATA
			DDRSS3_PHY_255_DATA
			DDRSS3_PHY_256_DATA
			DDRSS3_PHY_257_DATA
			DDRSS3_PHY_258_DATA
			DDRSS3_PHY_259_DATA
			DDRSS3_PHY_260_DATA
			DDRSS3_PHY_261_DATA
			DDRSS3_PHY_262_DATA
			DDRSS3_PHY_263_DATA
			DDRSS3_PHY_264_DATA
			DDRSS3_PHY_265_DATA
			DDRSS3_PHY_266_DATA
			DDRSS3_PHY_267_DATA
			DDRSS3_PHY_268_DATA
			DDRSS3_PHY_269_DATA
			DDRSS3_PHY_270_DATA
			DDRSS3_PHY_271_DATA
			DDRSS3_PHY_272_DATA
			DDRSS3_PHY_273_DATA
			DDRSS3_PHY_274_DATA
			DDRSS3_PHY_275_DATA
			DDRSS3_PHY_276_DATA
			DDRSS3_PHY_277_DATA
			DDRSS3_PHY_278_DATA
			DDRSS3_PHY_279_DATA
			DDRSS3_PHY_280_DATA
			DDRSS3_PHY_281_DATA
			DDRSS3_PHY_282_DATA
			DDRSS3_PHY_283_DATA
			DDRSS3_PHY_284_DATA
			DDRSS3_PHY_285_DATA
			DDRSS3_PHY_286_DATA
			DDRSS3_PHY_287_DATA
			DDRSS3_PHY_288_DATA
			DDRSS3_PHY_289_DATA
			DDRSS3_PHY_290_DATA
			DDRSS3_PHY_291_DATA
			DDRSS3_PHY_292_DATA
			DDRSS3_PHY_293_DATA
			DDRSS3_PHY_294_DATA
			DDRSS3_PHY_295_DATA
			DDRSS3_PHY_296_DATA
			DDRSS3_PHY_297_DATA
			DDRSS3_PHY_298_DATA
			DDRSS3_PHY_299_DATA
			DDRSS3_PHY_300_DATA
			DDRSS3_PHY_301_DATA
			DDRSS3_PHY_302_DATA
			DDRSS3_PHY_303_DATA
			DDRSS3_PHY_304_DATA
			DDRSS3_PHY_305_DATA
			DDRSS3_PHY_306_DATA
			DDRSS3_PHY_307_DATA
			DDRSS3_PHY_308_DATA
			DDRSS3_PHY_309_DATA
			DDRSS3_PHY_310_DATA
			DDRSS3_PHY_311_DATA
			DDRSS3_PHY_312_DATA
			DDRSS3_PHY_313_DATA
			DDRSS3_PHY_314_DATA
			DDRSS3_PHY_315_DATA
			DDRSS3_PHY_316_DATA
			DDRSS3_PHY_317_DATA
			DDRSS3_PHY_318_DATA
			DDRSS3_PHY_319_DATA
			DDRSS3_PHY_320_DATA
			DDRSS3_PHY_321_DATA
			DDRSS3_PHY_322_DATA
			DDRSS3_PHY_323_DATA
			DDRSS3_PHY_324_DATA
			DDRSS3_PHY_325_DATA
			DDRSS3_PHY_326_DATA
			DDRSS3_PHY_327_DATA
			DDRSS3_PHY_328_DATA
			DDRSS3_PHY_329_DATA
			DDRSS3_PHY_330_DATA
			DDRSS3_PHY_331_DATA
			DDRSS3_PHY_332_DATA
			DDRSS3_PHY_333_DATA
			DDRSS3_PHY_334_DATA
			DDRSS3_PHY_335_DATA
			DDRSS3_PHY_336_DATA
			DDRSS3_PHY_337_DATA
			DDRSS3_PHY_338_DATA
			DDRSS3_PHY_339_DATA
			DDRSS3_PHY_340_DATA
			DDRSS3_PHY_341_DATA
			DDRSS3_PHY_342_DATA
			DDRSS3_PHY_343_DATA
			DDRSS3_PHY_344_DATA
			DDRSS3_PHY_345_DATA
			DDRSS3_PHY_346_DATA
			DDRSS3_PHY_347_DATA
			DDRSS3_PHY_348_DATA
			DDRSS3_PHY_349_DATA
			DDRSS3_PHY_350_DATA
			DDRSS3_PHY_351_DATA
			DDRSS3_PHY_352_DATA
			DDRSS3_PHY_353_DATA
			DDRSS3_PHY_354_DATA
			DDRSS3_PHY_355_DATA
			DDRSS3_PHY_356_DATA
			DDRSS3_PHY_357_DATA
			DDRSS3_PHY_358_DATA
			DDRSS3_PHY_359_DATA
			DDRSS3_PHY_360_DATA
			DDRSS3_PHY_361_DATA
			DDRSS3_PHY_362_DATA
			DDRSS3_PHY_363_DATA
			DDRSS3_PHY_364_DATA
			DDRSS3_PHY_365_DATA
			DDRSS3_PHY_366_DATA
			DDRSS3_PHY_367_DATA
			DDRSS3_PHY_368_DATA
			DDRSS3_PHY_369_DATA
			DDRSS3_PHY_370_DATA
			DDRSS3_PHY_371_DATA
			DDRSS3_PHY_372_DATA
			DDRSS3_PHY_373_DATA
			DDRSS3_PHY_374_DATA
			DDRSS3_PHY_375_DATA
			DDRSS3_PHY_376_DATA
			DDRSS3_PHY_377_DATA
			DDRSS3_PHY_378_DATA
			DDRSS3_PHY_379_DATA
			DDRSS3_PHY_380_DATA
			DDRSS3_PHY_381_DATA
			DDRSS3_PHY_382_DATA
			DDRSS3_PHY_383_DATA
			DDRSS3_PHY_384_DATA
			DDRSS3_PHY_385_DATA
			DDRSS3_PHY_386_DATA
			DDRSS3_PHY_387_DATA
			DDRSS3_PHY_388_DATA
			DDRSS3_PHY_389_DATA
			DDRSS3_PHY_390_DATA
			DDRSS3_PHY_391_DATA
			DDRSS3_PHY_392_DATA
			DDRSS3_PHY_393_DATA
			DDRSS3_PHY_394_DATA
			DDRSS3_PHY_395_DATA
			DDRSS3_PHY_396_DATA
			DDRSS3_PHY_397_DATA
			DDRSS3_PHY_398_DATA
			DDRSS3_PHY_399_DATA
			DDRSS3_PHY_400_DATA
			DDRSS3_PHY_401_DATA
			DDRSS3_PHY_402_DATA
			DDRSS3_PHY_403_DATA
			DDRSS3_PHY_404_DATA
			DDRSS3_PHY_405_DATA
			DDRSS3_PHY_406_DATA
			DDRSS3_PHY_407_DATA
			DDRSS3_PHY_408_DATA
			DDRSS3_PHY_409_DATA
			DDRSS3_PHY_410_DATA
			DDRSS3_PHY_411_DATA
			DDRSS3_PHY_412_DATA
			DDRSS3_PHY_413_DATA
			DDRSS3_PHY_414_DATA
			DDRSS3_PHY_415_DATA
			DDRSS3_PHY_416_DATA
			DDRSS3_PHY_417_DATA
			DDRSS3_PHY_418_DATA
			DDRSS3_PHY_419_DATA
			DDRSS3_PHY_420_DATA
			DDRSS3_PHY_421_DATA
			DDRSS3_PHY_422_DATA
			DDRSS3_PHY_423_DATA
			DDRSS3_PHY_424_DATA
			DDRSS3_PHY_425_DATA
			DDRSS3_PHY_426_DATA
			DDRSS3_PHY_427_DATA
			DDRSS3_PHY_428_DATA
			DDRSS3_PHY_429_DATA
			DDRSS3_PHY_430_DATA
			DDRSS3_PHY_431_DATA
			DDRSS3_PHY_432_DATA
			DDRSS3_PHY_433_DATA
			DDRSS3_PHY_434_DATA
			DDRSS3_PHY_435_DATA
			DDRSS3_PHY_436_DATA
			DDRSS3_PHY_437_DATA
			DDRSS3_PHY_438_DATA
			DDRSS3_PHY_439_DATA
			DDRSS3_PHY_440_DATA
			DDRSS3_PHY_441_DATA
			DDRSS3_PHY_442_DATA
			DDRSS3_PHY_443_DATA
			DDRSS3_PHY_444_DATA
			DDRSS3_PHY_445_DATA
			DDRSS3_PHY_446_DATA
			DDRSS3_PHY_447_DATA
			DDRSS3_PHY_448_DATA
			DDRSS3_PHY_449_DATA
			DDRSS3_PHY_450_DATA
			DDRSS3_PHY_451_DATA
			DDRSS3_PHY_452_DATA
			DDRSS3_PHY_453_DATA
			DDRSS3_PHY_454_DATA
			DDRSS3_PHY_455_DATA
			DDRSS3_PHY_456_DATA
			DDRSS3_PHY_457_DATA
			DDRSS3_PHY_458_DATA
			DDRSS3_PHY_459_DATA
			DDRSS3_PHY_460_DATA
			DDRSS3_PHY_461_DATA
			DDRSS3_PHY_462_DATA
			DDRSS3_PHY_463_DATA
			DDRSS3_PHY_464_DATA
			DDRSS3_PHY_465_DATA
			DDRSS3_PHY_466_DATA
			DDRSS3_PHY_467_DATA
			DDRSS3_PHY_468_DATA
			DDRSS3_PHY_469_DATA
			DDRSS3_PHY_470_DATA
			DDRSS3_PHY_471_DATA
			DDRSS3_PHY_472_DATA
			DDRSS3_PHY_473_DATA
			DDRSS3_PHY_474_DATA
			DDRSS3_PHY_475_DATA
			DDRSS3_PHY_476_DATA
			DDRSS3_PHY_477_DATA
			DDRSS3_PHY_478_DATA
			DDRSS3_PHY_479_DATA
			DDRSS3_PHY_480_DATA
			DDRSS3_PHY_481_DATA
			DDRSS3_PHY_482_DATA
			DDRSS3_PHY_483_DATA
			DDRSS3_PHY_484_DATA
			DDRSS3_PHY_485_DATA
			DDRSS3_PHY_486_DATA
			DDRSS3_PHY_487_DATA
			DDRSS3_PHY_488_DATA
			DDRSS3_PHY_489_DATA
			DDRSS3_PHY_490_DATA
			DDRSS3_PHY_491_DATA
			DDRSS3_PHY_492_DATA
			DDRSS3_PHY_493_DATA
			DDRSS3_PHY_494_DATA
			DDRSS3_PHY_495_DATA
			DDRSS3_PHY_496_DATA
			DDRSS3_PHY_497_DATA
			DDRSS3_PHY_498_DATA
			DDRSS3_PHY_499_DATA
			DDRSS3_PHY_500_DATA
			DDRSS3_PHY_501_DATA
			DDRSS3_PHY_502_DATA
			DDRSS3_PHY_503_DATA
			DDRSS3_PHY_504_DATA
			DDRSS3_PHY_505_DATA
			DDRSS3_PHY_506_DATA
			DDRSS3_PHY_507_DATA
			DDRSS3_PHY_508_DATA
			DDRSS3_PHY_509_DATA
			DDRSS3_PHY_510_DATA
			DDRSS3_PHY_511_DATA
			DDRSS3_PHY_512_DATA
			DDRSS3_PHY_513_DATA
			DDRSS3_PHY_514_DATA
			DDRSS3_PHY_515_DATA
			DDRSS3_PHY_516_DATA
			DDRSS3_PHY_517_DATA
			DDRSS3_PHY_518_DATA
			DDRSS3_PHY_519_DATA
			DDRSS3_PHY_520_DATA
			DDRSS3_PHY_521_DATA
			DDRSS3_PHY_522_DATA
			DDRSS3_PHY_523_DATA
			DDRSS3_PHY_524_DATA
			DDRSS3_PHY_525_DATA
			DDRSS3_PHY_526_DATA
			DDRSS3_PHY_527_DATA
			DDRSS3_PHY_528_DATA
			DDRSS3_PHY_529_DATA
			DDRSS3_PHY_530_DATA
			DDRSS3_PHY_531_DATA
			DDRSS3_PHY_532_DATA
			DDRSS3_PHY_533_DATA
			DDRSS3_PHY_534_DATA
			DDRSS3_PHY_535_DATA
			DDRSS3_PHY_536_DATA
			DDRSS3_PHY_537_DATA
			DDRSS3_PHY_538_DATA
			DDRSS3_PHY_539_DATA
			DDRSS3_PHY_540_DATA
			DDRSS3_PHY_541_DATA
			DDRSS3_PHY_542_DATA
			DDRSS3_PHY_543_DATA
			DDRSS3_PHY_544_DATA
			DDRSS3_PHY_545_DATA
			DDRSS3_PHY_546_DATA
			DDRSS3_PHY_547_DATA
			DDRSS3_PHY_548_DATA
			DDRSS3_PHY_549_DATA
			DDRSS3_PHY_550_DATA
			DDRSS3_PHY_551_DATA
			DDRSS3_PHY_552_DATA
			DDRSS3_PHY_553_DATA
			DDRSS3_PHY_554_DATA
			DDRSS3_PHY_555_DATA
			DDRSS3_PHY_556_DATA
			DDRSS3_PHY_557_DATA
			DDRSS3_PHY_558_DATA
			DDRSS3_PHY_559_DATA
			DDRSS3_PHY_560_DATA
			DDRSS3_PHY_561_DATA
			DDRSS3_PHY_562_DATA
			DDRSS3_PHY_563_DATA
			DDRSS3_PHY_564_DATA
			DDRSS3_PHY_565_DATA
			DDRSS3_PHY_566_DATA
			DDRSS3_PHY_567_DATA
			DDRSS3_PHY_568_DATA
			DDRSS3_PHY_569_DATA
			DDRSS3_PHY_570_DATA
			DDRSS3_PHY_571_DATA
			DDRSS3_PHY_572_DATA
			DDRSS3_PHY_573_DATA
			DDRSS3_PHY_574_DATA
			DDRSS3_PHY_575_DATA
			DDRSS3_PHY_576_DATA
			DDRSS3_PHY_577_DATA
			DDRSS3_PHY_578_DATA
			DDRSS3_PHY_579_DATA
			DDRSS3_PHY_580_DATA
			DDRSS3_PHY_581_DATA
			DDRSS3_PHY_582_DATA
			DDRSS3_PHY_583_DATA
			DDRSS3_PHY_584_DATA
			DDRSS3_PHY_585_DATA
			DDRSS3_PHY_586_DATA
			DDRSS3_PHY_587_DATA
			DDRSS3_PHY_588_DATA
			DDRSS3_PHY_589_DATA
			DDRSS3_PHY_590_DATA
			DDRSS3_PHY_591_DATA
			DDRSS3_PHY_592_DATA
			DDRSS3_PHY_593_DATA
			DDRSS3_PHY_594_DATA
			DDRSS3_PHY_595_DATA
			DDRSS3_PHY_596_DATA
			DDRSS3_PHY_597_DATA
			DDRSS3_PHY_598_DATA
			DDRSS3_PHY_599_DATA
			DDRSS3_PHY_600_DATA
			DDRSS3_PHY_601_DATA
			DDRSS3_PHY_602_DATA
			DDRSS3_PHY_603_DATA
			DDRSS3_PHY_604_DATA
			DDRSS3_PHY_605_DATA
			DDRSS3_PHY_606_DATA
			DDRSS3_PHY_607_DATA
			DDRSS3_PHY_608_DATA
			DDRSS3_PHY_609_DATA
			DDRSS3_PHY_610_DATA
			DDRSS3_PHY_611_DATA
			DDRSS3_PHY_612_DATA
			DDRSS3_PHY_613_DATA
			DDRSS3_PHY_614_DATA
			DDRSS3_PHY_615_DATA
			DDRSS3_PHY_616_DATA
			DDRSS3_PHY_617_DATA
			DDRSS3_PHY_618_DATA
			DDRSS3_PHY_619_DATA
			DDRSS3_PHY_620_DATA
			DDRSS3_PHY_621_DATA
			DDRSS3_PHY_622_DATA
			DDRSS3_PHY_623_DATA
			DDRSS3_PHY_624_DATA
			DDRSS3_PHY_625_DATA
			DDRSS3_PHY_626_DATA
			DDRSS3_PHY_627_DATA
			DDRSS3_PHY_628_DATA
			DDRSS3_PHY_629_DATA
			DDRSS3_PHY_630_DATA
			DDRSS3_PHY_631_DATA
			DDRSS3_PHY_632_DATA
			DDRSS3_PHY_633_DATA
			DDRSS3_PHY_634_DATA
			DDRSS3_PHY_635_DATA
			DDRSS3_PHY_636_DATA
			DDRSS3_PHY_637_DATA
			DDRSS3_PHY_638_DATA
			DDRSS3_PHY_639_DATA
			DDRSS3_PHY_640_DATA
			DDRSS3_PHY_641_DATA
			DDRSS3_PHY_642_DATA
			DDRSS3_PHY_643_DATA
			DDRSS3_PHY_644_DATA
			DDRSS3_PHY_645_DATA
			DDRSS3_PHY_646_DATA
			DDRSS3_PHY_647_DATA
			DDRSS3_PHY_648_DATA
			DDRSS3_PHY_649_DATA
			DDRSS3_PHY_650_DATA
			DDRSS3_PHY_651_DATA
			DDRSS3_PHY_652_DATA
			DDRSS3_PHY_653_DATA
			DDRSS3_PHY_654_DATA
			DDRSS3_PHY_655_DATA
			DDRSS3_PHY_656_DATA
			DDRSS3_PHY_657_DATA
			DDRSS3_PHY_658_DATA
			DDRSS3_PHY_659_DATA
			DDRSS3_PHY_660_DATA
			DDRSS3_PHY_661_DATA
			DDRSS3_PHY_662_DATA
			DDRSS3_PHY_663_DATA
			DDRSS3_PHY_664_DATA
			DDRSS3_PHY_665_DATA
			DDRSS3_PHY_666_DATA
			DDRSS3_PHY_667_DATA
			DDRSS3_PHY_668_DATA
			DDRSS3_PHY_669_DATA
			DDRSS3_PHY_670_DATA
			DDRSS3_PHY_671_DATA
			DDRSS3_PHY_672_DATA
			DDRSS3_PHY_673_DATA
			DDRSS3_PHY_674_DATA
			DDRSS3_PHY_675_DATA
			DDRSS3_PHY_676_DATA
			DDRSS3_PHY_677_DATA
			DDRSS3_PHY_678_DATA
			DDRSS3_PHY_679_DATA
			DDRSS3_PHY_680_DATA
			DDRSS3_PHY_681_DATA
			DDRSS3_PHY_682_DATA
			DDRSS3_PHY_683_DATA
			DDRSS3_PHY_684_DATA
			DDRSS3_PHY_685_DATA
			DDRSS3_PHY_686_DATA
			DDRSS3_PHY_687_DATA
			DDRSS3_PHY_688_DATA
			DDRSS3_PHY_689_DATA
			DDRSS3_PHY_690_DATA
			DDRSS3_PHY_691_DATA
			DDRSS3_PHY_692_DATA
			DDRSS3_PHY_693_DATA
			DDRSS3_PHY_694_DATA
			DDRSS3_PHY_695_DATA
			DDRSS3_PHY_696_DATA
			DDRSS3_PHY_697_DATA
			DDRSS3_PHY_698_DATA
			DDRSS3_PHY_699_DATA
			DDRSS3_PHY_700_DATA
			DDRSS3_PHY_701_DATA
			DDRSS3_PHY_702_DATA
			DDRSS3_PHY_703_DATA
			DDRSS3_PHY_704_DATA
			DDRSS3_PHY_705_DATA
			DDRSS3_PHY_706_DATA
			DDRSS3_PHY_707_DATA
			DDRSS3_PHY_708_DATA
			DDRSS3_PHY_709_DATA
			DDRSS3_PHY_710_DATA
			DDRSS3_PHY_711_DATA
			DDRSS3_PHY_712_DATA
			DDRSS3_PHY_713_DATA
			DDRSS3_PHY_714_DATA
			DDRSS3_PHY_715_DATA
			DDRSS3_PHY_716_DATA
			DDRSS3_PHY_717_DATA
			DDRSS3_PHY_718_DATA
			DDRSS3_PHY_719_DATA
			DDRSS3_PHY_720_DATA
			DDRSS3_PHY_721_DATA
			DDRSS3_PHY_722_DATA
			DDRSS3_PHY_723_DATA
			DDRSS3_PHY_724_DATA
			DDRSS3_PHY_725_DATA
			DDRSS3_PHY_726_DATA
			DDRSS3_PHY_727_DATA
			DDRSS3_PHY_728_DATA
			DDRSS3_PHY_729_DATA
			DDRSS3_PHY_730_DATA
			DDRSS3_PHY_731_DATA
			DDRSS3_PHY_732_DATA
			DDRSS3_PHY_733_DATA
			DDRSS3_PHY_734_DATA
			DDRSS3_PHY_735_DATA
			DDRSS3_PHY_736_DATA
			DDRSS3_PHY_737_DATA
			DDRSS3_PHY_738_DATA
			DDRSS3_PHY_739_DATA
			DDRSS3_PHY_740_DATA
			DDRSS3_PHY_741_DATA
			DDRSS3_PHY_742_DATA
			DDRSS3_PHY_743_DATA
			DDRSS3_PHY_744_DATA
			DDRSS3_PHY_745_DATA
			DDRSS3_PHY_746_DATA
			DDRSS3_PHY_747_DATA
			DDRSS3_PHY_748_DATA
			DDRSS3_PHY_749_DATA
			DDRSS3_PHY_750_DATA
			DDRSS3_PHY_751_DATA
			DDRSS3_PHY_752_DATA
			DDRSS3_PHY_753_DATA
			DDRSS3_PHY_754_DATA
			DDRSS3_PHY_755_DATA
			DDRSS3_PHY_756_DATA
			DDRSS3_PHY_757_DATA
			DDRSS3_PHY_758_DATA
			DDRSS3_PHY_759_DATA
			DDRSS3_PHY_760_DATA
			DDRSS3_PHY_761_DATA
			DDRSS3_PHY_762_DATA
			DDRSS3_PHY_763_DATA
			DDRSS3_PHY_764_DATA
			DDRSS3_PHY_765_DATA
			DDRSS3_PHY_766_DATA
			DDRSS3_PHY_767_DATA
			DDRSS3_PHY_768_DATA
			DDRSS3_PHY_769_DATA
			DDRSS3_PHY_770_DATA
			DDRSS3_PHY_771_DATA
			DDRSS3_PHY_772_DATA
			DDRSS3_PHY_773_DATA
			DDRSS3_PHY_774_DATA
			DDRSS3_PHY_775_DATA
			DDRSS3_PHY_776_DATA
			DDRSS3_PHY_777_DATA
			DDRSS3_PHY_778_DATA
			DDRSS3_PHY_779_DATA
			DDRSS3_PHY_780_DATA
			DDRSS3_PHY_781_DATA
			DDRSS3_PHY_782_DATA
			DDRSS3_PHY_783_DATA
			DDRSS3_PHY_784_DATA
			DDRSS3_PHY_785_DATA
			DDRSS3_PHY_786_DATA
			DDRSS3_PHY_787_DATA
			DDRSS3_PHY_788_DATA
			DDRSS3_PHY_789_DATA
			DDRSS3_PHY_790_DATA
			DDRSS3_PHY_791_DATA
			DDRSS3_PHY_792_DATA
			DDRSS3_PHY_793_DATA
			DDRSS3_PHY_794_DATA
			DDRSS3_PHY_795_DATA
			DDRSS3_PHY_796_DATA
			DDRSS3_PHY_797_DATA
			DDRSS3_PHY_798_DATA
			DDRSS3_PHY_799_DATA
			DDRSS3_PHY_800_DATA
			DDRSS3_PHY_801_DATA
			DDRSS3_PHY_802_DATA
			DDRSS3_PHY_803_DATA
			DDRSS3_PHY_804_DATA
			DDRSS3_PHY_805_DATA
			DDRSS3_PHY_806_DATA
			DDRSS3_PHY_807_DATA
			DDRSS3_PHY_808_DATA
			DDRSS3_PHY_809_DATA
			DDRSS3_PHY_810_DATA
			DDRSS3_PHY_811_DATA
			DDRSS3_PHY_812_DATA
			DDRSS3_PHY_813_DATA
			DDRSS3_PHY_814_DATA
			DDRSS3_PHY_815_DATA
			DDRSS3_PHY_816_DATA
			DDRSS3_PHY_817_DATA
			DDRSS3_PHY_818_DATA
			DDRSS3_PHY_819_DATA
			DDRSS3_PHY_820_DATA
			DDRSS3_PHY_821_DATA
			DDRSS3_PHY_822_DATA
			DDRSS3_PHY_823_DATA
			DDRSS3_PHY_824_DATA
			DDRSS3_PHY_825_DATA
			DDRSS3_PHY_826_DATA
			DDRSS3_PHY_827_DATA
			DDRSS3_PHY_828_DATA
			DDRSS3_PHY_829_DATA
			DDRSS3_PHY_830_DATA
			DDRSS3_PHY_831_DATA
			DDRSS3_PHY_832_DATA
			DDRSS3_PHY_833_DATA
			DDRSS3_PHY_834_DATA
			DDRSS3_PHY_835_DATA
			DDRSS3_PHY_836_DATA
			DDRSS3_PHY_837_DATA
			DDRSS3_PHY_838_DATA
			DDRSS3_PHY_839_DATA
			DDRSS3_PHY_840_DATA
			DDRSS3_PHY_841_DATA
			DDRSS3_PHY_842_DATA
			DDRSS3_PHY_843_DATA
			DDRSS3_PHY_844_DATA
			DDRSS3_PHY_845_DATA
			DDRSS3_PHY_846_DATA
			DDRSS3_PHY_847_DATA
			DDRSS3_PHY_848_DATA
			DDRSS3_PHY_849_DATA
			DDRSS3_PHY_850_DATA
			DDRSS3_PHY_851_DATA
			DDRSS3_PHY_852_DATA
			DDRSS3_PHY_853_DATA
			DDRSS3_PHY_854_DATA
			DDRSS3_PHY_855_DATA
			DDRSS3_PHY_856_DATA
			DDRSS3_PHY_857_DATA
			DDRSS3_PHY_858_DATA
			DDRSS3_PHY_859_DATA
			DDRSS3_PHY_860_DATA
			DDRSS3_PHY_861_DATA
			DDRSS3_PHY_862_DATA
			DDRSS3_PHY_863_DATA
			DDRSS3_PHY_864_DATA
			DDRSS3_PHY_865_DATA
			DDRSS3_PHY_866_DATA
			DDRSS3_PHY_867_DATA
			DDRSS3_PHY_868_DATA
			DDRSS3_PHY_869_DATA
			DDRSS3_PHY_870_DATA
			DDRSS3_PHY_871_DATA
			DDRSS3_PHY_872_DATA
			DDRSS3_PHY_873_DATA
			DDRSS3_PHY_874_DATA
			DDRSS3_PHY_875_DATA
			DDRSS3_PHY_876_DATA
			DDRSS3_PHY_877_DATA
			DDRSS3_PHY_878_DATA
			DDRSS3_PHY_879_DATA
			DDRSS3_PHY_880_DATA
			DDRSS3_PHY_881_DATA
			DDRSS3_PHY_882_DATA
			DDRSS3_PHY_883_DATA
			DDRSS3_PHY_884_DATA
			DDRSS3_PHY_885_DATA
			DDRSS3_PHY_886_DATA
			DDRSS3_PHY_887_DATA
			DDRSS3_PHY_888_DATA
			DDRSS3_PHY_889_DATA
			DDRSS3_PHY_890_DATA
			DDRSS3_PHY_891_DATA
			DDRSS3_PHY_892_DATA
			DDRSS3_PHY_893_DATA
			DDRSS3_PHY_894_DATA
			DDRSS3_PHY_895_DATA
			DDRSS3_PHY_896_DATA
			DDRSS3_PHY_897_DATA
			DDRSS3_PHY_898_DATA
			DDRSS3_PHY_899_DATA
			DDRSS3_PHY_900_DATA
			DDRSS3_PHY_901_DATA
			DDRSS3_PHY_902_DATA
			DDRSS3_PHY_903_DATA
			DDRSS3_PHY_904_DATA
			DDRSS3_PHY_905_DATA
			DDRSS3_PHY_906_DATA
			DDRSS3_PHY_907_DATA
			DDRSS3_PHY_908_DATA
			DDRSS3_PHY_909_DATA
			DDRSS3_PHY_910_DATA
			DDRSS3_PHY_911_DATA
			DDRSS3_PHY_912_DATA
			DDRSS3_PHY_913_DATA
			DDRSS3_PHY_914_DATA
			DDRSS3_PHY_915_DATA
			DDRSS3_PHY_916_DATA
			DDRSS3_PHY_917_DATA
			DDRSS3_PHY_918_DATA
			DDRSS3_PHY_919_DATA
			DDRSS3_PHY_920_DATA
			DDRSS3_PHY_921_DATA
			DDRSS3_PHY_922_DATA
			DDRSS3_PHY_923_DATA
			DDRSS3_PHY_924_DATA
			DDRSS3_PHY_925_DATA
			DDRSS3_PHY_926_DATA
			DDRSS3_PHY_927_DATA
			DDRSS3_PHY_928_DATA
			DDRSS3_PHY_929_DATA
			DDRSS3_PHY_930_DATA
			DDRSS3_PHY_931_DATA
			DDRSS3_PHY_932_DATA
			DDRSS3_PHY_933_DATA
			DDRSS3_PHY_934_DATA
			DDRSS3_PHY_935_DATA
			DDRSS3_PHY_936_DATA
			DDRSS3_PHY_937_DATA
			DDRSS3_PHY_938_DATA
			DDRSS3_PHY_939_DATA
			DDRSS3_PHY_940_DATA
			DDRSS3_PHY_941_DATA
			DDRSS3_PHY_942_DATA
			DDRSS3_PHY_943_DATA
			DDRSS3_PHY_944_DATA
			DDRSS3_PHY_945_DATA
			DDRSS3_PHY_946_DATA
			DDRSS3_PHY_947_DATA
			DDRSS3_PHY_948_DATA
			DDRSS3_PHY_949_DATA
			DDRSS3_PHY_950_DATA
			DDRSS3_PHY_951_DATA
			DDRSS3_PHY_952_DATA
			DDRSS3_PHY_953_DATA
			DDRSS3_PHY_954_DATA
			DDRSS3_PHY_955_DATA
			DDRSS3_PHY_956_DATA
			DDRSS3_PHY_957_DATA
			DDRSS3_PHY_958_DATA
			DDRSS3_PHY_959_DATA
			DDRSS3_PHY_960_DATA
			DDRSS3_PHY_961_DATA
			DDRSS3_PHY_962_DATA
			DDRSS3_PHY_963_DATA
			DDRSS3_PHY_964_DATA
			DDRSS3_PHY_965_DATA
			DDRSS3_PHY_966_DATA
			DDRSS3_PHY_967_DATA
			DDRSS3_PHY_968_DATA
			DDRSS3_PHY_969_DATA
			DDRSS3_PHY_970_DATA
			DDRSS3_PHY_971_DATA
			DDRSS3_PHY_972_DATA
			DDRSS3_PHY_973_DATA
			DDRSS3_PHY_974_DATA
			DDRSS3_PHY_975_DATA
			DDRSS3_PHY_976_DATA
			DDRSS3_PHY_977_DATA
			DDRSS3_PHY_978_DATA
			DDRSS3_PHY_979_DATA
			DDRSS3_PHY_980_DATA
			DDRSS3_PHY_981_DATA
			DDRSS3_PHY_982_DATA
			DDRSS3_PHY_983_DATA
			DDRSS3_PHY_984_DATA
			DDRSS3_PHY_985_DATA
			DDRSS3_PHY_986_DATA
			DDRSS3_PHY_987_DATA
			DDRSS3_PHY_988_DATA
			DDRSS3_PHY_989_DATA
			DDRSS3_PHY_990_DATA
			DDRSS3_PHY_991_DATA
			DDRSS3_PHY_992_DATA
			DDRSS3_PHY_993_DATA
			DDRSS3_PHY_994_DATA
			DDRSS3_PHY_995_DATA
			DDRSS3_PHY_996_DATA
			DDRSS3_PHY_997_DATA
			DDRSS3_PHY_998_DATA
			DDRSS3_PHY_999_DATA
			DDRSS3_PHY_1000_DATA
			DDRSS3_PHY_1001_DATA
			DDRSS3_PHY_1002_DATA
			DDRSS3_PHY_1003_DATA
			DDRSS3_PHY_1004_DATA
			DDRSS3_PHY_1005_DATA
			DDRSS3_PHY_1006_DATA
			DDRSS3_PHY_1007_DATA
			DDRSS3_PHY_1008_DATA
			DDRSS3_PHY_1009_DATA
			DDRSS3_PHY_1010_DATA
			DDRSS3_PHY_1011_DATA
			DDRSS3_PHY_1012_DATA
			DDRSS3_PHY_1013_DATA
			DDRSS3_PHY_1014_DATA
			DDRSS3_PHY_1015_DATA
			DDRSS3_PHY_1016_DATA
			DDRSS3_PHY_1017_DATA
			DDRSS3_PHY_1018_DATA
			DDRSS3_PHY_1019_DATA
			DDRSS3_PHY_1020_DATA
			DDRSS3_PHY_1021_DATA
			DDRSS3_PHY_1022_DATA
			DDRSS3_PHY_1023_DATA
			DDRSS3_PHY_1024_DATA
			DDRSS3_PHY_1025_DATA
			DDRSS3_PHY_1026_DATA
			DDRSS3_PHY_1027_DATA
			DDRSS3_PHY_1028_DATA
			DDRSS3_PHY_1029_DATA
			DDRSS3_PHY_1030_DATA
			DDRSS3_PHY_1031_DATA
			DDRSS3_PHY_1032_DATA
			DDRSS3_PHY_1033_DATA
			DDRSS3_PHY_1034_DATA
			DDRSS3_PHY_1035_DATA
			DDRSS3_PHY_1036_DATA
			DDRSS3_PHY_1037_DATA
			DDRSS3_PHY_1038_DATA
			DDRSS3_PHY_1039_DATA
			DDRSS3_PHY_1040_DATA
			DDRSS3_PHY_1041_DATA
			DDRSS3_PHY_1042_DATA
			DDRSS3_PHY_1043_DATA
			DDRSS3_PHY_1044_DATA
			DDRSS3_PHY_1045_DATA
			DDRSS3_PHY_1046_DATA
			DDRSS3_PHY_1047_DATA
			DDRSS3_PHY_1048_DATA
			DDRSS3_PHY_1049_DATA
			DDRSS3_PHY_1050_DATA
			DDRSS3_PHY_1051_DATA
			DDRSS3_PHY_1052_DATA
			DDRSS3_PHY_1053_DATA
			DDRSS3_PHY_1054_DATA
			DDRSS3_PHY_1055_DATA
			DDRSS3_PHY_1056_DATA
			DDRSS3_PHY_1057_DATA
			DDRSS3_PHY_1058_DATA
			DDRSS3_PHY_1059_DATA
			DDRSS3_PHY_1060_DATA
			DDRSS3_PHY_1061_DATA
			DDRSS3_PHY_1062_DATA
			DDRSS3_PHY_1063_DATA
			DDRSS3_PHY_1064_DATA
			DDRSS3_PHY_1065_DATA
			DDRSS3_PHY_1066_DATA
			DDRSS3_PHY_1067_DATA
			DDRSS3_PHY_1068_DATA
			DDRSS3_PHY_1069_DATA
			DDRSS3_PHY_1070_DATA
			DDRSS3_PHY_1071_DATA
			DDRSS3_PHY_1072_DATA
			DDRSS3_PHY_1073_DATA
			DDRSS3_PHY_1074_DATA
			DDRSS3_PHY_1075_DATA
			DDRSS3_PHY_1076_DATA
			DDRSS3_PHY_1077_DATA
			DDRSS3_PHY_1078_DATA
			DDRSS3_PHY_1079_DATA
			DDRSS3_PHY_1080_DATA
			DDRSS3_PHY_1081_DATA
			DDRSS3_PHY_1082_DATA
			DDRSS3_PHY_1083_DATA
			DDRSS3_PHY_1084_DATA
			DDRSS3_PHY_1085_DATA
			DDRSS3_PHY_1086_DATA
			DDRSS3_PHY_1087_DATA
			DDRSS3_PHY_1088_DATA
			DDRSS3_PHY_1089_DATA
			DDRSS3_PHY_1090_DATA
			DDRSS3_PHY_1091_DATA
			DDRSS3_PHY_1092_DATA
			DDRSS3_PHY_1093_DATA
			DDRSS3_PHY_1094_DATA
			DDRSS3_PHY_1095_DATA
			DDRSS3_PHY_1096_DATA
			DDRSS3_PHY_1097_DATA
			DDRSS3_PHY_1098_DATA
			DDRSS3_PHY_1099_DATA
			DDRSS3_PHY_1100_DATA
			DDRSS3_PHY_1101_DATA
			DDRSS3_PHY_1102_DATA
			DDRSS3_PHY_1103_DATA
			DDRSS3_PHY_1104_DATA
			DDRSS3_PHY_1105_DATA
			DDRSS3_PHY_1106_DATA
			DDRSS3_PHY_1107_DATA
			DDRSS3_PHY_1108_DATA
			DDRSS3_PHY_1109_DATA
			DDRSS3_PHY_1110_DATA
			DDRSS3_PHY_1111_DATA
			DDRSS3_PHY_1112_DATA
			DDRSS3_PHY_1113_DATA
			DDRSS3_PHY_1114_DATA
			DDRSS3_PHY_1115_DATA
			DDRSS3_PHY_1116_DATA
			DDRSS3_PHY_1117_DATA
			DDRSS3_PHY_1118_DATA
			DDRSS3_PHY_1119_DATA
			DDRSS3_PHY_1120_DATA
			DDRSS3_PHY_1121_DATA
			DDRSS3_PHY_1122_DATA
			DDRSS3_PHY_1123_DATA
			DDRSS3_PHY_1124_DATA
			DDRSS3_PHY_1125_DATA
			DDRSS3_PHY_1126_DATA
			DDRSS3_PHY_1127_DATA
			DDRSS3_PHY_1128_DATA
			DDRSS3_PHY_1129_DATA
			DDRSS3_PHY_1130_DATA
			DDRSS3_PHY_1131_DATA
			DDRSS3_PHY_1132_DATA
			DDRSS3_PHY_1133_DATA
			DDRSS3_PHY_1134_DATA
			DDRSS3_PHY_1135_DATA
			DDRSS3_PHY_1136_DATA
			DDRSS3_PHY_1137_DATA
			DDRSS3_PHY_1138_DATA
			DDRSS3_PHY_1139_DATA
			DDRSS3_PHY_1140_DATA
			DDRSS3_PHY_1141_DATA
			DDRSS3_PHY_1142_DATA
			DDRSS3_PHY_1143_DATA
			DDRSS3_PHY_1144_DATA
			DDRSS3_PHY_1145_DATA
			DDRSS3_PHY_1146_DATA
			DDRSS3_PHY_1147_DATA
			DDRSS3_PHY_1148_DATA
			DDRSS3_PHY_1149_DATA
			DDRSS3_PHY_1150_DATA
			DDRSS3_PHY_1151_DATA
			DDRSS3_PHY_1152_DATA
			DDRSS3_PHY_1153_DATA
			DDRSS3_PHY_1154_DATA
			DDRSS3_PHY_1155_DATA
			DDRSS3_PHY_1156_DATA
			DDRSS3_PHY_1157_DATA
			DDRSS3_PHY_1158_DATA
			DDRSS3_PHY_1159_DATA
			DDRSS3_PHY_1160_DATA
			DDRSS3_PHY_1161_DATA
			DDRSS3_PHY_1162_DATA
			DDRSS3_PHY_1163_DATA
			DDRSS3_PHY_1164_DATA
			DDRSS3_PHY_1165_DATA
			DDRSS3_PHY_1166_DATA
			DDRSS3_PHY_1167_DATA
			DDRSS3_PHY_1168_DATA
			DDRSS3_PHY_1169_DATA
			DDRSS3_PHY_1170_DATA
			DDRSS3_PHY_1171_DATA
			DDRSS3_PHY_1172_DATA
			DDRSS3_PHY_1173_DATA
			DDRSS3_PHY_1174_DATA
			DDRSS3_PHY_1175_DATA
			DDRSS3_PHY_1176_DATA
			DDRSS3_PHY_1177_DATA
			DDRSS3_PHY_1178_DATA
			DDRSS3_PHY_1179_DATA
			DDRSS3_PHY_1180_DATA
			DDRSS3_PHY_1181_DATA
			DDRSS3_PHY_1182_DATA
			DDRSS3_PHY_1183_DATA
			DDRSS3_PHY_1184_DATA
			DDRSS3_PHY_1185_DATA
			DDRSS3_PHY_1186_DATA
			DDRSS3_PHY_1187_DATA
			DDRSS3_PHY_1188_DATA
			DDRSS3_PHY_1189_DATA
			DDRSS3_PHY_1190_DATA
			DDRSS3_PHY_1191_DATA
			DDRSS3_PHY_1192_DATA
			DDRSS3_PHY_1193_DATA
			DDRSS3_PHY_1194_DATA
			DDRSS3_PHY_1195_DATA
			DDRSS3_PHY_1196_DATA
			DDRSS3_PHY_1197_DATA
			DDRSS3_PHY_1198_DATA
			DDRSS3_PHY_1199_DATA
			DDRSS3_PHY_1200_DATA
			DDRSS3_PHY_1201_DATA
			DDRSS3_PHY_1202_DATA
			DDRSS3_PHY_1203_DATA
			DDRSS3_PHY_1204_DATA
			DDRSS3_PHY_1205_DATA
			DDRSS3_PHY_1206_DATA
			DDRSS3_PHY_1207_DATA
			DDRSS3_PHY_1208_DATA
			DDRSS3_PHY_1209_DATA
			DDRSS3_PHY_1210_DATA
			DDRSS3_PHY_1211_DATA
			DDRSS3_PHY_1212_DATA
			DDRSS3_PHY_1213_DATA
			DDRSS3_PHY_1214_DATA
			DDRSS3_PHY_1215_DATA
			DDRSS3_PHY_1216_DATA
			DDRSS3_PHY_1217_DATA
			DDRSS3_PHY_1218_DATA
			DDRSS3_PHY_1219_DATA
			DDRSS3_PHY_1220_DATA
			DDRSS3_PHY_1221_DATA
			DDRSS3_PHY_1222_DATA
			DDRSS3_PHY_1223_DATA
			DDRSS3_PHY_1224_DATA
			DDRSS3_PHY_1225_DATA
			DDRSS3_PHY_1226_DATA
			DDRSS3_PHY_1227_DATA
			DDRSS3_PHY_1228_DATA
			DDRSS3_PHY_1229_DATA
			DDRSS3_PHY_1230_DATA
			DDRSS3_PHY_1231_DATA
			DDRSS3_PHY_1232_DATA
			DDRSS3_PHY_1233_DATA
			DDRSS3_PHY_1234_DATA
			DDRSS3_PHY_1235_DATA
			DDRSS3_PHY_1236_DATA
			DDRSS3_PHY_1237_DATA
			DDRSS3_PHY_1238_DATA
			DDRSS3_PHY_1239_DATA
			DDRSS3_PHY_1240_DATA
			DDRSS3_PHY_1241_DATA
			DDRSS3_PHY_1242_DATA
			DDRSS3_PHY_1243_DATA
			DDRSS3_PHY_1244_DATA
			DDRSS3_PHY_1245_DATA
			DDRSS3_PHY_1246_DATA
			DDRSS3_PHY_1247_DATA
			DDRSS3_PHY_1248_DATA
			DDRSS3_PHY_1249_DATA
			DDRSS3_PHY_1250_DATA
			DDRSS3_PHY_1251_DATA
			DDRSS3_PHY_1252_DATA
			DDRSS3_PHY_1253_DATA
			DDRSS3_PHY_1254_DATA
			DDRSS3_PHY_1255_DATA
			DDRSS3_PHY_1256_DATA
			DDRSS3_PHY_1257_DATA
			DDRSS3_PHY_1258_DATA
			DDRSS3_PHY_1259_DATA
			DDRSS3_PHY_1260_DATA
			DDRSS3_PHY_1261_DATA
			DDRSS3_PHY_1262_DATA
			DDRSS3_PHY_1263_DATA
			DDRSS3_PHY_1264_DATA
			DDRSS3_PHY_1265_DATA
			DDRSS3_PHY_1266_DATA
			DDRSS3_PHY_1267_DATA
			DDRSS3_PHY_1268_DATA
			DDRSS3_PHY_1269_DATA
			DDRSS3_PHY_1270_DATA
			DDRSS3_PHY_1271_DATA
			DDRSS3_PHY_1272_DATA
			DDRSS3_PHY_1273_DATA
			DDRSS3_PHY_1274_DATA
			DDRSS3_PHY_1275_DATA
			DDRSS3_PHY_1276_DATA
			DDRSS3_PHY_1277_DATA
			DDRSS3_PHY_1278_DATA
			DDRSS3_PHY_1279_DATA
			DDRSS3_PHY_1280_DATA
			DDRSS3_PHY_1281_DATA
			DDRSS3_PHY_1282_DATA
			DDRSS3_PHY_1283_DATA
			DDRSS3_PHY_1284_DATA
			DDRSS3_PHY_1285_DATA
			DDRSS3_PHY_1286_DATA
			DDRSS3_PHY_1287_DATA
			DDRSS3_PHY_1288_DATA
			DDRSS3_PHY_1289_DATA
			DDRSS3_PHY_1290_DATA
			DDRSS3_PHY_1291_DATA
			DDRSS3_PHY_1292_DATA
			DDRSS3_PHY_1293_DATA
			DDRSS3_PHY_1294_DATA
			DDRSS3_PHY_1295_DATA
			DDRSS3_PHY_1296_DATA
			DDRSS3_PHY_1297_DATA
			DDRSS3_PHY_1298_DATA
			DDRSS3_PHY_1299_DATA
			DDRSS3_PHY_1300_DATA
			DDRSS3_PHY_1301_DATA
			DDRSS3_PHY_1302_DATA
			DDRSS3_PHY_1303_DATA
			DDRSS3_PHY_1304_DATA
			DDRSS3_PHY_1305_DATA
			DDRSS3_PHY_1306_DATA
			DDRSS3_PHY_1307_DATA
			DDRSS3_PHY_1308_DATA
			DDRSS3_PHY_1309_DATA
			DDRSS3_PHY_1310_DATA
			DDRSS3_PHY_1311_DATA
			DDRSS3_PHY_1312_DATA
			DDRSS3_PHY_1313_DATA
			DDRSS3_PHY_1314_DATA
			DDRSS3_PHY_1315_DATA
			DDRSS3_PHY_1316_DATA
			DDRSS3_PHY_1317_DATA
			DDRSS3_PHY_1318_DATA
			DDRSS3_PHY_1319_DATA
			DDRSS3_PHY_1320_DATA
			DDRSS3_PHY_1321_DATA
			DDRSS3_PHY_1322_DATA
			DDRSS3_PHY_1323_DATA
			DDRSS3_PHY_1324_DATA
			DDRSS3_PHY_1325_DATA
			DDRSS3_PHY_1326_DATA
			DDRSS3_PHY_1327_DATA
			DDRSS3_PHY_1328_DATA
			DDRSS3_PHY_1329_DATA
			DDRSS3_PHY_1330_DATA
			DDRSS3_PHY_1331_DATA
			DDRSS3_PHY_1332_DATA
			DDRSS3_PHY_1333_DATA
			DDRSS3_PHY_1334_DATA
			DDRSS3_PHY_1335_DATA
			DDRSS3_PHY_1336_DATA
			DDRSS3_PHY_1337_DATA
			DDRSS3_PHY_1338_DATA
			DDRSS3_PHY_1339_DATA
			DDRSS3_PHY_1340_DATA
			DDRSS3_PHY_1341_DATA
			DDRSS3_PHY_1342_DATA
			DDRSS3_PHY_1343_DATA
			DDRSS3_PHY_1344_DATA
			DDRSS3_PHY_1345_DATA
			DDRSS3_PHY_1346_DATA
			DDRSS3_PHY_1347_DATA
			DDRSS3_PHY_1348_DATA
			DDRSS3_PHY_1349_DATA
			DDRSS3_PHY_1350_DATA
			DDRSS3_PHY_1351_DATA
			DDRSS3_PHY_1352_DATA
			DDRSS3_PHY_1353_DATA
			DDRSS3_PHY_1354_DATA
			DDRSS3_PHY_1355_DATA
			DDRSS3_PHY_1356_DATA
			DDRSS3_PHY_1357_DATA
			DDRSS3_PHY_1358_DATA
			DDRSS3_PHY_1359_DATA
			DDRSS3_PHY_1360_DATA
			DDRSS3_PHY_1361_DATA
			DDRSS3_PHY_1362_DATA
			DDRSS3_PHY_1363_DATA
			DDRSS3_PHY_1364_DATA
			DDRSS3_PHY_1365_DATA
			DDRSS3_PHY_1366_DATA
			DDRSS3_PHY_1367_DATA
			DDRSS3_PHY_1368_DATA
			DDRSS3_PHY_1369_DATA
			DDRSS3_PHY_1370_DATA
			DDRSS3_PHY_1371_DATA
			DDRSS3_PHY_1372_DATA
			DDRSS3_PHY_1373_DATA
			DDRSS3_PHY_1374_DATA
			DDRSS3_PHY_1375_DATA
			DDRSS3_PHY_1376_DATA
			DDRSS3_PHY_1377_DATA
			DDRSS3_PHY_1378_DATA
			DDRSS3_PHY_1379_DATA
			DDRSS3_PHY_1380_DATA
			DDRSS3_PHY_1381_DATA
			DDRSS3_PHY_1382_DATA
			DDRSS3_PHY_1383_DATA
			DDRSS3_PHY_1384_DATA
			DDRSS3_PHY_1385_DATA
			DDRSS3_PHY_1386_DATA
			DDRSS3_PHY_1387_DATA
			DDRSS3_PHY_1388_DATA
			DDRSS3_PHY_1389_DATA
			DDRSS3_PHY_1390_DATA
			DDRSS3_PHY_1391_DATA
			DDRSS3_PHY_1392_DATA
			DDRSS3_PHY_1393_DATA
			DDRSS3_PHY_1394_DATA
			DDRSS3_PHY_1395_DATA
			DDRSS3_PHY_1396_DATA
			DDRSS3_PHY_1397_DATA
			DDRSS3_PHY_1398_DATA
			DDRSS3_PHY_1399_DATA
			DDRSS3_PHY_1400_DATA
			DDRSS3_PHY_1401_DATA
			DDRSS3_PHY_1402_DATA
			DDRSS3_PHY_1403_DATA
			DDRSS3_PHY_1404_DATA
			DDRSS3_PHY_1405_DATA
			DDRSS3_PHY_1406_DATA
			DDRSS3_PHY_1407_DATA
			DDRSS3_PHY_1408_DATA
			DDRSS3_PHY_1409_DATA
			DDRSS3_PHY_1410_DATA
			DDRSS3_PHY_1411_DATA
			DDRSS3_PHY_1412_DATA
			DDRSS3_PHY_1413_DATA
			DDRSS3_PHY_1414_DATA
			DDRSS3_PHY_1415_DATA
			DDRSS3_PHY_1416_DATA
			DDRSS3_PHY_1417_DATA
			DDRSS3_PHY_1418_DATA
			DDRSS3_PHY_1419_DATA
			DDRSS3_PHY_1420_DATA
			DDRSS3_PHY_1421_DATA
			DDRSS3_PHY_1422_DATA
		>;
	};
};
