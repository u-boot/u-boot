// SPDX-License-Identifier: (GPL-2.0+ OR MIT)
/*
 * Copyright (c) 2017 Amlogic, Inc. All rights reserved.
 */

#include "meson-axg-u-boot.dtsi"

/* wifi module */
&sd_emmc_b {
	status = "disabled";
};

/* emmc storage */
&sd_emmc_c {
	status = "okay";
};

&usb {
	status = "okay";
	dr_mode = "otg";
	vbus-supply = <&usb_pwr>;
};

&usb2_phy1 {
	phy-supply = <&vcc_5v>;
};
