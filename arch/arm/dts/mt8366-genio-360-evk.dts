// SPDX-License-Identifier: GPL-2.0-only OR MIT
/*
 * Copyright (C) 2026 MediaTek Inc.
 * Author: Macpaul Lin <macpaul.lin@mediatek.com>
 */

/dts-v1/;

#include "mt8366-genio-360-evk-common.dtsi"

/ {
	model = "MediaTek Genio-360 EVK";
	compatible = "mediatek,mt8366-evk", "mediatek,mt8366";
};
