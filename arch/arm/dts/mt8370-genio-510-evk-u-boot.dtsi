// SPDX-License-Identifier: (GPL-2.0-only OR MIT)
/*
 * Copyright (c) 2026 BayLibre SAS
 * Author: Julien Stephan <jstephan@baylibre.com>
 */

#include <config.h>
#include "mt8390-genio-common-u-boot.dtsi"

#ifdef CONFIG_MTK_GENIO_BOOT_IMAGES
#define MTK_BOOTLOADERS_DESCRIPTION "MediaTek Genio 510 bootloaders"
#define MTK_BOOT_CHAIN_DESCRIPTION "Genio 510 boot chain"
#include "mtk-genio-binman-u-boot.dtsi"
#include "mtk-genio-mtk-boot-binman-u-boot.dtsi"
#include "mtk-genio-bootloaders-binman-u-boot.dtsi"
#endif
