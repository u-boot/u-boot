// SPDX-License-Identifier: (GPL-2.0-only OR MIT)
/*
 * Copyright (c) 2026 BayLibre, SAS.
 * Author: Carlo Caione <ccaione@baylibre.com>
 */

&binman {
	da: da {
		filename = "da.bin";
		pad-byte = <0>;

#include "mtk-genio-loader-spl-binman-u-boot.dtsi"
	};
};
