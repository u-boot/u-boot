// SPDX-License-Identifier: GPL-2.0+ OR X11
/*
 * Copyright 2016 Toradex AG
 */

/dts-v1/;
#include "vf.dtsi"

/ {
	model = "Phytec phyCORE-Vybrid";
	compatible = "phytec,pcm052", "fsl,vf610";

	chosen {
		stdout-path = &uart1;
	};

};

&uart1 {
	status = "okay";
};
