// SPDX-License-Identifier: BSD-3-Clause
/*
 * Copyright (c) 2025, Qualcomm Innovation Center, Inc. All rights reserved.
 */

/ {
	memory@80000000 {
		device_type = "memory";
		reg = <0x0 0x80000000 0x0 0x11a80000>,
		      <0x0 0xc0000000 0x0 0x10000000>,
		      <0x0 0xd3100000 0x0 0x26b00000>,
		      <0xe 0x80000000 0x1 0x00000000>,
		      <0xa 0x80000000 0x1 0x80000000>,
		      <0x0 0xb0800000 0x0 0x0f200000>,
		      <0x0 0xd0100000 0x0 0x01800000>,
		      <0x0 0x91b00000 0x0 0x1e500000>;
	};
};

