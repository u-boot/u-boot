// SPDX-License-Identifier: BSD-3-Clause
/*
 * Copyright (c) 2025, Qualcomm Innovation Center, Inc. All rights reserved.
 */

/ {
	/* Will be removed when bootloader updates later */
	memory@80000000 {
		device_type = "memory";
		reg = <0x0 0x80000000 0x0 0x3ee00000>,
		      <0x0 0xc0000000 0x0 0x04d00000>,
		      <0xd 0x00000000 0x2 0x54100000>,
		      <0xa 0x80000000 0x1 0x52d00000>,
		      <0x9 0x00000000 0x1 0x80000000>,
		      <0x1 0x00000000 0x2 0xf7500000>,
		      <0x0 0xd0000000 0x0 0x00100000>,
		      <0x0 0xd3500000 0x0 0x07c00000>,
		      <0x0 0xdb300000 0x0 0x24d00000>;
	};
};
