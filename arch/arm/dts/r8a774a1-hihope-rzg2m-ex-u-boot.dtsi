// SPDX-License-Identifier: GPL-2.0
/*
 * Device Tree Source extras for U-Boot for the Hihope RZ/G2M board
 *
 * Copyright (C) 2021-2024 Renesas Electronics Corporation
 */

#include "r8a774a1-u-boot.dtsi"
