// SPDX-License-Identifier: GPL-2.0
/*
 * Device Tree Source extras for U-Boot on RZ/G2 R8A774A1 SoC
 *
 * Copyright (C) 2021 Renesas Electronics Corporation
 */

#include "r8a779x-rcar64-u-boot.dtsi"
