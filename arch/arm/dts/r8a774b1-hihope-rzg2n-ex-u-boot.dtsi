// SPDX-License-Identifier: GPL-2.0
/*
 * Device Tree Source extras for U-Boot for the Hihope RZ/G2N board
 *
 * Copyright (C) 2021-2024 Renesas Electronics Corp.
 */

#include "r8a774b1-u-boot.dtsi"
