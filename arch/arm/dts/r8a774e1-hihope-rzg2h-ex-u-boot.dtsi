// SPDX-License-Identifier: GPL-2.0
/*
 * Device Tree Source extras for U-Boot for the Hihope RZ/G2H board
 *
 * Copyright (C) 2020-2024 Renesas Electronics Corp.
 */

#include "r8a774e1-u-boot.dtsi"
