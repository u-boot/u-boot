/*
 * Device Tree Source extras for U-Boot for the Koelsch board
 *
 * Copyright (C) 2018 Marek Vasut <marek.vasut@gmail.com>
 *
 * SPDX-License-Identifier:	GPL-2.0
 */

#include "r8a7791-koelsch.dts"
#include "r8a7791-u-boot.dtsi"
