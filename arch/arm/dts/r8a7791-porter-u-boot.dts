/*
 * Device Tree Source extras for U-Boot for the Porter board
 *
 * Copyright (C) 2018 Marek Vasut <marek.vasut@gmail.com>
 *
 * SPDX-License-Identifier:	GPL-2.0
 */

#include "r8a7791-porter.dts"
#include "r8a7791-u-boot.dtsi"

&scif0 {
	u-boot,dm-pre-reloc;
};
