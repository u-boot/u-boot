/*
 * Device Tree Source extras for U-Boot on RCar R8A7792 SoC
 *
 * Copyright (C) 2018 Marek Vasut <marek.vasut@gmail.com>
 *
 * SPDX-License-Identifier:	GPL-2.0
 */

#include "r8a779x-u-boot.dtsi"

&pfc {
	u-boot,dm-pre-reloc;
};

&rst {
	u-boot,dm-pre-reloc;
};
