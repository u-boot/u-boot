/*
 * Device Tree Source extras for U-Boot for the Gose board
 *
 * Copyright (C) 2018 Marek Vasut <marek.vasut@gmail.com>
 *
 * SPDX-License-Identifier:	GPL-2.0
 */

#include "r8a7793-gose.dts"
#include "r8a7793-u-boot.dtsi"
