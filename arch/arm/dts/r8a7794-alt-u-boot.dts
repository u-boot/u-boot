/*
 * Device Tree Source extras for U-Boot for the Alt board
 *
 * Copyright (C) 2018 Marek Vasut <marek.vasut@gmail.com>
 *
 * SPDX-License-Identifier:	GPL-2.0
 */

#include "r8a7794-alt.dts"
#include "r8a7794-u-boot.dtsi"
