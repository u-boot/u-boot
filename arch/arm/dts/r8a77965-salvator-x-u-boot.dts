// SPDX-License-Identifier: GPL-2.0
/*
 * Device Tree Source extras for U-Boot for the M3N Salvator-XS board
 *
 * Copyright (C) 2018 Marek Vasut <marek.vasut@gmail.com>
 */

#include "r8a77965-salvator-x.dts"
#include "r8a77965-u-boot.dtsi"
