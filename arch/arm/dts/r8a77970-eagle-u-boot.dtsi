// SPDX-License-Identifier: GPL-2.0
/*
 * Device Tree Source extras for U-Boot for the Eagle board
 *
 * Copyright (C) 2018 Marek Vasut <marek.vasut@gmail.com>
 */

#include <dt-bindings/gpio/gpio.h>

/ {
	aliases {
		spi0 = &rpc;
	};
};

&rpc {
	status = "okay";
	#address-cells = <1>;
	#size-cells = <0>;

	flash0: spi-flash@0 {
		#address-cells = <1>;
		#size-cells = <1>;
		compatible = "s25fs512s", "jedec,spi-nor";
		spi-max-frequency = <50000000>;
		spi-tx-bus-width = <1>;
		spi-rx-bus-width = <1>;
		reg = <0>;
		status = "okay";
	};
};
