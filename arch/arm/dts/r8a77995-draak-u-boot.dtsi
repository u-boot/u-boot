// SPDX-License-Identifier: GPL-2.0
/*
 * Device Tree Source extras for U-Boot for the Draak board
 *
 * Copyright (C) 2018 Marek Vasut <marek.vasut@gmail.com>
 */

/ {
	sysinfo {
		compatible = "renesas,rcar-sysinfo";
		i2c-eeprom = <&{i2c0/eeprom@50}>;
		bootph-all;
	};
};

&i2c0 {
	bootph-all;

	eeprom@50 {
		bootph-all;
	};
};
