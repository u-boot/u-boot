// SPDX-License-Identifier: GPL-2.0
/*
 * Device Tree Source extras for U-Boot on R-Car 64bit SoC
 *
 * Copyright (C) 2024 Marek Vasut <marek.vasut+renesas@mailbox.org>
 */

#include "r8a779x-u-boot.dtsi"

&extalr_clk {
	bootph-all;
};
