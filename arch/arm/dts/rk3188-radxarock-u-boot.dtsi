// SPDX-License-Identifier: GPL-2.0+
/*
 * Copyright (c) 2018 Fuzhou Rockchip Electronics Co., Ltd.
 */

&cru {
	u-boot,dm-spl;
};

&pinctrl {
	u-boot,dm-spl;
};

&uart2 {
	status = "okay";
	u-boot,dm-spl;
};

&timer3 {
	compatible = "rockchip,rk3368-timer", "rockchip,rk3288-timer";
	u-boot,dm-spl;
	clock-frequency = <24000000>;
};
