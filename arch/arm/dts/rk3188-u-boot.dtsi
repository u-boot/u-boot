// SPDX-License-Identifier: GPL-2.0+
/*
 * Copyright (C) 2019 Jagan Teki <jagan@amarulasolutions.com>
 */

#include "rockchip-u-boot.dtsi"
#include "rk3xxx-u-boot.dtsi"

&global_timer {
	status = "okay";
};

&gpio0 {
	compatible = "rockchip,gpio-bank";
};

&pmu {
	compatible = "rockchip,rk3188-pmu", "syscon", "simple-mfd";
};

