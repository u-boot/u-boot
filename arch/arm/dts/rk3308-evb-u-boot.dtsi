// SPDX-License-Identifier: GPL-2.0+
/*
 * (C) Copyright 2018-2019 Rockchip Electronics Co., Ltd
 */
#include "rk3308-u-boot.dtsi"

&uart4 {
	bootph-all;
	clock-frequency = <24000000>;
};

&uart4_xfer {
	bootph-all;
};
