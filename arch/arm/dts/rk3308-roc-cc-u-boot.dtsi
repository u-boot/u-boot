// SPDX-License-Identifier: GPL-2.0+
/*
 * (C) Copyright 2018-2019 Rockchip Electronics Co., Ltd
 */
#include "rk3308-u-boot.dtsi"

&gpio4 {
	bootph-pre-ram;
};

&uart2 {
	bootph-all;
	clock-frequency = <24000000>;
};

&uart2m0_xfer {
	bootph-all;
};

&vcc_sd {
	bootph-pre-ram;
};
