// SPDX-License-Identifier: GPL-2.0+
/*
 * Copyright (c) 2019 Andy Yan <andy.yan@gmail.com>
 */

#include "rk3399-u-boot.dtsi"
#include "rk3399-sdram-lpddr4-100.dtsi"

&vdd_log {
	regulator-init-microvolt = <950000>;
};
