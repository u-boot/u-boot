// SPDX-License-Identifier: GPL-2.0+
/*
 * Copyright (C) 2019 Jagan Teki <jagan@amarulasolutions.com>
 */

#include "rk3399-u-boot.dtsi"
#include "rk3399-sdram-ddr3-1333.dtsi"

&gpio0 {
	bootph-pre-ram;
};

&sdmmc0_pwr_h {
	bootph-pre-ram;
};

&vcc3v0_sd {
	bootph-pre-ram;
};

&vdd_log {
	regulator-init-microvolt = <950000>;
};
