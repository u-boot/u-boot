// SPDX-License-Identifier: GPL-2.0+
/*
 * Copyright (C) 2022 Peter Robinson <pbrobinson at gmail.com>
 */

#include "rk3399-u-boot.dtsi"
#include "rk3399-sdram-lpddr4-100.dtsi"

&sdhci {
	max-frequency = <25000000>;
};

&sdmmc {
	max-frequency = <20000000>;
};

&spi1 {
	flash@0 {
		bootph-pre-ram;
		bootph-some-ram;
	};
};
