/*
 * (C) Copyright 2017 Theobroma Systems Design und Consulting GmbH
 *
 * SPDX-License-Identifier:     GPL-2.0+	X11
 */

/dts-v1/;

#include "rk3399-puma.dtsi"
#include "rk3399-sdram-ddr3-1866.dtsi"

