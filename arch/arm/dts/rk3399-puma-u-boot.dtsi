// SPDX-License-Identifier: GPL-2.0+

#include "rk3399-u-boot.dtsi"
/ {
       config {
               u-boot,spl-payload-offset = <0x40000>; /* @ 256KB */
               u-boot,mmc-env-offset = <0x4000>;      /* @  16KB */
               u-boot,efi-partition-entries-offset = <0x200000>; /* 2MB */
               u-boot,boot-led = "module_led";
               sysreset-gpio = <&gpio1 RK_PA6 GPIO_ACTIVE_HIGH>;
       };

       chosen {
               stdout-path = "serial0:115200n8";
               u-boot,spl-boot-order = \
                       "same-as-spl", &spiflash, &sdhci, &sdmmc;
       };

       aliases {
               spi0 = &spi1;
               spi1 = &spi5;
       };

};
