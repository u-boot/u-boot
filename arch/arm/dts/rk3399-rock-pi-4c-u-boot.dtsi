// SPDX-License-Identifier: GPL-2.0+
/*
 * Copyright (C) 2019 Jagan Teki <jagan@amarulasolutions.com>
 */

#include "rk3399-rock-pi-4-u-boot.dtsi"

&spi1 {
	flash@0 {
		bootph-pre-ram;
		bootph-some-ram;
	};
};
