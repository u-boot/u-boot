// SPDX-License-Identifier: (GPL-2.0+ OR MIT)

#include "rk356x-u-boot.dtsi"

/ {
	chosen {
		u-boot,spl-boot-order = &sdmmc0, &sdhci;
	};

	/*
	 * Adding fixed regulator to work around driver regulator
	 * requirements. Note that the correct regulator is on by
	 * default at boot and that saradc regulator gets corrected
	 * when proper device-tree is loaded.
	 */
	vcc_1v8_dummy: vcc-1v8-dummy {
		bootph-pre-ram;
		bootph-some-ram;
		compatible = "regulator-fixed";
		regulator-always-on;
		regulator-boot-on;
		regulator-min-microvolt = <1800000>;
		regulator-max-microvolt = <1800000>;
		regulator-name = "vcc_1v8_dummy";
		status = "okay";
	};
};

&saradc {
	bootph-pre-ram;
	bootph-some-ram;
	vref-supply = <&vcc_1v8_dummy>;
	status = "okay";
};
