// SPDX-License-Identifier: (GPL-2.0+ OR MIT)

/dts-v1/;

#include "rk3566-anbernic-rgxx3.dtsi"

/ {

/*
 * Note this is a pseudo-model that doesn't exist in mainline Linux.
 * This model is used for all RGXX3 devices and the board.c file will
 * set the correct dtb name for loading mainline Linux automatically.
 */
	model = "RGXX3";
	compatible = "anbernic,rg-arc-d", "anbernic,rg-arc-s",
		     "anbernic,rg353m", "anbernic,rg353p",
		     "anbernic,rg353ps", "anbernic,rg353v",
		     "anbernic,rg353vs", "anbernic,rg503",
		     "powkiddy,rgb10max3", "powkiddy,rgb30",
		     "powkiddy,rk2023", "rockchip,rk3566";
};

&cru {
	assigned-clocks = <&pmucru CLK_RTC_32K>, <&cru PLL_GPLL>,
			  <&pmucru PLL_PPLL>, <&cru PLL_VPLL>;
	assigned-clock-rates = <32768>, <1200000000>,
			       <200000000>, <241500000>;
};
