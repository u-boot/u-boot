// SPDX-License-Identifier: GPL-2.0+
/*
 * (C) Copyright 2021 Rockchip Electronics Co., Ltd
 */

#include "rk356x-u-boot.dtsi"

/ {
	chosen {
		stdout-path = &uart2;
	};
};

&sdhci {
	cap-mmc-highspeed;
	mmc-ddr-1_8v;
};

&uart2 {
	clock-frequency = <24000000>;
	bootph-all;
	status = "okay";
};
