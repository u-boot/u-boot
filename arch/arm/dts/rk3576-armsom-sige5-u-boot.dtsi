// SPDX-License-Identifier: (GPL-2.0+ OR MIT)

#include "rk3576-u-boot.dtsi"

/ {
	aliases {
		mmc0 = &sdhci;
		mmc1 = &sdmmc;
	};
};

&red_led {
	default-state = "on";
};

&sdhci {
	cap-mmc-highspeed;
};
