// SPDX-License-Identifier: (GPL-2.0+ OR MIT)

#include "rk3588-u-boot.dtsi"

&fspim2_pins {
	bootph-pre-ram;
	bootph-some-ram;
};

&sfc {
	flash@0 {
		bootph-pre-ram;
		bootph-some-ram;
	};
};

/* USB A out */
&usb_host1_xhci {
	snps,dis_u3_susphy_quirk;
};
