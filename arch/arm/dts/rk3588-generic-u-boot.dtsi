// SPDX-License-Identifier: (GPL-2.0+ OR MIT)

#include "rk3588s-u-boot.dtsi"

&u2phy0 {
	status = "okay";
};

&u2phy0_otg {
	status = "okay";
};

&usbdp_phy0 {
	status = "okay";
};

&usb_host0_xhci {
	dr_mode = "peripheral";
	maximum-speed = "high-speed";
	status = "okay";
};
