// SPDX-License-Identifier: GPL-2.0+
// (C) Copyright 2024 Rockchip Electronics Co., Ltd

#include "rockchip-u-boot.dtsi"

/ {
	chosen {
		stdout-path = &uart0;
		u-boot,spl-boot-order = &spi_nand;
	};
};
