// SPDX-License-Identifier: GPL-2.0+
/*
 * Copyright (C) 2020 Amit Singh Tomar <amittomer25@gmail.com>
 */

/{
	soc {
		u-boot,dm-pre-reloc;
	};
};

&uart3 {
	u-boot,dm-pre-reloc;
};

&cmu {
	u-boot,dm-pre-reloc;
};
