// SPDX-License-Identifier: GPL-2.0-or-later
/*
 * (C) Copyright 2024 - Analog Devices, Inc.
 */

/dts-v1/;

#include "sc598-som.dtsi"

/ {
	model = "ADI SC598-SOM-EZLITE";
	compatible = "adi,sc598-som-ezlite", "adi,sc59x-64";
};
