// SPDX-License-Identifier: GPL-2.0
/*
 * Copyright Altera Corporation (C) 2026. All rights reserved.
 */

#include "socfpga_stratix10_socdk-u-boot.dtsi"

&gmac0 {
	status = "disabled";
};

&gmac2 {
	status = "okay";
};
