// SPDX-License-Identifier: GPL-2.0+ OR BSD-3-Clause
/*
 * Copyright : STMicroelectronics 2018
 */

#include "stm32mp157a-dk1-u-boot.dtsi"

&i2c1 {
	hdmi-transmitter@39 {
		reset-gpios = <&gpioa 10 GPIO_ACTIVE_LOW>;
	};
};
