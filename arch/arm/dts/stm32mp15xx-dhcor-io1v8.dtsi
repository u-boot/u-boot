// SPDX-License-Identifier: (GPL-2.0 OR BSD-3-Clause)
/*
 * Copyright (C) 2020 Marek Vasut <marex@denx.de>
 */

#include "stm32mp15xx-dhcor-io3v3.dtsi"

/ {
	/* Enpirion EP3A8LQI U2 on the 1V8 IO DHCOR */
	vdd_io: regulator-buck-io {
		compatible = "regulator-fixed";
		regulator-name = "buck-io";
		regulator-min-microvolt = <1800000>;
		regulator-max-microvolt = <1800000>;
		regulator-always-on;
		regulator-boot-on;
		vin-supply = <&vdd>;
	};
};

&pwr_regulators {
	vdd-supply = <&vdd_io>;
	vdd_3v3_usbfs-supply = <&vdd_usb>;
};
