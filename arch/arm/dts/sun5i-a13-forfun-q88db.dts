/*
 * Copyright 2015 Hans de Goede <hdegoede@redhat.com>
 *
 * Minimal dts file for the Forfun Q88db for u-boot only
 *
 * SPDX-License-Identifier:     GPL-2.0+ or X11
 */

/dts-v1/;
#include "sun5i-a13.dtsi"

/ {
	model = "Forfun Q88db";
	compatible = "forfun,q88db", "allwinner,sun5i-a13";

	aliases {
		serial0 = &uart1;
	};

	chosen {
		stdout-path = "serial0:115200n8";
	};
};

&uart1 {
	pinctrl-names = "default";
	pinctrl-0 = <&uart1_pins_b>;
	status = "okay";
};
