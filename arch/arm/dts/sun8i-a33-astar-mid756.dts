/*
 * Copyright 2015 Hans de Goede <hdegoede@redhat.com>
 *
 * Minimal dts file for the Astar MID756 for u-boot only
 *
 * SPDX-License-Identifier:     GPL-2.0+ or X11
 */

/dts-v1/;
#include "sun8i-a23.dtsi"

/ {
	model = "Astar MID756";
	compatible = "astar,mid756", "allwinner,sun8i-a23";

	aliases {
		serial0 = &r_uart;
	};

	chosen {
		stdout-path = "serial0:115200n8";
	};
};

&r_uart {
	pinctrl-names = "default";
	pinctrl-0 = <&r_uart_pins_a>;
	status = "okay";
};
