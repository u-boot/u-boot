// SPDX-License-Identifier: GPL-2.0
/dts-v1/;

#include "tegra20-asus-transformer.dtsi"

/ {
	model = "ASUS EeePad Transformer TF101";
	compatible = "asus,tf101", "nvidia,tegra20";

	extcon-keys {
		compatible = "gpio-keys";

		switch-dock-hall-sensor {
			label = "Lid sensor";
			gpios = <&gpio TEGRA_GPIO(S, 4) GPIO_ACTIVE_LOW>;
			linux,code = <SW_LID>;
		};
	};
};
