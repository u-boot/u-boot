/*
 * Device Tree Source for UniPhier PH1-LD6b SoC
 *
 * Copyright (C) 2015 Masahiro Yamada <yamada.masahiro@socionext.com>
 *
 * SPDX-License-Identifier:	GPL-2.0+	X11
 */

/*
 * PH1-LD6b consists of two silicon dies: D-chip and A-chip.
 * The D-chip (digital chip) is the same as the ProXstream2 die.
 * Reuse the ProXstream2 device tree with some properties overridden.
 */
/include/ "uniphier-proxstream2.dtsi"

/ {
	compatible = "socionext,ph1-ld6b";
};

/* UART3 unavilable: the pads are not wired to the package balls */
&serial3 {
	status = "disabled";
};

/*
 * PH1-LD6b and ProXstream2 have completely different packages,
 * which makes the pinctrl driver unshareable.
 */
&pinctrl {
	compatible = "socionext,ph1-ld6b-pinctrl", "syscon";
};
