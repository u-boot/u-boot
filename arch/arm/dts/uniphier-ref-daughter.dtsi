/*
 * Device Tree Source for UniPhier Reference Daughter Board
 *
 * Copyright (C) 2014-2015 Masahiro Yamada <yamada.masahiro@socionext.com>
 *
 * SPDX-License-Identifier:	GPL-2.0+	X11
 */

&i2c0 {
	eeprom@50 {
		compatible = "microchip,24lc128", "i2c-eeprom";
		reg = <0x50>;
		u-boot,i2c-offset-len = <2>;
	};
};
