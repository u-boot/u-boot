// SPDX-License-Identifier: GPL-2.0
/*
 * Xilinx Versal QSPI Quad Stacked DTS
 *
 * Copyright (C) 2018-2020 Xilinx, Inc.
 */

#include "versal-mini-ospi.dtsi"

/ {
	model = "Xilinx Versal MINI OSPI STACKED";
};

&ospi {
	is-stacked = <1>;
};

&flash0 {
	spi-rx-bus-width = <8>;
};
