// SPDX-License-Identifier: GPL-2.0
/*
 * Xilinx Versal QSPI Quad Parallel DTS
 *
 * Copyright (C) 2018-2019 Xilinx, Inc.
 */

#include "versal-mini-qspi.dtsi"

&qspi {
	is-dual = <1>;
};

&flash0 {
	spi-rx-bus-width = <4>;
};
