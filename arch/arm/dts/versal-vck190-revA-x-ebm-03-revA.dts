// SPDX-License-Identifier: GPL-2.0
/*
 * dts file for Xilinx Versal vck190 revA with X-EBM-03-revA module
 *
 * (C) Copyright 2020, Xilinx, Inc.
 *
 * Michal Simek <michal.simek@xilinx.com>
 */

#include "versal-vmk180-revA-x-ebm-03-revA.dts"

/ {
	compatible = "xlnx,versal-vck190-revA-x-ebm-03-revA",
		     "xlnx,versal-vck190-revA", "xlnx,versal";
	model = "Xilinx Versal vck190 Eval board revA (OSPI)";
};
