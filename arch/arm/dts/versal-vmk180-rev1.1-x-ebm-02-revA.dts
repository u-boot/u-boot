// SPDX-License-Identifier: GPL-2.0
/*
 * dts file for Xilinx Versal vmk180 rev1.1 with X-EBM-02-revA module
 *
 * (C) Copyright 2020 - 2021, Xilinx, Inc.
 *
 * Michal Simek <michal.simek@xilinx.com>
 */

#include "versal-vmk180-rev1.1.dts"

/ {
	compatible = "xlnx,versal-vmk180-rev1.1-x-ebm-02-revA",
		     "xlnx,versal-vmk180-rev1.1", "xlnx,versal";
	model = "Xilinx Versal vmk180 Eval board rev1.1 (EMMC)";
};

&sdhci1 {
#include "versal-x-ebm-02-revA.dtsi"
};
