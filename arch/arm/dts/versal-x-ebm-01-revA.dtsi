// SPDX-License-Identifier: GPL-2.0
/*
 * dts file for Xilinx X-EBM-01 revA for vck190/vmk180
 *
 * (C) Copyright 2019, Xilinx, Inc.
 *
 * Michal Simek <michal.simek@xilinx.com>
 */

status = "okay";
num-cs = <1>;
spi-tx-bus-width = <1>;
spi-rx-bus-width = <4>;
#address-cells = <1>;
#size-cells = <0>;
is-dual = <1>;
flash@0 {
	#address-cells = <1>;
	#size-cells = <1>;
	compatible = "m25p80", "jedec,spi-nor"; /* 256MB */
	reg = <0>;
	spi-tx-bus-width = <1>;
	spi-rx-bus-width = <4>;
	spi-max-frequency = <150000000>;
	partition@0 {
		label = "spi0-flash0";
		reg = <0x0 0x10000000>;
	};
};
