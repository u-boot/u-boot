/*
 * Copyright 2014 Toradex AG
 *
 * SPDX-License-Identifier:     GPL-2.0+ or X11
 */

/dts-v1/;
#include "vf-colibri.dtsi"

/ {
	model = "Toradex Colibri VF50";
	compatible = "toradex,vf500-colibri_vf50", "toradex,vf500-colibri_vf50", "fsl,vf500";
};
