/*
 * Copyright 2016 Toradex AG
 *
 * SPDX-License-Identifier:     GPL-2.0+ or X11
 */

/dts-v1/;
#include "vf.dtsi"

/ {
	model = "VF610 Tower Board";
	compatible = "fsl,vf610-twr", "fsl,vf610";

	choosen {
		stdout-path = &uart1;
	};

};

&uart1 {
	status = "okay";
};
