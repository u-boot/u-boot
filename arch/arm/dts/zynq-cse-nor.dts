/*
 * Xilinx CSE NOR board DTS
 *
 * Copyright (C) 2015 Xilinx, Inc.
 *
 * SPDX-License-Identifier:	GPL-2.0+
 */
/dts-v1/;
#include "zynq-7000.dtsi"

/ {
	model = "Zynq CSE NOR Board";
	compatible = "xlnx,zynq-cse-nor", "xlnx,zynq-7000";
};
