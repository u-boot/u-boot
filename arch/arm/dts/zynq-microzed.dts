/*
 * Xilinx MicroZED board DTS
 *
 * Copyright (C) 2013 Xilinx, Inc.
 *
 * SPDX-License-Identifier:	GPL-2.0+
 */
/dts-v1/;
#include "zynq-7000.dtsi"

/ {
	model = "Zynq MicroZED Board";
	compatible = "xlnx,zynq-microzed", "xlnx,zynq-7000";

	aliases {
		serial0 = &uart1;
	};

	memory {
		device_type = "memory";
		reg = <0 0x40000000>;
	};
};
