/*
 * Xilinx ZC770 XM010 board DTS
 *
 * Copyright (C) 2013 Xilinx, Inc.
 *
 * SPDX-License-Identifier:	GPL-2.0+
 */
/dts-v1/;
#include "zynq-7000.dtsi"

/ {
	model = "Zynq ZC770 XM010 Board";
	compatible = "xlnx,zynq-zc770-xm010", "xlnx,zynq-7000";

	aliases {
		serial0 = &uart1;
		spi1 = &spi1;
	};

	memory {
		device_type = "memory";
		reg = <0 0x40000000>;
	};
};

&spi1 {
	status = "okay";
};
