// SPDX-License-Identifier: GPL-2.0+
/*
 * Xilinx ZynqMP QSPI Quad Parallel DTS
 *
 * Copyright (C) 2015 - 2017 Xilinx, Inc.
 */

#include "zynqmp-mini-qspi.dts"

&qspi {
	is-dual = <1>;
};

&flash0 {
	spi-rx-bus-width = <4>;
};
