## arch/arm/mach-imx/imx9/Kconfig
```kconfig
if ARCH_IMX9

config AHAB_BOOT
    bool "Support i.MX9 AHAB features"
    help
    This option enables the support for AHAB secure boot.

config IMX9
	bool
	select BINMAN
	select CPU
	select CPU_IMX
	select HAS_CAAM
	select ROM_UNIFIED_SECTIONS
	imply IMX_TMU

config IMX93
	bool
	select IMX9
	select ARMV8_SPL_EXCEPTION_VECTORS

config IMX91
	bool
	select IMX9
	select ARCH_MISC_INIT
	select ARMV8_SPL_EXCEPTION_VECTORS

config IMX95_A0
	bool "Support for i.MX95 A0 silicon version"

config IMX95
	bool
	select ARCH_MISC_INIT
	select ARMV8_SPL_EXCEPTION_VECTORS
	select IMX9
	select DM_MAILBOX
	select SCMI_FIRMWARE
	select SPL_IMX_CONTAINER_USE_TRAMPOLINE
	select IMX_PQC_SUPPORT if !IMX95_A0

config IMX94
	bool
	select ARMV8_SPL_EXCEPTION_VECTORS
	select DM_MAILBOX
	select IMX9
	select IMX_PQC_SUPPORT
	select SCMI_FIRMWARE
	select SPL_IMX_CONTAINER_USE_TRAMPOLINE

config SYS_SOC
	default "imx9"

choice
	prompt  "NXP i.MX9 board select"
	optional

config TARGET_IMX91_11X11_EVK
	bool "imx91_11x11_evk"
	select OF_BOARD_FIXUP
	select IMX91
	imply BOOTSTD_FULL
	imply BOOTSTD_BOOTCOMMAND

config TARGET_IMX91_11X11_FRDM
	bool "imx91_11x11_frdm"
	select OF_BOARD_FIXUP
	select IMX91
	select IMX9_LPDDR4X
	imply BOOTSTD_FULL
	imply BOOTSTD_BOOTCOMMAND

config TARGET_IMX93_9X9_QSB
	bool "imx93_qsb"
	select OF_BOARD_FIXUP
	select IMX93
	select IMX9_LPDDR4X
	imply OF_UPSTREAM
	imply BOOTSTD_FULL
	imply BOOTSTD_BOOTCOMMAND
	select CMD_REMOTEPROC
	select REMOTEPROC_IMX
	select REGMAP
	select SYSCON

config TARGET_IMX93_11X11_EVK
	bool "imx93_11x11_evk"
	select OF_BOARD_FIXUP
	select IMX93
	imply OF_UPSTREAM
	imply BOOTSTD_FULL
	imply BOOTSTD_BOOTCOMMAND
	select CMD_REMOTEPROC
	select REMOTEPROC_IMX
	select REGMAP
	select SYSCON

config TARGET_IMX93_FRDM
	bool "imx93_frdm"
	select OF_BOARD_FIXUP
	select IMX93
	select IMX9_LPDDR4X
	imply BOOTSTD_FULL
	imply BOOTSTD_BOOTCOMMAND
	select CMD_REMOTEPROC
	select REMOTEPROC_IMX
	select REGMAP
	select SYSCON

config TARGET_IMX93_VAR_SOM
	bool "imx93_var_som"
	select IMX93
	select IMX9_LPDDR4X

config TARGET_KONTRON_MX93
	bool "Kontron OSM-S/BL i.MX93"
	select BINMAN
	select IMX93
	select IMX9_LPDDR4X
	help
	  Kontron Electronics BL i.MX93 using SoM module conformant to OSM
	  standard 1.1 size S.

config TARGET_PHYCORE_IMX93
	bool "phycore_imx93"
	select IMX93
	select IMX9_LPDDR4X
	imply OF_UPSTREAM
	select OF_BOARD_FIXUP
	select OF_BOARD_SETUP

config TARGET_IMX95_19X19_EVK
	bool "imx95_19x19_evk"
	select IMX95
	imply BOOTSTD_BOOTCOMMAND
	imply BOOTSTD_FULL
	imply OF_UPSTREAM

config TARGET_IMX95_15X15_EVK
	bool "imx95_15x15_evk"
	select IMX95
	imply BOOTSTD_BOOTCOMMAND
	imply BOOTSTD_FULL
	imply OF_UPSTREAM

config TARGET_IMX943_EVK
	bool "imx943_evk"
	select IMX94
	imply BOOTSTD_BOOTCOMMAND
	imply BOOTSTD_FULL
	imply OF_UPSTREAM

config TARGET_TORADEX_SMARC_IMX95
	bool "Support Toradex SMARC iMX95"
	select IMX95

endchoice

source "board/freescale/imx91_evk/Kconfig"
source "board/freescale/imx91_frdm/Kconfig"
source "board/freescale/imx93_evk/Kconfig"
source "board/freescale/imx93_frdm/Kconfig"
source "board/freescale/imx93_qsb/Kconfig"
source "board/kontron/osm-s-mx93/Kconfig"
source "board/phytec/phycore_imx93/Kconfig"
source "board/variscite/imx93_var_som/Kconfig"
source "board/freescale/imx94_evk/Kconfig"
source "board/freescale/imx95_evk/Kconfig"
source "board/toradex/smarc-imx95/Kconfig"

endif
```

## arch/arm/mach-imx/imxrt/Kconfig
```kconfig
if ARCH_IMXRT

config IMXRT
	bool

config IMXRT1020
	bool
	select IMXRT

config IMXRT1050
	bool
	select IMXRT

config SYS_SOC
	default "imxrt"

choice
	prompt "NXP i.MXRT board select"
	optional

config TARGET_IMXRT1020_EVK
	bool "Support imxrt1020 EVK board"
	select IMXRT1020

config TARGET_IMXRT1050_EVK
	bool "Support imxrt1050 EVK board"
	select IMXRT1050

endchoice

source "board/freescale/imxrt1020-evk/Kconfig"
source "board/freescale/imxrt1050-evk/Kconfig"

endif
```

## arch/arm/mach-imx/mx3/Kconfig
```kconfig
if ARCH_MX31

config MX31
       bool
       default y
choice
	prompt "MX31 board select"
	optional

config TARGET_MX31PDK
	bool "Support the i.MX31 PDK board from Freescale/NXP"
	select BOARD_LATE_INIT
	select SUPPORT_SPL
	select BOARD_EARLY_INIT_F

endchoice

source "board/freescale/mx31pdk/Kconfig"

endif
```

## arch/arm/mach-imx/mx5/Kconfig
```kconfig
if ARCH_MX5

config MX5
	bool
	default y

config MX51
	bool
	select SYS_FSL_ERRATUM_ESDHC_A001

config MX53
	bool

choice
	prompt "MX5 board select"
	optional

config TARGET_M53EVK
	bool "Support m53evk"
	select MX53
	select SUPPORT_SPL

config TARGET_MX51EVK
	bool "Support mx51evk"
	select BOARD_LATE_INIT
	select MX51

config TARGET_MX53ARD
	bool "Support mx53ard"
	select MX53

config TARGET_MX53CX9020
	bool "Support CX9020"
	select BOARD_LATE_INIT
	select MX53
	select DM
	select DM_SERIAL

config TARGET_MX53EVK
	bool "Support mx53evk"
	select BOARD_LATE_INIT
	select MX53

config TARGET_MX53LOCO
	bool "Support mx53loco"
	select BOARD_LATE_INIT
	select MX53

config TARGET_MX53SMD
	bool "Support mx53smd"
	select MX53

config TARGET_TS4800
	bool "Support TS4800"
	select MX51

config TARGET_USBARMORY
	bool "Support USB armory"
	select MX53

endchoice

config SYS_SOC
	default "mx5"

source "board/aries/m53evk/Kconfig"
source "board/beckhoff/mx53cx9020/Kconfig"
source "board/freescale/mx51evk/Kconfig"
source "board/freescale/mx53ard/Kconfig"
source "board/freescale/mx53evk/Kconfig"
source "board/freescale/mx53loco/Kconfig"
source "board/freescale/mx53smd/Kconfig"
source "board/inversepath/usbarmory/Kconfig"
source "board/technologic/ts4800/Kconfig"

endif
```

## arch/arm/mach-imx/mx6/Kconfig
```kconfig
if ARCH_MX6

config MX6_SMP
	select ARM_ERRATA_751472
	select ARM_ERRATA_761320
	select ARM_ERRATA_794072
	select ARM_ERRATA_845369
	bool

config MX6
	select ARM_ERRATA_743622 if !MX6UL && !MX6ULL
	select GPT_TIMER if !MX6UL && !MX6ULL
	bool
	default y
	imply CMD_FUSE

config MX6D
	select HAS_CAAM
	select MX6_SMP
	bool

config MX6DL
	select HAS_CAAM
	select MX6_SMP
	bool

config MX6Q
	select HAS_CAAM
	select MX6_SMP
	bool

config MX6QDL
	select HAS_CAAM
	select MX6_SMP
	bool

config MX6S
	select HAS_CAAM
	bool

config MX6SL
	bool

config MX6SX
	select HAS_CAAM
	select ROM_UNIFIED_SECTIONS
	bool

config MX6SLL
	select ROM_UNIFIED_SECTIONS
	bool

config MX6UL
	select HAS_CAAM
	select SYS_L2CACHE_OFF
	select ROM_UNIFIED_SECTIONS
	select SYSCOUNTER_TIMER
	bool

config MX6UL_LITESOM
	bool
	select MX6UL
	select DM
	select DM_THERMAL
	select SUPPORT_SPL

config MX6UL_OPOS6UL
	bool
	select MX6UL
	select BOARD_LATE_INIT
	select DM
	select DM_GPIO
	select DM_MMC
	select DM_THERMAL
	select SUPPORT_SPL

config MX6ULL
	select SYS_L2CACHE_OFF
	select ROM_UNIFIED_SECTIONS
	select SYSCOUNTER_TIMER
	bool

config MX6_DDRCAL
	bool "Include dynamic DDR calibration routines"
	depends on SPL
	default n
	help
	  Say "Y" if your board uses dynamic (per-boot) DDR calibration.
	  If unsure, say N.

choice
	prompt "MX6 board select"
	optional

config TARGET_ADVANTECH_DMS_BA16
	bool "Advantech dms-ba16"
	select BOARD_LATE_INIT
	select MX6Q
	imply CMD_SATA

config TARGET_APALIS_IMX6
	bool "Toradex Apalis iMX6 board"
	select BOARD_LATE_INIT
	select SUPPORT_SPL
	select DM
	select DM_SERIAL
	select DM_THERMAL
	imply CMD_SATA

config TARGET_ARISTAINETOS
	bool "aristainetos"

config TARGET_ARISTAINETOS2
	bool "aristainetos2"
	select BOARD_LATE_INIT

config TARGET_ARISTAINETOS2B
	bool "Support aristainetos2-revB"
	select BOARD_LATE_INIT

config TARGET_CGTQMX6EVAL
	bool "cgtqmx6eval"
	select MX6QDL
	select BOARD_LATE_INIT
	select SUPPORT_SPL
	select DM
	select DM_THERMAL

config TARGET_CM_FX6
	bool "CM-FX6"
	select SUPPORT_SPL
	select MX6QDL
	select DM
	select DM_SERIAL
	select DM_GPIO

config TARGET_COLIBRI_IMX6
	bool "Toradex Colibri iMX6 board"
	select BOARD_LATE_INIT
	select SUPPORT_SPL
	select DM
	select DM_SERIAL
	select DM_THERMAL

config TARGET_DHCOMIMX6
	bool "dh_imx6"
	select MX6QDL
	select BOARD_LATE_INIT
	select BOARD_EARLY_INIT_F
	select SUPPORT_SPL
	select DM
	select DM_THERMAL
	imply CMD_SPL

config TARGET_DISPLAY5
	bool "LWN DISPLAY5 board"
	select SUPPORT_SPL
	select DM
	select DM_SERIAL

config TARGET_EMBESTMX6BOARDS
	bool "embestmx6boards"
	select BOARD_LATE_INIT

config TARGET_GE_B450V3
	bool "General Electric B450v3"
	select BOARD_LATE_INIT
	select MX6Q

config TARGET_GE_B650V3
	bool "General Electric B650v3"
	select BOARD_LATE_INIT
	select MX6Q

config TARGET_GE_B850V3
	bool "General Electric B850v3"
	select BOARD_LATE_INIT
	select MX6Q

config TARGET_GW_VENTANA
	bool "gw_ventana"
	select MX6QDL
	select SUPPORT_SPL
	imply CMD_SATA
	imply CMD_SPL

config TARGET_KOSAGI_NOVENA
	bool "Kosagi Novena"
	select BOARD_LATE_INIT
	select SUPPORT_SPL

config TARGET_MCCMON6
	bool "mccmon6"
	select MX6QDL
	select SUPPORT_SPL

config TARGET_MX6CUBOXI
	bool "Solid-run mx6 boards"
	select MX6QDL
	select BOARD_LATE_INIT
	select SUPPORT_SPL

config TARGET_MX6LOGICPD
	bool "Logic PD i.MX6 SOM"
	select BOARD_EARLY_INIT_F
	select BOARD_LATE_INIT
	select DM
	select DM_ETH
	select DM_GPIO
	select DM_I2C
	select DM_MMC
	select DM_PMIC
	select DM_REGULATOR
	select OF_CONTROL

config TARGET_MX6MEMCAL
	bool "mx6memcal"
	select SUPPORT_SPL
	help
	  The mx6memcal board is a virtual board that can be used to validate
	  and characterize the memory layout of a new design during the initial
	  development and pre-production stages.

config TARGET_MX6QARM2
	bool "mx6qarm2"

config TARGET_MX6Q_ENGICAM
	bool "Support Engicam i.Core(RQS)"
	select BOARD_LATE_INIT
	select MX6QDL
	select OF_CONTROL
	select SPL_OF_LIBFDT
	select DM
	select DM_ETH
	select DM_GPIO
	select DM_I2C
	select DM_MMC
	select DM_THERMAL
	select SUPPORT_SPL
	select SPL_LOAD_FIT
	select SPL_DM if SPL
	select SPL_OF_CONTROL if SPL
	select SPL_SEPARATE_BSS if SPL
	select SPL_PINCTRL if SPL

config TARGET_MX6SABREAUTO
	bool "mx6sabreauto"
	select MX6QDL
	select BOARD_LATE_INIT
	select SUPPORT_SPL
	select DM
	select DM_THERMAL
	select BOARD_EARLY_INIT_F

config TARGET_MX6SABRESD
	bool "mx6sabresd"
	select MX6QDL
	select BOARD_LATE_INIT
	select SUPPORT_SPL
	select DM
	select DM_THERMAL
	select BOARD_EARLY_INIT_F

config TARGET_MX6SLEVK
	bool "mx6slevk"
	select MX6SL
	select SUPPORT_SPL

config TARGET_MX6SLLEVK
        bool "mx6sll evk"
	select BOARD_LATE_INIT
        select MX6SLL
        select DM
        select DM_THERMAL

config TARGET_MX6SXSABRESD
	bool "mx6sxsabresd"
	select BOARD_LATE_INIT
	select MX6SX
	select SUPPORT_SPL
	select DM
	select DM_THERMAL
	select BOARD_EARLY_INIT_F

config TARGET_MX6SXSABREAUTO
        bool "mx6sxsabreauto"
	select BOARD_LATE_INIT
	select MX6SX
        select DM
        select DM_THERMAL
	select BOARD_EARLY_INIT_F

config TARGET_MX6UL_9X9_EVK
	bool "mx6ul_9x9_evk"
	select BOARD_LATE_INIT
	select MX6UL
	select DM
	select DM_THERMAL
	select SUPPORT_SPL

config TARGET_MX6UL_14X14_EVK
	select BOARD_LATE_INIT
	bool "mx6ul_14x14_evk"
	select MX6UL
	select DM
	select DM_THERMAL
	select SUPPORT_SPL

config TARGET_MX6UL_ENGICAM
	bool "Support Engicam GEAM6UL/Is.IoT"
	select BOARD_LATE_INIT
	select MX6UL
	select OF_CONTROL
	select DM
	select DM_ETH
	select DM_GPIO
	select DM_I2C
	select DM_MMC
	select DM_THERMAL
	select SUPPORT_SPL
	select SPL_DM if SPL
	select SPL_OF_CONTROL if SPL
	select SPL_SEPARATE_BSS if SPL
	select SPL_PINCTRL if SPL

config TARGET_MX6ULL_14X14_EVK
	bool "Support mx6ull_14x14_evk"
	select BOARD_LATE_INIT
	select MX6ULL
	select DM
	select DM_THERMAL

config TARGET_NITROGEN6X
	bool "nitrogen6x"
	imply USB_HOST_ETHER
	imply USB_ETHER_ASIX
	imply USB_ETHER_SMSC95XX
	imply USB_ETHER_MCS7830

config TARGET_OPOS6ULDEV
	bool "Armadeus OPOS6ULDev board"
	select MX6UL_OPOS6UL

config TARGET_OT1200
	bool "Bachmann OT1200"
	select SUPPORT_SPL
	imply CMD_SATA

config TARGET_PICO_IMX6UL
	bool "PICO-IMX6UL-EMMC"
	select MX6UL

config TARGET_LITEBOARD
	bool "Grinn liteBoard (i.MX6UL)"
	select BOARD_LATE_INIT
	select MX6UL_LITESOM

config TARGET_PLATINUM_PICON
	bool "platinum-picon"
	select SUPPORT_SPL

config TARGET_PLATINUM_TITANIUM
	bool "platinum-titanium"
	select SUPPORT_SPL

config TARGET_PCM058
	bool "Phytec PCM058 i.MX6 Quad"
	select BOARD_LATE_INIT
	select SUPPORT_SPL

config TARGET_PFLA02
	bool "Phytec PFLA02 (PhyFlex) i.MX6 Quad"
	select MX6QDL
	select BOARD_LATE_INIT
	select SUPPORT_SPL

config TARGET_SECOMX6
	bool "secomx6 boards"

config TARGET_TBS2910
	bool "TBS2910 Matrix ARM mini PC"

config TARGET_TITANIUM
	bool "titanium"

config TARGET_TQMA6
	bool "TQ Systems TQMa6 board"
	select BOARD_LATE_INIT

config TARGET_UDOO
	bool "udoo"
	select MX6QDL
	select BOARD_LATE_INIT
	select SUPPORT_SPL

config TARGET_UDOO_NEO
	bool "UDOO Neo"
	select BOARD_LATE_INIT
	select SUPPORT_SPL
	select MX6SX
	select DM
	select DM_THERMAL

config TARGET_SAMTEC_VINING_2000
	bool "samtec VIN|ING 2000"
	select BOARD_LATE_INIT
	select MX6SX
	select DM
	select DM_THERMAL

config TARGET_WANDBOARD
	bool "wandboard"
	select MX6QDL
	select BOARD_LATE_INIT
	select SUPPORT_SPL

config TARGET_WARP
	bool "WaRP"
	select MX6SL
	select BOARD_LATE_INIT

config TARGET_XPRESS
	bool "CCV xPress"
	select BOARD_LATE_INIT
	select MX6UL
	select DM
	select DM_THERMAL
	select SUPPORT_SPL

config TARGET_ZC5202
	bool "zc5202"
	select BOARD_LATE_INIT
	select SUPPORT_SPL
	select DM
	select DM_THERMAL

config TARGET_ZC5601
	bool "zc5601"
	select BOARD_LATE_INIT
	select SUPPORT_SPL
	select DM
	select DM_THERMAL

endchoice

config SYS_SOC
	default "mx6"

source "board/ge/bx50v3/Kconfig"
source "board/advantech/dms-ba16/Kconfig"
source "board/aristainetos/Kconfig"
source "board/armadeus/opos6uldev/Kconfig"
source "board/bachmann/ot1200/Kconfig"
source "board/barco/platinum/Kconfig"
source "board/barco/titanium/Kconfig"
source "board/boundary/nitrogen6x/Kconfig"
source "board/ccv/xpress/Kconfig"
source "board/compulab/cm_fx6/Kconfig"
source "board/congatec/cgtqmx6eval/Kconfig"
source "board/dhelectronics/dh_imx6/Kconfig"
source "board/el/el6x/Kconfig"
source "board/embest/mx6boards/Kconfig"
source "board/engicam/imx6q/Kconfig"
source "board/engicam/imx6ul/Kconfig"
source "board/freescale/mx6qarm2/Kconfig"
source "board/freescale/mx6memcal/Kconfig"
source "board/freescale/mx6sabreauto/Kconfig"
source "board/freescale/mx6sabresd/Kconfig"
source "board/freescale/mx6slevk/Kconfig"
source "board/freescale/mx6sllevk/Kconfig"
source "board/freescale/mx6sxsabresd/Kconfig"
source "board/freescale/mx6sxsabreauto/Kconfig"
source "board/freescale/mx6ul_14x14_evk/Kconfig"
source "board/freescale/mx6ullevk/Kconfig"
source "board/grinn/liteboard/Kconfig"
source "board/phytec/pcm058/Kconfig"
source "board/phytec/pfla02/Kconfig"
source "board/gateworks/gw_ventana/Kconfig"
source "board/kosagi/novena/Kconfig"
source "board/samtec/vining_2000/Kconfig"
source "board/liebherr/display5/Kconfig"
source "board/liebherr/mccmon6/Kconfig"
source "board/logicpd/imx6/Kconfig"
source "board/seco/Kconfig"
source "board/solidrun/mx6cuboxi/Kconfig"
source "board/technexion/pico-imx6ul/Kconfig"
source "board/tbs/tbs2910/Kconfig"
source "board/tqc/tqma6/Kconfig"
source "board/toradex/apalis_imx6/Kconfig"
source "board/toradex/colibri_imx6/Kconfig"
source "board/udoo/Kconfig"
source "board/udoo/neo/Kconfig"
source "board/wandboard/Kconfig"
source "board/warp/Kconfig"

endif
```
