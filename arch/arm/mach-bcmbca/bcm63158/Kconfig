## arch/arm/mach-bcmbca/bcm63158/Kconfig
```kconfig
# SPDX-License-Identifier: GPL-2.0+
#
# (C) Copyright 2022 Broadcom Ltd
#

if BCM63158

config TARGET_BCM963158
	bool "Broadcom 63158 Reference Board"
	depends on ARCH_BCMBCA

config SYS_SOC
	default "bcm63158"

source "board/broadcom/bcmbca/Kconfig"

endif
```

## arch/arm/mach-bcmbca/bcm63178/Kconfig
```kconfig
# SPDX-License-Identifier: GPL-2.0+
#
# (C) Copyright 2022 Broadcom Ltd
#

if BCM63178

config TARGET_BCM963178
	bool "Broadcom 63178 Reference Board"
	depends on ARCH_BCMBCA

config SYS_SOC
	default "bcm63178"

source "board/broadcom/bcmbca/Kconfig"

endif
```

## arch/arm/mach-bcmbca/bcm6756/Kconfig
```kconfig
# SPDX-License-Identifier: GPL-2.0+
#
# (C) Copyright 2022 Broadcom Ltd
#

if BCM6756

config TARGET_BCM96756
	bool "Broadcom 6756 Reference Board"
	depends on ARCH_BCMBCA

config SYS_SOC
	default "bcm6756"

source "board/broadcom/bcmbca/Kconfig"

endif
```

## arch/arm/mach-bcmbca/bcm6846/Kconfig
```kconfig
# SPDX-License-Identifier: GPL-2.0+
#
# (C) Copyright 2022 Broadcom Ltd
#

if BCM6846

config TARGET_BCM96846
	bool "Broadcom 6846 Reference Board"
	depends on ARCH_BCMBCA
	imply OF_UPSTREAM
	imply MTD_RAW_NAND
	imply NAND_BRCMNAND
	imply NAND_BRCMNAND_BCMBCA

config SYS_SOC
	default "bcm6846"

source "board/broadcom/bcmbca/Kconfig"

endif
```

## arch/arm/mach-bcmbca/bcm6855/Kconfig
```kconfig
# SPDX-License-Identifier: GPL-2.0+
#
# (C) Copyright 2022 Broadcom Ltd
#

if BCM6855

config TARGET_BCM96855
	bool "Broadcom 6855 Reference Board"
	depends on ARCH_BCMBCA

config SYS_SOC
	default "bcm6855"

source "board/broadcom/bcmbca/Kconfig"

endif
```

## arch/arm/mach-bcmbca/bcm6856/Kconfig
```kconfig
# SPDX-License-Identifier: GPL-2.0+
#
# (C) Copyright 2022 Broadcom Ltd
#

if BCM6856

config TARGET_BCM96856
	bool "Broadcom 6856 Reference Board"
	depends on ARCH_BCMBCA

config SYS_SOC
	default "bcm6856"

source "board/broadcom/bcmbca/Kconfig"

endif
```

## arch/arm/mach-bcmbca/bcm6858/Kconfig
```kconfig
# SPDX-License-Identifier: GPL-2.0+
#
# (C) Copyright 2022 Broadcom Ltd
#

if BCM6858

config TARGET_BCM96858
	bool "Broadcom 6858 Reference Board"
	depends on ARCH_BCMBCA

config SYS_SOC
	default "bcm6858"

source "board/broadcom/bcmbca/Kconfig"

endif
```

## arch/arm/mach-davinci/Kconfig
```kconfig
if ARCH_DAVINCI

choice
	prompt "DaVinci board select"
	optional

config TARGET_IPAM390
	bool "IPAM390 board"
	select SUPPORT_SPL
	select SYS_DA850_PLL_INIT
	select SYS_DA850_DDR_INIT

config TARGET_DA850EVM
	bool "DA850 EVM board"
	select SUPPORT_SPL
	select SYS_DA850_PLL_INIT
	select SYS_DA850_DDR_INIT

config TARGET_EA20
	bool "EA20 board"
	select BOARD_LATE_INIT

config TARGET_OMAPL138_LCDK
	bool "OMAPL138 LCDK"
	select SUPPORT_SPL
	select SYS_DA850_PLL_INIT
	select SYS_DA850_DDR_INIT

config TARGET_CALIMAIN
	bool "Calimain board"
	select SYS_DA850_PLL_INIT
	select SYS_DA850_DDR_INIT

config TARGET_LEGOEV3
	bool "LEGO MINDSTORMS EV3"
	select SYS_DA850_PLL_INIT
	select SYS_DA850_DDR_INIT

endchoice

config SYS_SOC
	default "davinci"

config SYS_DA850_PLL_INIT
	bool

config SYS_DA850_DDR_INIT
	bool

source "board/Barix/ipam390/Kconfig"
source "board/davinci/da8xxevm/Kconfig"
source "board/davinci/ea20/Kconfig"
source "board/omicron/calimain/Kconfig"
source "board/lego/ev3/Kconfig"

config SPL_LDSCRIPT
	default "board/$(BOARDDIR)/u-boot-spl-ipam390.lds" if TARGET_IPAM390
	default "board/$(BOARDDIR)/u-boot-spl-da850evm.lds"

endif
```

## arch/arm/mach-exynos/Kconfig
```kconfig
if ARCH_EXYNOS

choice
	prompt "EXYNOS architecture type select"
	optional

config ARCH_EXYNOS4
	bool "Exynos4 SoC family"
	select CPU_V7
	select BOARD_EARLY_INIT_F
	help
	  Samsung Exynos4 SoC family are based on ARM Cortex-A9 CPU. There
	  are multiple SoCs in this family including Exynos4210, Exynos4412,
	  and Exynos4212.

config ARCH_EXYNOS5
	bool "Exynos5 SoC family"
	select CPU_V7
	select BOARD_EARLY_INIT_F
	select SHA_HW_ACCEL
	imply CRC32_VERIFY
	imply CMD_HASH
	imply HASH_VERIFY
	help
	  Samsung Exynos5 SoC family are based on ARM Cortex-A15 CPU (and
	  Cortex-A7 CPU in big.LITTLE configuration). There are multiple SoCs
	  in this family including Exynos5250, Exynos5420 and Exynos5800.

config ARCH_EXYNOS7
	bool "Exynos7 SoC family"
	select ARM64
	select BOARD_EARLY_INIT_F
	help
	  Samsung Exynos7 SoC family are based on ARM Cortex-A57 CPU or
	  Cortex-A53 CPU (and some in a big.LITTLE configuration). There are
	  multiple SoCs in this family including Exynos7420.

endchoice

if ARCH_EXYNOS4

choice
	prompt "EXYNOS4 board select"

config TARGET_SMDKV310
	select SUPPORT_SPL
	bool "Exynos4210 SMDKV310 board"
	select OF_CONTROL

config TARGET_TRATS
	bool "Exynos4210 Trats board"

config TARGET_S5PC210_UNIVERSAL
	bool "EXYNOS4210 Universal C210 board"

config TARGET_ORIGEN
	bool "Exynos4412 Origen board"
	select SUPPORT_SPL

config TARGET_TRATS2
	bool "Exynos4412 Trat2 board"

config TARGET_ODROID
	bool "Exynos4412 Odroid board"

endchoice
endif

if ARCH_EXYNOS5

config SPL_GPIO_SUPPORT
	default y

config SPL_LIBCOMMON_SUPPORT
	default y

config SPL_LIBGENERIC_SUPPORT
	default y

choice
	prompt "EXYNOS5 board select"

config TARGET_ODROID_XU3
	bool "Exynos5422 Odroid board"
	select OF_CONTROL

config TARGET_ARNDALE
	bool "Exynos5250 Arndale board"
	select ARM_ERRATA_773022
	select ARM_ERRATA_774769
	select CPU_V7_HAS_NONSEC
	select CPU_V7_HAS_VIRT
	select SUPPORT_SPL
	select OF_CONTROL

config TARGET_SMDK5250
	bool "SMDK5250 board"
	select SUPPORT_SPL
	select OF_CONTROL

config TARGET_SNOW
	bool "Snow board"
	select SUPPORT_SPL
	select OF_CONTROL

config TARGET_SPRING
	bool "Spring board"
	select SUPPORT_SPL
	select OF_CONTROL
	select SPL_DISABLE_OF_CONTROL

config TARGET_SMDK5420
	bool "SMDK5420 board"
	select SUPPORT_SPL
	select OF_CONTROL

config TARGET_PEACH_PI
	bool "Peach Pi board"
	select SUPPORT_SPL
	select OF_CONTROL

config TARGET_PEACH_PIT
	bool "Peach Pit board"
	select SUPPORT_SPL
	select OF_CONTROL

endchoice
endif

if ARCH_EXYNOS7

choice
	prompt "EXYNOS7 board select"

config  TARGET_ESPRESSO7420
	bool "ESPRESSO7420 board"
	select ARM64
	select ARMV8_MULTIENTRY
	select SUPPORT_SPL
	select OF_CONTROL
	select SPL_DISABLE_OF_CONTROL
	select PINCTRL
	select PINCTRL_EXYNOS7420
	select CLK_EXYNOS

endchoice
endif

config SYS_SOC
	default "exynos"

source "board/samsung/smdkv310/Kconfig"
source "board/samsung/trats/Kconfig"
source "board/samsung/universal_c210/Kconfig"
source "board/samsung/origen/Kconfig"
source "board/samsung/trats2/Kconfig"
source "board/samsung/odroid/Kconfig"
source "board/samsung/arndale/Kconfig"
source "board/samsung/smdk5250/Kconfig"
source "board/samsung/smdk5420/Kconfig"
source "board/samsung/espresso7420/Kconfig"

endif
```

## arch/arm/mach-histb/Kconfig
```kconfig
if ARCH_HISTB

choice
	prompt "Select a HiSTB SoC"

config ARCH_HI3798MV2X
	bool "Hi3798M V2XX series SoC"
	select ARM64
	help
	  Support for Hi3798MV2XX series SoCs.

endchoice

endif
```

## arch/arm/mach-imx/Kconfig
```kconfig
config HAS_CAAM
	bool

config IMX_CONFIG
	string

config ROM_UNIFIED_SECTIONS
	bool

config SYSCOUNTER_TIMER
	bool

config GPT_TIMER
	bool

config IMX_RDC
	bool "i.MX Resource domain controller driver"
	depends on ARCH_MX6 || ARCH_MX7
	help
	  i.MX Resource domain controller is used to assign masters
	  and peripherals to differet domains. This can be used to
	  isolate resources.

config IMX_BOOTAUX
	bool "Support boot auxiliary core"
	depends on ARCH_MX7 || ARCH_MX6 || ARCH_VF610
	help
	  bootaux [addr] to boot auxiliary core.

config USE_IMXIMG_PLUGIN
	bool "Use imximage plugin code"
	depends on ARCH_MX7 || ARCH_MX6 || ARCH_MX7ULP
	help
	  i.MX6/7 supports DCD and Plugin. Enable this configuration
	  to use Plugin, otherwise DCD will be used.

config IMX_HAB
	bool "Support i.MX HAB features"
	depends on ARCH_MX7 || ARCH_MX6 || ARCH_MX5
	select FSL_CAAM if HAS_CAAM
	imply CMD_DEKBLOB
	help
	  This option enables the support for secure boot (HAB).
	  See doc/README.mxc_hab for more details.

config CSF_SIZE
	hex "Maximum size for Command Sequence File (CSF) binary"
	default 0x2060
	help
	  Define the maximum size for Command Sequence File (CSF) binary
	  this information is used to define the image boot data.

config CMD_BMODE
	bool "Support the 'bmode' command"
	default y
	depends on ARCH_MX6 || ARCH_MX5
	help
	  This enables the 'bmode' (bootmode) command for forcing
	  a boot from specific media.

	  This is useful for forcing the ROM's usb downloader to
	  activate upon a watchdog reset which is nice when iterating
	  on U-Boot.  Using the reset button or running bmode normal
	  will set it back to normal.  This command currently
	  supports i.MX53 and i.MX6.

config CMD_DEKBLOB
	bool "Support the 'dek_blob' command"
	help
	  This enables the 'dek_blob' command which is used with the
	  Freescale secure boot mechanism. This command encapsulates and
	  creates a blob of data. See also CMD_BLOB and doc/README.mxc_hab for
	  more information.

config CMD_HDMIDETECT
	bool "Support the 'hdmidet' command"
	help
	  This enables the 'hdmidet' command which detects if an HDMI monitor
	  is connected.

config CMD_NANDBCB
	bool "i.MX6 NAND Boot Control Block(BCB) command"
	depends on MTD_RAW_NAND && CMD_MTDPARTS
	select BCH if MX6UL || MX6ULL
	default y if (ARCH_MX6 && NAND_MXS) || (ARCH_MX7 && NAND_MXS)
	help
	  Unlike normal 'nand write/erase' commands, this command update
	  Boot Control Block(BCB) for i.MX6 platform NAND IP's.

	  This is similar to kobs-ng, which is used in Linux as separate
	  rootfs package.

config NXP_BOARD_REVISION
	bool "Read NXP board revision from fuses"
	depends on ARCH_MX6 || ARCH_MX7
	help
	  NXP boards based on i.MX6/7 contain the board revision information
	  stored in the fuses. Select this option if you want to be able to
	  retrieve the board revision information.

config DDRMC_VF610_CALIBRATION
	bool "Enable DDRMC (DDR3) on-chip calibration"
	depends on ARCH_VF610
	help
	  Vybrid (vf610) SoC provides some on-chip facility to tune the DDR3
	  memory parameters. Select this option if you want to calculate them
	  at boot time.
	  NOTE:
	  NXP does NOT recommend to perform this calibration at each boot. One
	  shall perform it on a new PCB and then use those values to program
	  the ddrmc_cr_setting on relevant board file.

config SPL_IMX_ROMAPI_LOADADDR
	hex "Default load address to load image through ROM API"
	depends on IMX8MN
```

## arch/arm/mach-imx/imx8/Kconfig
```kconfig
if ARCH_IMX8

config IMX8
	bool

config MU_BASE_SPL
	hex "MU base address used in SPL"
	default 0x5d1b0000
	help
	  SPL runs in EL3 mode, it use MU0_A to communicate with SCU.
	  So we could not reuse the one in dts which is for normal U-Boot.

config IMX8QM
	select IMX8
	select SUPPORT_SPL
	bool

config IMX8QXP
	select IMX8
	select SUPPORT_SPL
	bool

config SYS_SOC
	default "imx8"

config SPL_LOAD_IMX_CONTAINER
	bool "Enable SPL loading U-Boot as a i.MX Container image"
	depends on SPL
	help
	  This is to let SPL could load i.MX8 Container image

config IMX_CONTAINER_CFG
	string "i.MX Container config file"
	depends on SPL
	help
	  This is to specific the cfg file for generating container
	  image which will be loaded by SPL.

choice
	prompt "i.MX8 board select"
	optional

config TARGET_APALIS_IMX8
	bool "Support Apalis iMX8 module"
	select BOARD_LATE_INIT
	select IMX8QM

config TARGET_COLIBRI_IMX8X
	bool "Support Colibri iMX8X module"
	select BOARD_LATE_INIT
	select IMX8QXP

config TARGET_IMX8QM_MEK
	bool "Support i.MX8QM MEK board"
	select BOARD_LATE_INIT
	select IMX8QM

config TARGET_IMX8QXP_MEK
	bool "Support i.MX8QXP MEK board"
	select BOARD_LATE_INIT
	select IMX8QXP

endchoice

source "board/freescale/imx8qm_mek/Kconfig"
source "board/freescale/imx8qxp_mek/Kconfig"
source "board/toradex/apalis-imx8/Kconfig"
source "board/toradex/colibri-imx8x/Kconfig"

endif
```

## arch/arm/mach-imx/imx8m/Kconfig
```kconfig
if ARCH_IMX8M

config IMX8M
	bool
	select HAS_CAAM
	select ROM_UNIFIED_SECTIONS

config IMX8MQ
	bool
	select IMX8M

config IMX8MM
	bool
	select IMX8M

config IMX8MN
	bool
	select IMX8M

config IMX8MP
	bool
	select IMX8M

config SYS_SOC
	default "imx8m"

choice
	prompt  "NXP i.MX8M board select"
	optional

config TARGET_IMX8MQ_CM
        bool "Ronetix iMX8MQ-CM SoM"
		select BINMAN
        select IMX8MQ
        select IMX8M_LPDDR4

config TARGET_IMX8MQ_EVK
	bool "imx8mq_evk"
	select IMX8MQ
	select IMX8M_LPDDR4

config TARGET_IMX8MQ_PHANBELL
        bool "imx8mq_phanbell"
        select IMX8MQ
        select IMX8M_LPDDR4

config TARGET_IMX8MM_EVK
	bool "imx8mm LPDDR4 EVK board"
	select BINMAN
	select IMX8MM
	select SUPPORT_SPL
	select IMX8M_LPDDR4

config TARGET_IMX8MM_ICORE_MX8MM
	bool "Engicam i.Core MX8M Mini SOM"
	select IMX8MM
	select SUPPORT_SPL
	select IMX8M_LPDDR4
	help
	  i.Core MX8M Mini is an EDIMM SOM based on NXP i.MX8MM.

	  i.Core MX8M Mini EDIMM2.2:
	  * EDIMM2.2 is a Form Factor Capacitive Evaluation Board.
	  * i.Core MX8M Mini needs to mount on top of EDIMM2.2 for
	    creating complete i.Core MX8M Mini EDIMM2.2 Starter Kit.

	  i.Core MX8M Mini C.TOUCH 2.0
	  * C.TOUCH 2.0 is a general purpose Carrier board.
	  * i.Core MX8M Mini needs to mount on top of this Carrier board
	    for creating complete i.Core MX8M Mini C.TOUCH 2.0 board.

config TARGET_IMX8MM_VENICE
	bool "Support Gateworks Venice iMX8M Mini module"
	select IMX8MM
	select SUPPORT_SPL
	select IMX8M_LPDDR4

config TARGET_IMX8MN_EVK
	bool "imx8mn LPDDR4 EVK board"
	select BINMAN
	select IMX8MN
	select SUPPORT_SPL
	select IMX8M_LPDDR4

config TARGET_IMX8MN_DDR4_EVK
	bool "imx8mn DDR4 EVK board"
	select BINMAN
	select IMX8MN
	select SUPPORT_SPL
	select IMX8M_DDR4

config TARGET_IMX8MP_EVK
	bool "imx8mp LPDDR4 EVK board"
	select BINMAN
	select IMX8MP
	select SUPPORT_SPL
	select IMX8M_LPDDR4

config TARGET_PICO_IMX8MQ
	bool "Support Technexion Pico iMX8MQ"
	select IMX8MQ
	select IMX8M_LPDDR4

config TARGET_VERDIN_IMX8MM
       bool "Support Toradex Verdin iMX8M Mini module"
       select IMX8MM
       select SUPPORT_SPL
       select IMX8M_LPDDR4

config TARGET_IMX8MM_BEACON
	bool "imx8mm Beacon Embedded devkit"
	select IMX8MM
	select SUPPORT_SPL
	select IMX8M_LPDDR4

config TARGET_IMX8MN_BEACON
	bool "imx8mn Beacon Embedded devkit"
	select IMX8MN
	select SUPPORT_SPL
	select IMX8M_LPDDR4

config TARGET_PHYCORE_IMX8MM
	bool "PHYTEC PHYCORE i.MX8MM"
	select IMX8MM
        select SUPPORT_SPL
	select IMX8M_LPDDR4

config TARGET_PHYCORE_IMX8MP
	bool "PHYTEC PHYCORE i.MX8MP"
	select BINMAN
	select IMX8MP
        select SUPPORT_SPL
	select IMX8M_LPDDR4

config TARGET_IMX8MM_CL_IOT_GATE
	bool "CompuLab iot-gate-imx8"
	select BINMAN
	select IMX8MM
	select SUPPORT_SPL
	select IMX8M_LPDDR4
endchoice

source "board/beacon/imx8mm/Kconfig"
source "board/beacon/imx8mn/Kconfig"
source "board/compulab/imx8mm-cl-iot-gate/Kconfig"
source "board/engicam/imx8mm/Kconfig"
source "board/freescale/imx8mq_evk/Kconfig"
source "board/freescale/imx8mm_evk/Kconfig"
source "board/freescale/imx8mn_evk/Kconfig"
source "board/freescale/imx8mp_evk/Kconfig"
source "board/gateworks/venice/Kconfig"
source "board/google/imx8mq_phanbell/Kconfig"
source "board/phytec/phycore_imx8mm/Kconfig"
source "board/phytec/phycore_imx8mp/Kconfig"
source "board/ronetix/imx8mq-cm/Kconfig"
source "board/technexion/pico-imx8mq/Kconfig"
source "board/toradex/verdin-imx8mm/Kconfig"

endif
```

## arch/arm/mach-imx/imx8ulp/Kconfig
```kconfig
if ARCH_IMX8ULP

config IMX8ULP
	bool

config SYS_SOC
	default "imx8ulp"

config IMX8ULP_LD_MODE
	bool

config IMX8ULP_ND_MODE
	bool "i.MX8ULP Low Driver Mode"

choice
	prompt "i.MX8ULP board select"
	optional

config TARGET_IMX8ULP_EVK
	bool "imx8ulp_evk"
	select IMX8ULP
	select SUPPORT_SPL

endchoice

source "board/freescale/imx8ulp_evk/Kconfig"

endif
```
