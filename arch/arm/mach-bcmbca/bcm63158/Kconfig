## arch/arm/mach-imx/mx7/Kconfig
```kconfig
if ARCH_MX7

config MX7
	bool
	default y
	select ARCH_SUPPORT_PSCI
	select CPU_V7_HAS_NONSEC
	select CPU_V7_HAS_VIRT
	select IOMUX_LPSR
	select ROM_UNIFIED_SECTIONS
	select SYSCOUNTER_TIMER
	imply CMD_FUSE

config MX7D
	bool
	select HAS_CAAM
	select ROM_UNIFIED_SECTIONS
	imply CMD_FUSE

choice
	prompt "MX7 board select"
	optional

config TARGET_CL_SOM_IMX7
	bool "CL-SOM-iMX7"
	select DM
	select DM_THERMAL
	select MX7D
	select SUPPORT_SPL
	imply CMD_DM

config TARGET_IMX7_CM
	bool "Ronetix iMX7-CM"
	select BOARD_LATE_INIT
	select DM
	select DM_THERMAL
	select MX7D
	select SUPPORT_SPL
	imply CMD_DM

config TARGET_MEERKAT96
	bool "NovTech Meerkat96 board"
	select BOARD_LATE_INIT
	select DM
	select DM_SERIAL
	select DM_THERMAL
	select MX7D
	imply CMD_DM

config TARGET_MX7DSABRESD
	bool "mx7dsabresd"
	select BOARD_LATE_INIT
	select DM
	select DM_THERMAL
	select MX7D
	imply CMD_DM
	select FSL_CAAM

config TARGET_PICO_IMX7D
	bool "pico-imx7d"
	select BOARD_LATE_INIT
	select DM
	select DM_THERMAL
	select MX7D
	select SUPPORT_SPL
	imply CMD_DM

config TARGET_SMEGW01
	bool "smegw01"
	select BOARD_LATE_INIT
	select DM
	select DM_THERMAL
	select MX7D
	imply CMD_DM

config TARGET_WARP7
	bool "warp7"
	select BOARD_LATE_INIT
	select DM
	select DM_THERMAL
	select MX7D
	imply CMD_DM
	imply OF_UPSTREAM

config TARGET_COLIBRI_IMX7
	bool "Support Colibri iMX7S/iMX7D modules"
	select DM
	select DM_SERIAL
	select DM_THERMAL
	select MX7D
	imply CMD_DM

config TARGET_TQMA7
	bool "TQ-Systems TQMa7x SoM"
	select BOARD_LATE_INIT
	select SUPPORT_SPL
	select SPL_SEPARATE_BSS if SPL
	select DM
	select DM_SERIAL
	select MX7
	imply MX7D
	imply CMD_DM
	imply DM_THERMAL
	help
	  TQMa7x is a TQ SoM with i.MX7 CPU
	  The SoM can be used on various baseboards.

endchoice

config SYS_SOC
	default "mx7"

source "board/compulab/cl-som-imx7/Kconfig"
source "board/ronetix/imx7-cm/Kconfig"
source "board/nxp/mx7dsabresd/Kconfig"
source "board/novtech/meerkat96/Kconfig"
source "board/storopack/smegw01/Kconfig"
source "board/technexion/pico-imx7d/Kconfig"
source "board/toradex/colibri_imx7/Kconfig"
source "board/tq/tqma7/Kconfig"
source "board/warp7/Kconfig"

endif
```

## arch/arm/mach-imx/mx7ulp/Kconfig
```kconfig
if ARCH_MX7ULP

config SYS_SOC
	default "mx7ulp"

config LDO_ENABLED_MODE
	bool "i.MX7ULP LDO Enabled Mode"
	help
	  Select this option to enable the PMC1 LDO.

config MX7ULP
	select HAS_CAAM
	bool

choice
	prompt "MX7ULP board select"
	optional

config TARGET_MX7ULP_COM
	bool "Support MX7ULP COM board"
	select MX7ULP
	select SYS_ARCH_TIMER

config TARGET_MX7ULP_EVK
	bool "Support mx7ulp EVK board"
	select MX7ULP
	select SYS_ARCH_TIMER

endchoice

source "board/ea/mx7ulp_com/Kconfig"
source "board/freescale/mx7ulp_evk/Kconfig"

endif
```

## arch/arm/mach-imx/mx8m/Kconfig
```kconfig
if ARCH_MX8M

config MX8M
	bool
	select ROM_UNIFIED_SECTIONS

config SYS_SOC
	default "mx8m"

endif
```

## arch/arm/mach-imx/mxs/Kconfig
```kconfig
if ARCH_MX23

config MX23
	bool
	default y

choice
	prompt "MX23 board select"
	optional

config TARGET_MX23_OLINUXINO
	bool "Support mx23_olinuxino"
	select BOARD_EARLY_INIT_F

config TARGET_MX23EVK
	bool "Support mx23evk"
	select BOARD_EARLY_INIT_F

config TARGET_SANSA_FUZE_PLUS
	bool "Support sansa_fuze_plus"

config TARGET_XFI3
	bool "Support xfi3"

endchoice

config SYS_SOC
	default "mxs"

source "board/olimex/mx23_olinuxino/Kconfig"
source "board/freescale/mx23evk/Kconfig"
source "board/sandisk/sansa_fuze_plus/Kconfig"
source "board/creative/xfi3/Kconfig"

endif
```

## arch/arm/mach-integrator/Kconfig
```kconfig
menu "Integrator Options"
	depends on ARCH_INTEGRATOR

choice
	prompt "ARM Ltd. Integrator board select"

config TARGET_INTEGRATORAP_CM720T
	bool "Support integratorap_cm720t"
	select CPU_ARM720T

config TARGET_INTEGRATORAP_CM920T
	bool "Support integratorap_cm920t"
	select CPU_ARM920T

config TARGET_INTEGRATORCP_CM920T
	bool "Support integratorcp_cm920t"
	select CPU_ARM920T

config TARGET_INTEGRATORAP_CM926EJS
	bool "Support integratorap_cm926ejs"
	select CPU_ARM926EJS

config TARGET_INTEGRATORCP_CM926EJS
	bool "Support integratorcp_cm926ejs"
	select CPU_ARM926EJS

config TARGET_INTEGRATORCP_CM1136
	bool "Support integratorcp_cm1136"
	select CPU_ARM1136

config TARGET_INTEGRATORAP_CM946ES
	bool "Support integratorap_cm946es"
	select CPU_ARM946ES

config TARGET_INTEGRATORCP_CM946ES
	bool "Support integratorcp_cm946es"
	select CPU_ARM946ES

endchoice

config SYS_BOARD
	default "integrator"

config SYS_VENDOR
	default "armltd"

config SYS_CONFIG_NAME
	default "integratorap" if TARGET_INTEGRATORAP_CM720T || \
				  TARGET_INTEGRATORAP_CM920T || \
				  TARGET_INTEGRATORAP_CM926EJS || \
				  TARGET_INTEGRATORAP_CM946ES
	default "integratorcp" if TARGET_INTEGRATORCP_CM920T || \
				  TARGET_INTEGRATORCP_CM926EJS || \
				  TARGET_INTEGRATORCP_CM946ES || \
				  TARGET_INTEGRATORCP_CM1136

endmenu
```

## arch/arm/mach-k3/Kconfig
```kconfig
if ARCH_K3

choice
	prompt "Texas Instruments' K3 based SoC select"
	optional

config SOC_K3_AM6
	bool "TI's K3 based AM6 SoC Family Support"

config SOC_K3_J721E
	bool "TI's K3 based J721E SoC Family Support"

config SOC_K3_J721S2
	bool "TI's K3 based J721S2 SoC Family Support"

config SOC_K3_AM642
	bool "TI's K3 based AM642 SoC Family Support"

endchoice

config SYS_SOC
	default "k3"

config SYS_K3_NON_SECURE_MSRAM_SIZE
	hex
	default 0x80000 if SOC_K3_AM6
	default 0x100000 if SOC_K3_J721E || SOC_K3_J721S2
	default 0x1c0000 if SOC_K3_AM642
	help
	  Describes the total size of the MCU or OCMC MSRAM present on
	  the SoC in use. This doesn't specify the total size of SPL as
	  ROM can use some part of this RAM. Once ROM gives control to
	  SPL then this complete size can be usable.

config SYS_K3_MAX_DOWNLODABLE_IMAGE_SIZE
	hex
	default 0x58000 if SOC_K3_AM6
	default 0xc0000 if SOC_K3_J721E || SOC_K3_J721S2
	default 0x180000 if SOC_K3_AM642
	help
	  Describes the maximum size of the image that ROM can download
	  from any boot media.

config SYS_K3_MCU_SCRATCHPAD_BASE
	hex
	default 0x40280000 if SOC_K3_AM6
	default 0x40280000 if SOC_K3_J721E || SOC_K3_J721S2
	help
	  Describes the base address of MCU Scratchpad RAM.

config SYS_K3_MCU_SCRATCHPAD_SIZE
	hex
	default 0x200 if SOC_K3_AM6
	default 0x200 if SOC_K3_J721E || SOC_K3_J721S2
	help
	  Describes the size of MCU Scratchpad RAM.

config SYS_K3_BOOT_PARAM_TABLE_INDEX
	hex
	default 0x41c7fbfc if SOC_K3_AM6
	default 0x41cffbfc if SOC_K3_J721E
	default 0x41cfdbfc if SOC_K3_J721S2
	default 0x701bebfc if SOC_K3_AM642
	help
	  Address at which ROM stores the value which determines if SPL
	  is booted up by primary boot media or secondary boot media.

config SYS_K3_KEY
	string "Key used to generate x509 certificate"
	help
	  This option enables to provide a custom key that can be used for
	  generating x509 certificate for spl binary. If not needed leave
	  it blank so that a random key is generated and used.

config SYS_K3_BOOT_CORE_ID
	int
	default 16

config K3_EARLY_CONS
	bool "Activate to allow for an early console during SPL"
	depends on SPL
	help
	  Turn this option on to enable an early console functionality in SPL
	  before the main console is being brought up. This can be useful in
	  situations where the main console is dependent on System Firmware
	  (SYSFW) being up and running, which is usually not the case during
	  the very early stages of boot. Using this early console functionality
	  will allow for an alternate serial port to be used to support things
	  like UART-based boot and early diagnostic messages until the main
	  console is ready to get activated.

config K3_EARLY_CONS_IDX
	depends on K3_EARLY_CONS
	int "Index of serial device to use for SPL early console"
	default 1
	help
	  Use this option to set the index of the serial device to be used
	  for the early console during SPL execution.

config K3_LOAD_SYSFW
	bool
	depends on SPL

config K3_SYSFW_IMAGE_NAME
	string "File name of SYSFW firmware and configuration blob"
	depends on K3_LOAD_SYSFW
	default	"sysfw.itb"
	help
	  Filename of the combined System Firmware and configuration image tree
	  blob to be loaded when booting from a filesystem.

config K3_SYSFW_IMAGE_MMCSD_RAW_MODE_SECT
	hex "MMC sector to load SYSFW firmware and configuration blob from"
	depends on K3_LOAD_SYSFW && SYS_MMCSD_RAW_MODE_U_BOOT_USE_SECTOR
	default 0x3600
	help
	  Address on the MMC to load the combined System Firmware and
	  configuration image tree blob from, when the MMC is being used
	  in raw mode. Units: MMC sectors (1 sector = 512 bytes).

config K3_SYSFW_IMAGE_MMCSD_RAW_MODE_PART
	hex "MMC partition to load SYSFW firmware and configuration blob from"
	depends on K3_LOAD_SYSFW && SYS_MMCSD_RAW_MODE_U_BOOT_USE_PARTITION
	default 2
	help
	  Partition on the MMC to the combined System Firmware and configuration
	  image tree blob from, when the MMC is being used in raw mode.

config K3_SYSFW_IMAGE_SIZE_MAX
	int "Amount of memory dynamically allocated for loading SYSFW blob"
	depends on K3_LOAD_SYSFW
	default	278000
	help
	  Amount of memory (in bytes) reserved through dynamic allocation at
	  runtime for loading the combined System Firmware and configuration image
	  tree blob. Keep it as tight as possible, as this directly affects the
	  overall SPL memory footprint.

config K3_SYSFW_IMAGE_SPI_OFFS
	hex "SPI offset of SYSFW firmware and configuration blob"
	depends on K3_LOAD_SYSFW
	default	0x6C0000
	help
	  Offset of the combined System Firmware and configuration image tree
	  blob to be loaded when booting from a SPI flash memory.

config SYS_K3_SPL_ATF
	bool "Start Cortex-A from SPL"
	depends on SPL && CPU_V7R
	help
	  Enabling this will try to start Cortex-A (typically with ATF)
	  after SPL from R5.

config K3_ATF_LOAD_ADDR
	hex "Load address of ATF image"
	default 0x70000000
	help
	  The load address for the ATF image. This value defaults to 0x70000000
	  if not provided in the board defconfig file.

config K3_DM_FW
	bool "Separate DM firmware image"
	depends on SPL && CPU_V7R && (SOC_K3_J721E || SOC_K3_J721S2) && !CLK_TI_SCI && !TI_SCI_POWER_DOMAIN
	default y
	help
	  Enabling this will indicate that the system has separate DM
	  and TIFS firmware images in place, instead of a single SYSFW
	  firmware. Due to DM being executed on the same core as R5 SPL
	  bootloader, it makes RM and PM services not being available
	  during R5 SPL execution time.

source "board/ti/am65x/Kconfig"
source "board/ti/am64x/Kconfig"
source "board/ti/j721e/Kconfig"
source "board/siemens/iot2050/Kconfig"
source "board/ti/j721s2/Kconfig"
endif
```
