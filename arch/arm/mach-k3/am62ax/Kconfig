## arch/arm/mach-k3/am62ax/Kconfig
```kconfig
# SPDX-License-Identifier: GPL-2.0+
#
# Copyright (C) 2023 Texas Instruments Incorporated - https://www.ti.com/
#	Andrew Davis <afd@ti.com>

if SOC_K3_AM62A7

choice
	prompt "K3 AM62Ax based boards"
	optional

config TARGET_AM62A7_A53_EVM
	bool "TI K3 based AM62A7 EVM running on A53"
	select ARM64
	select BINMAN
	select OF_SYSTEM_SETUP
	imply BOARD
	imply SPL_BOARD
	imply TI_I2C_BOARD_DETECT

config TARGET_AM62A7_R5_EVM
	bool "TI K3 based AM62A7 EVM running on R5"
	select CPU_V7R
	select SYS_THUMB_BUILD
	select K3_LOAD_SYSFW
	select RAM
	select SPL_RAM
	select K3_DDRSS
	select BINMAN
	imply SYS_K3_SPL_ATF
	imply TI_I2C_BOARD_DETECT

config TARGET_PHYCORE_AM62AX_A53
	bool "PHYTEC phyCORE-AM62Ax running on A53"
	select ARM64
	select BINMAN
	select OF_SYSTEM_SETUP
	imply OF_UPSTREAM
	imply BOARD
	imply SPL_BOARD

config TARGET_PHYCORE_AM62AX_R5
	bool "PHYTEC phyCORE-AM62Ax running on R5"
	select CPU_V7R
	select SYS_THUMB_BUILD
	select K3_LOAD_SYSFW
	select RAM
	select SPL_RAM
	select K3_DDRSS
	select BINMAN
	imply SYS_K3_SPL_ATF

endchoice

source "board/ti/am62ax/Kconfig"
source "board/phytec/phycore_am62ax/Kconfig"

endif
```

## arch/arm/mach-k3/am62px/Kconfig
```kconfig
# SPDX-License-Identifier: GPL-2.0+
#
# Copyright (C) 2024 Texas Instruments Incorporated - https://www.ti.com/
#

if SOC_K3_AM62P5

choice
	prompt "TI K3 AM62Px based boards"
	optional

config TARGET_AM62P5_A53_EVM
	bool "TI K3 based AM62P5 EVM running on A53"
	select ARM64
	select BINMAN
	select OF_SYSTEM_SETUP

config TARGET_AM62P5_R5_EVM
	bool "TI K3 based AM62P5 EVM running on R5"
	select CPU_V7R
	select SYS_THUMB_BUILD
	select K3_LOAD_SYSFW
	select RAM
	select SPL_RAM
	select K3_DDRSS
	select BINMAN
	imply SYS_K3_SPL_ATF

endchoice

source "board/ti/am62px/Kconfig"
source "board/toradex/verdin-am62p/Kconfig"

endif
```

## arch/arm/mach-k3/j7200/Kconfig
```kconfig
# SPDX-License-Identifier: GPL-2.0+
#
# Copyright (C) 2025 Texas Instruments Incorporated - https://www.ti.com/
#	Andrew Davis <afd@ti.com>

if SOC_K3_J7200

choice
	prompt "K3 J7200 based boards"
	optional

config TARGET_J7200_A72_EVM
	bool "TI K3 based J7200 EVM running on A72"
	select ARM64
	select BOARD_LATE_INIT
	imply TI_I2C_BOARD_DETECT
	select SYS_DISABLE_DCACHE_OPS
	select BINMAN

config TARGET_J7200_R5_EVM
	bool "TI K3 based J7200 EVM running on R5"
	select CPU_V7R
	select SYS_THUMB_BUILD
	select K3_LOAD_SYSFW
	select RAM
	select SPL_RAM
	select K3_DDRSS
	select BINMAN
	imply SYS_K3_SPL_ATF
	imply TI_I2C_BOARD_DETECT

endchoice

source "board/ti/j7200/Kconfig"

endif
```

## arch/arm/mach-k3/j722s/Kconfig
```kconfig
# SPDX-License-Identifier: GPL-2.0+
#
# Copyright (C) 2024 Texas Instruments Incorporated - https://www.ti.com/
#

if SOC_K3_J722S

choice
	prompt "TI K3 J722S based boards"
	optional

config TARGET_J722S_A53_EVM
	bool "TI K3 based J722S EVM running on A53"
	select ARM64
	select BINMAN
	select OF_SYSTEM_SETUP

config TARGET_J722S_R5_EVM
	bool "TI K3 based J722S EVM running on R5"
	select CPU_V7R
	select SYS_THUMB_BUILD
	select K3_LOAD_SYSFW
	select RAM
	select SPL_RAM
	select K3_DDRSS
	select BINMAN
	imply SYS_K3_SPL_ATF

config TARGET_J722S_A53_BEAGLEY_AI
	bool "BeagleBoard.org BeagleY-AI running on A53"
	select ARM64
	select BINMAN
	select OF_SYSTEM_SETUP

config TARGET_J722S_R5_BEAGLEY_AI
	bool "BeagleBoard.org BeagleY-AI running on R5"
	select CPU_V7R
	select SYS_THUMB_BUILD
	select K3_LOAD_SYSFW
	select RAM
	select SPL_RAM
	select K3_DDRSS
	select BINMAN
	imply SYS_K3_SPL_ATF

endchoice

source "board/ti/j722s/Kconfig"
source "board/beagle/beagley-ai/Kconfig"

endif
```

## arch/arm/mach-k3/j784s4/Kconfig
```kconfig
# SPDX-License-Identifier: GPL-2.0-or-later
#
# Copyright (C) 2023-2024 Texas Instruments Incorporated - https://www.ti.com/
#	Hari Nagalla <hnagalla@ti.com>

if SOC_K3_J784S4

choice
	prompt "K3 J784S4 board"
	optional

config TARGET_J784S4_A72_EVM
	bool "TI K3 based J784S4 EVM running on A72"
	select ARM64
	select BOARD_LATE_INIT
	select SYS_DISABLE_DCACHE_OPS
	select BINMAN

config TARGET_J784S4_R5_EVM
	bool "TI K3 based J784S4 EVM running on R5"
	select CPU_V7R
	select SYS_THUMB_BUILD
	select K3_LOAD_SYSFW
	select RAM
	select SPL_RAM
	select K3_DDRSS
	select BINMAN
	imply SYS_K3_SPL_ATF

config TARGET_J742S2_A72_EVM
	bool "TI K3 based J742S2 EVM running on A72"
	select ARM64
	select BOARD_LATE_INIT
	select SYS_DISABLE_DCACHE_OPS
	select BINMAN

config TARGET_J742S2_R5_EVM
	bool "TI K3 based J742S2 EVM running on R5"
	select CPU_V7R
	select SYS_THUMB_BUILD
	select K3_LOAD_SYSFW
	select RAM
	select SPL_RAM
	select K3_DDRSS
	select BINMAN
	imply SYS_K3_SPL_ATF

endchoice

source "board/ti/j784s4/Kconfig"

endif
```

## arch/arm/mach-keystone/Kconfig
```kconfig
if ARCH_KEYSTONE

choice
	prompt "TI Keystone board select"
	optional

config TARGET_K2HK_EVM
	bool "TI Keystone 2 Kepler/Hawking EVM"
	select SOC_K2HK
	select SPL_BOARD_INIT if SPL
	select CMD_DDR3
	imply DM_I2C
	imply SOC_TI
	imply TI_KEYSTONE_SERDES

config TARGET_K2E_EVM
	bool "TI Keystone 2 Edison EVM"
	select SOC_K2E
	select SPL_BOARD_INIT if SPL
	select CMD_DDR3
	imply DM_I2C
	imply SOC_TI
	imply TI_KEYSTONE_SERDES

config TARGET_K2L_EVM
	bool "TI Keystone 2 Lamar EVM"
	select SOC_K2L
	select SPL_BOARD_INIT if SPL
	select CMD_DDR3
	imply DM_I2C
	imply SOC_TI
	imply TI_KEYSTONE_SERDES

config TARGET_K2G_EVM
	bool "TI Keystone 2 Galileo EVM"
        select BOARD_LATE_INIT
	select SOC_K2G
	select SPL_BOARD_INIT if SPL
        select TI_I2C_BOARD_DETECT
	select CMD_DDR3
	imply DM_I2C
	imply SOC_TI
	imply TI_KEYSTONE_SERDES

endchoice

config SOC_K2E
	bool

config SOC_K2G
	bool

config SOC_K2HK
	bool

config SOC_K2L
	bool

config SYS_SOC
	default "keystone"

source "board/ti/ks2_evm/Kconfig"

endif
```

## arch/arm/mach-kirkwood/Kconfig
```kconfig
if ARCH_KIRKWOOD

config FEROCEON_88FR131
	bool

config KW88F6192
	bool

config KW88F6281
	bool

config SHEEVA_88SV131
	bool

choice
	prompt "Marvell Kirkwood board select"
	optional

config TARGET_OPENRD
	bool "Marvell OpenRD Board"
	select KW88F6281
	select SHEEVA_88SV131

config TARGET_DREAMPLUG
	bool "DreamPlug Board"
	select KW88F6281
	select SHEEVA_88SV131

config TARGET_DS109
	bool "Synology DS109"
	select KW88F6281
	select SHEEVA_88SV131

config TARGET_GURUPLUG
	bool "GuruPlug Board"
	select KW88F6281
	select SHEEVA_88SV131

config TARGET_SHEEVAPLUG
	bool "SheevaPlug Board"
	select FEROCEON_88FR131
	select KW88F6281

config TARGET_LSXL
	bool "lsxl Board"
	select FEROCEON_88FR131
	select KW88F6281

config TARGET_POGO_E02
	bool "pogo_e02 Board"
	select FEROCEON_88FR131
	select KW88F6281

config TARGET_POGO_V4
	bool "Pogoplug V4 Board"
	select FEROCEON_88FR131
	select KW88F6192

config TARGET_DNS325
	bool "dns325 Board"
	select FEROCEON_88FR131
	select KW88F6281

config TARGET_ICONNECT
	bool "iconnect Board"
	select FEROCEON_88FR131
	select KW88F6281

config TARGET_KM_KIRKWOOD
	bool "KM Kirkwood Board"
	select FEROCEON_88FR131
	select KW88F6281
	select VENDOR_KM

config TARGET_NET2BIG_V2
	bool "LaCie 2Big Network v2 NAS Board"
	select FEROCEON_88FR131
	select KW88F6281

config TARGET_NETSPACE_V2
	bool "LaCie netspace_v2 Board"
	select FEROCEON_88FR131

config TARGET_IB62X0
	bool "ib62x0 Board"
	select FEROCEON_88FR131
	select KW88F6281

config TARGET_DOCKSTAR
	bool "Dockstar Board"
	select FEROCEON_88FR131
	select KW88F6281

config TARGET_GOFLEXHOME
	bool "GoFlex Home Board"
	select FEROCEON_88FR131
	select KW88F6281

config TARGET_NAS220
	bool "BlackArmor NAS220"
	select FEROCEON_88FR131
	select KW88F6192

config TARGET_NSA310S
	bool "Zyxel NSA310S"
	select FEROCEON_88FR131
	select KW88F6192

config TARGET_SBx81LIFKW
	bool "Allied Telesis SBx81GS24/SBx81GT40/SBx81XS6/SBx81XS16"
	select FEROCEON_88FR131
	select KW88F6281

config TARGET_SBx81LIFXCAT
	bool "Allied Telesis SBx81GP24/SBx81GT24"
	select FEROCEON_88FR131
	select KW88F6281

endchoice

config SYS_SOC
	default "kirkwood"

source "board/Marvell/openrd/Kconfig"
source "board/Marvell/dreamplug/Kconfig"
source "board/Synology/ds109/Kconfig"
source "board/Marvell/guruplug/Kconfig"
source "board/Marvell/sheevaplug/Kconfig"
source "board/buffalo/lsxl/Kconfig"
source "board/cloudengines/pogo_e02/Kconfig"
source "board/cloudengines/pogo_v4/Kconfig"
source "board/d-link/dns325/Kconfig"
source "board/iomega/iconnect/Kconfig"
source "board/LaCie/net2big_v2/Kconfig"
source "board/LaCie/netspace_v2/Kconfig"
source "board/raidsonic/ib62x0/Kconfig"
source "board/Seagate/dockstar/Kconfig"
source "board/Seagate/goflexhome/Kconfig"
source "board/Seagate/nas220/Kconfig"
source "board/zyxel/nsa310s/Kconfig"
source "board/alliedtelesis/SBx81LIFKW/Kconfig"
source "board/alliedtelesis/SBx81LIFXCAT/Kconfig"

endif
```

## arch/arm/mach-litesom/Kconfig
```kconfig
config LITESOM
	bool
	select MX6UL
	select DM
	select DM_THERMAL
	select SUPPORT_SPL
```

## arch/arm/mach-lpc32xx/Kconfig
```kconfig
if ARCH_LPC32XX

config SYS_SOC
	default "lpc32xx"

choice
	prompt "NXP LPC32xx board select"

config TARGET_DEVKIT3250
	bool "Timll DevKit3250"

config TARGET_WORK_92105
	bool "Work Microwave Work_92105"

config TARGET_EA_LPC3250DEVKITV2
	bool "Embedded Artists LPC3250 Developer's Kit v2"

endchoice

choice
	prompt "LPC32xx clock source for standard UARTs"
	help
		Select clock source for standard UART baudrate divider.

config LPC32XX_UART_PERIPH_CLK
	bool "PERIPH as clock source"
	help
		Slower than HCLK, less resolution, lower power consumption.

config LPC32XX_UART_HCLK_CLK
	bool "HCLK as clock source"
	help
		Faster than PERIPH, better resolution, higher power consumption.

endchoice

config LPC32XX_OSC_CLK_FREQUENCY
	int "LPC32xx external XTAL OSC or clock source frequency"
	default 13000000
	help
		LPC32xx external XTAL OSC or clock source frequency.

source "board/timll/devkit3250/Kconfig"
source "board/work-microwave/work_92105/Kconfig"
source "board/ea/ea-lpc3250devkitv2/Kconfig"

endif
```

## arch/arm/mach-mediatek/Kconfig
```kconfig
if ARCH_MEDIATEK

config SYS_SOC
	default "mediatek"

config SYS_VENDOR
	default "mediatek"

config MT8512
	bool "MediaTek MT8512 SoC"
	default n

choice
	prompt "MediaTek board select"

config TARGET_MT7622
	bool "MediaTek MT7622 SoC"
	select ARM64
	help
	  The MediaTek MT7622 is a ARM64-based SoC with a dual-core Cortex-A53.
	  including UART, SPI, USB3.0, SD and MMC cards, NAND, SNFI, PWM, PCIe,
	  Gigabit Ethernet, I2C, built-in Wi-Fi, and PCIe.

config TARGET_MT7623
	bool "MediaTek MT7623 SoC"
	select CPU_V7A
	help
	  The MediaTek MT7623 is a ARM-based SoC with a quad-core Cortex-A7
	  including NEON and GPU, Mali-450 graphics, several DDR3 options,
	  crypto engine, built-in Wi-Fi / Bluetooth combo chip, JPEG decoder,
	  video interfaces supporting HDMI and MIPI, and video codec support.
	  Peripherals include Gigabit Ethernet, switch, USB3.0 and OTG, PCIe,
	  I2S, PCM, S/PDIF, UART, SPI, I2C, IR TX/RX, and PWM.

config TARGET_MT7629
	bool "MediaTek MT7629 SoC"
	select CPU_V7A
	select SPL
	help
	  The MediaTek MT7629 is a ARM-based SoC with a dual-core Cortex-A7
	  including DDR3, crypto engine, 3x3 11n/ac Wi-Fi, Gigabit Ethernet,
	  switch, USB3.0, PCIe, UART, SPI, I2C and PWM.

config TARGET_MT8183
	bool "MediaTek MT8183 SoC"
	select ARM64
	help
	  The MediaTek MT8183 is a ARM64-based SoC with a quad-core Cortex-A73 and
	  a quad-core Cortex-A53. It is including UART, SPI, USB3.0 dual role,
	  SD and MMC cards, UFS, PWM, I2C, I2S, S/PDIF, and several LPDDR3
	  and LPDDR4 options.

config TARGET_MT8512
        bool "MediaTek MT8512 M1 Board"
        select ARM64
	select MT8512
        help
          The MediaTek MT8512 is a ARM64-based SoC with a dual-core Cortex-A53.
          including UART, SPI, USB2.0 and OTG, SD and MMC cards, NAND, PWM,
          IR RX, I2C, I2S, S/PDIF, and built-in Wi-Fi / Bluetooth digital
          and several LPDDR3 and LPDDR4 options.

config TARGET_MT8516
	bool "MediaTek MT8516 SoC"
	select ARM64
	help
	  The MediaTek MT8516 is a ARM64-based SoC with a quad-core Cortex-A35.
	  including UART, SPI, USB2.0 and OTG, SD and MMC cards, NAND, PWM,
	  Ethernet, IR TX/RX, I2C, I2S, S/PDIF, and built-in Wi-Fi / Bluetooth combo
	  chip and several DDR3 and DDR4 options.

config TARGET_MT8518
	bool "MediaTek MT8518 SoC"
	select ARM64
	help
	  The MediaTek MT8518 is a ARM64-based SoC with a quad-core Cortex-A53.
	  including UART, SPI, USB2.0 and OTG, SD and MMC cards, NAND, PWM,
	  Ethernet, IR TX/RX, I2C, I2S, S/PDIF, and built-in Wi-Fi / Bluetooth combo
	  chip and several DDR3 and DDR4 options.

endchoice

source "board/mediatek/mt7622/Kconfig"
source "board/mediatek/mt7623/Kconfig"
source "board/mediatek/mt7629/Kconfig"
source "board/mediatek/mt8183/Kconfig"
source "board/mediatek/mt8512/Kconfig"
source "board/mediatek/mt8516/Kconfig"
source "board/mediatek/mt8518/Kconfig"

endif
```

## arch/arm/mach-mediatek/mt6735/u-boot.its
```
/dts-v1/;

/ {
    description = "FIT with ATF and U-Boot Proper for MT6735";
    #address-cells = <1>;

        images {

            uboot {
                description = "U-Boot Proper";
                data = /incbin/("u-boot.bin");
                type = "standalone";
                os = "U-Boot";
                arch = "arm64";
                compression = "none";
                load = <0x41e00000>;
                entry = <0x41e00000>;
            };

            atf {
                description = "ARM Trusted Firmware";
                type = "firmware";
                os = "arm-trusted-firmware";
                arch = "arm64";
                compression = "none";
                load = <0x43000000>;
                entry = <0x43000000>;
                data = /incbin/("bl31.bin");
            };

            fdt-1 {
                description = "mt6735-test.dtb";
                data = /incbin/("arch/arm/dts/mt6735-test.dtb");
                type = "flat_dt";
                compression = "none";
            };
        };

        configurations {
            default = "config-1";
            config-1 {
                description = "mt6735-test.dtb";
                firmware = "atf";
                loadables = "uboot";
                fdt = "fdt-1";
            };
        };
};
```
