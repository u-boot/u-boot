## arch/arm/mach-meson/Kconfig
```kconfig
if ARCH_MESON

config MESON64_COMMON
	bool
	select ARM64
	select CLK
	select DM
	select DM_SERIAL
	select SYSCON
	select REGMAP
	select PWRSEQ
	select MMC_PWRSEQ
	select BOARD_LATE_INIT
	select MESON_SM
	imply CMD_DM

config MESON_GX
	bool
	select MESON64_COMMON
	select SUPPORT_SPL
	select BINMAN if SPL

choice
	prompt "Platform select"
	default MESON_GXBB

config MESON_GXBB
	bool "GXBB"
	select MESON_GX
	imply OF_UPSTREAM
	help
	  Select this if your SoC is an S905

config MESON_GXL
	bool "GXL"
	select MESON_GX
	imply OF_UPSTREAM
	help
	  Select this if your SoC is an S905X/D or S805X

config MESON_GXM
	bool "GXM"
	select MESON_GX
	imply OF_UPSTREAM
	help
	  Select this if your SoC is an S912

config MESON_AXG
	bool "AXG"
	select MESON64_COMMON
	imply OF_UPSTREAM
	help
	  Select this if your SoC is an A113X/D

config MESON_G12A
	bool "G12A"
	select MESON64_COMMON
	imply OF_UPSTREAM
	help
	  Select this if your SoC is an S905X/D2

config MESON_A1
	bool "A1"
	select MESON64_COMMON
	help
	  Select this if your SoC is an A113L

endchoice

config SYS_SOC
	default "meson"

config SYS_MALLOC_F_LEN
	default 0x2000

config SYS_VENDOR
	string "Vendor name"
	default "amlogic"
	help
	  This option contains information about board name.
	  Based on this option board/<CONFIG_SYS_VENDOR>/<CONFIG_SYS_BOARD> will
	  be used.

config SYS_BOARD
	string "Board name"
	default "ad401" if MESON_A1
	default "p200" if MESON_GXBB
	default "p212" if MESON_GXL
	default "q200" if MESON_GXM
	default "s400" if MESON_AXG
	default "u200" if MESON_G12A
	default ""
	help
	  This option contains information about board name.
	  Based on this option board/<CONFIG_SYS_VENDOR>/<CONFIG_SYS_BOARD> will
	  be used.

if MESON_GX && SPL
config SPL_SYS_MALLOC_F_LEN
	default 0x2000

choice
	prompt "DRAM rank mode"
	help
	  Choose rank mode. This heavily depends on the board and you should
	  leave the board default set if you don't know what this is.
	  If you choose the wrong rank mode DRAM init in SPL may either fail
	  or in rare occasions require multiple resets before it succeeds.

config DRAM_ONE_RANK
	bool "One rank"

config DRAM_TWO_IDENTICAL_RANKS
	bool "Two identical ranks"

if MESON_GXBB
config DRAM_TWO_DIFF_RANKS
	bool "Two different ranks"
endif

if MESON_GXL
config DRAM_16BIT_RANK
	bool "One 16-bit rank"
endif
endchoice

choice
	prompt "DRAM memory type"
	default DRAM_DDR3
	help
	  Select the DDR type according to your board design.  GXBB/S905
	  currently only supports DDR3.

config DRAM_DDR3
	bool "DDR3"

if MESON_GXL
config DRAM_DDR4
	bool "DDR4"
endif
endchoice

config DRAM_DQS_CORR
	bool "Enable DQS correction"

config DRAM_CLK
	int "DRAM clock"
	default 912
	help
	  This option contains the DRAM clock to use in MHz.

config DRAM_SIZE
	int "DRAM size"
	default 1024
	help
	  This option contains the DRAM size. Units in MB.

choice
	prompt "Enable DRAM 2T mode"
	default DRAM_1T_MODE
	help
	  Choose whenever to use 2T mode or not.

config DRAM_1T_MODE
	bool "Use DRAM 1T mode"

config DRAM_2T_MODE
	bool "Use DRAM 2T mode"

endchoice

choice
	prompt "Set VDDEE init voltage"
	default SPL_MESON_GX_VDDEE_1000MV
	help
	  This option is used to set the VDDEE voltage on boot up.
	  If unsure, leave it to the board default.

config SPL_MESON_GX_VDDEE_1000MV
	bool "Set VDDEE to 1000 mv"

config SPL_MESON_GX_VDDEE_1100MV
	bool "Set VDDEE to 1100 mv"

endchoice

choice
	prompt "Set VCCK init voltage"
	default SPL_MESON_GX_VCCK_1100MV
	help
	  This option is used to set the VCCK voltage on boot up.
	  If unsure, leave it to the board default.

config SPL_MESON_GX_VCCK_1000MV
	bool "Set VCCK to 1000 mv"

config SPL_MESON_GX_VCCK_1100MV
	bool "Set VCCK to 1100 mv"

config SPL_MESON_GX_VCCK_1120MV
	bool "Set VCCK to 1120 mv"

endchoice

endif
endif
```

## arch/arm/mach-mvebu/Kconfig
```kconfig
if ARCH_MVEBU

config ARMADA_32BIT
	bool
	select CPU_V7
	select SUPPORT_SPL
	select SPL_DM
	select SPL_DM_SEQ_ALIAS
	select SPL_OF_CONTROL
	select SPL_SIMPLE_BUS

config ARMADA_64BIT
	bool
	select ARM64

# ARMv7 SoCs...
config ARMADA_375
	bool
	select ARMADA_32BIT

config ARMADA_38X
	bool
	select ARMADA_32BIT

config ARMADA_XP
	bool
	select ARMADA_32BIT

# ARMv8 SoCs...
config ARMADA_3700
	bool
	select ARM64

# Armada 7K and 8K are very similar - use only one Kconfig symbol for both
config ARMADA_8K
	bool
	select ARM64

# Armada PLL frequency (used for NAND clock generation)
config SYS_MVEBU_PLL_CLOCK
	int
	default "2000000000" if ARMADA_XP || ARMADA_3700 || ARMADA_8K
	default "1000000000" if ARMADA_38X || ARMADA_375

# Armada XP/38x SoC types...
config MV78230
	bool
	select ARMADA_XP

config MV78260
	bool
	select ARMADA_XP

config MV78460
	bool
	select ARMADA_XP

config 88F6820
	bool
	select ARMADA_38X

choice
	prompt "Armada XP/375/38x/3700/7K/8K board select"
	optional

config TARGET_CLEARFOG
	bool "Support ClearFog"
	select 88F6820

config TARGET_MVEBU_DB_88F3720
	bool "Support DB-88F3720 Armada 3720"
	select ARMADA_3700

config TARGET_DB_88F6720
	bool "Support DB-88F6720 Armada 375"
	select ARMADA_375

config TARGET_DB_88F6820_GP
	bool "Support DB-88F6820-GP"
	select 88F6820

config TARGET_DB_88F6820_AMC
	bool "Support DB-88F6820-AMC"
	select 88F6820

config TARGET_MVEBU_DB_88F7040
	bool "Support DB-88F7040 Armada 7040"
	select ARMADA_8K

config TARGET_DB_MV784MP_GP
	bool "Support db-mv784mp-gp"
	select MV78460

config TARGET_DS414
	bool "Support Synology DS414"
	select MV78230

config TARGET_MAXBCM
	bool "Support maxbcm"
	select MV78460

config TARGET_THEADORABLE
	bool "Support theadorable Armada XP"
	select MV78260

endchoice

config SYS_BOARD
	default "clearfog" if TARGET_CLEARFOG
	default "mvebu_db-88f3720" if TARGET_MVEBU_DB_88F3720
	default "db-88f6720" if TARGET_DB_88F6720
	default "db-88f6820-gp" if TARGET_DB_88F6820_GP
	default "db-88f6820-amc" if TARGET_DB_88F6820_AMC
	default "mvebu_db-88f7040" if TARGET_MVEBU_DB_88F7040
	default "db-mv784mp-gp" if TARGET_DB_MV784MP_GP
	default "ds414" if TARGET_DS414
	default "maxbcm" if TARGET_MAXBCM
	default "theadorable" if TARGET_THEADORABLE

config SYS_CONFIG_NAME
	default "clearfog" if TARGET_CLEARFOG
	default "mvebu_db-88f3720" if TARGET_MVEBU_DB_88F3720
	default "db-88f6720" if TARGET_DB_88F6720
	default "db-88f6820-gp" if TARGET_DB_88F6820_GP
	default "db-88f6820-amc" if TARGET_DB_88F6820_AMC
	default "mvebu_db-88f7040" if TARGET_MVEBU_DB_88F7040
	default "db-mv784mp-gp" if TARGET_DB_MV784MP_GP
	default "ds414" if TARGET_DS414
	default "maxbcm" if TARGET_MAXBCM
	default "theadorable" if TARGET_THEADORABLE

config SYS_VENDOR
	default "Marvell" if TARGET_DB_MV784MP_GP
	default "Marvell" if TARGET_MVEBU_DB_88F3720
	default "Marvell" if TARGET_DB_88F6720
	default "Marvell" if TARGET_DB_88F6820_GP
	default "Marvell" if TARGET_DB_88F6820_AMC
	default "Marvell" if TARGET_MVEBU_DB_88F7040
	default "solidrun" if TARGET_CLEARFOG
	default "Synology" if TARGET_DS414

config SYS_SOC
	default "mvebu"

endif
```

## arch/arm/mach-mvebu/armada3700/Kconfig
```kconfig
menu "eFuse support"

config MVEBU_EFUSE_SUPPORT
	bool "eFuse support"
	depends on TARGET_MVEBU_ARMADA_37XX && CMD_MVEBU_EFUSE
	default n
	help
	  Choose this option to add support
	  for eFuse access driver and enable
	  mailbox for eFuse read/write actions

endmenu
```

## arch/arm/mach-nomadik/Kconfig
```kconfig
if ARCH_NOMADIK

choice
	prompt "Nomadik board select"
	optional

config NOMADIK_NHK8815
	bool "ST 8815 Nomadik Hardware Kit"

endchoice

config SYS_SOC
	default "nomadik"

source "board/st/nhk8815/Kconfig"

endif
```

## arch/arm/mach-npcm/Kconfig
```kconfig
if ARCH_NPCM

config SYS_ARCH
	default "arm"

config SYS_TEXT_BASE
	default 0x8000

choice
	prompt "Nuvoton SoC select"
	default ARCH_NPCM7xx

config ARCH_NPCM7xx
	bool "Support Nuvoton NPCM7xx SoC"
	select CPU_V7A
	select OF_CONTROL
	select DM
	help
	  General support for NPCM7xx BMC (Poleg).
	  Nuvoton NPCM7xx BMC is based on the Cortex A9.

endchoice

source "arch/arm/mach-npcm/npcm7xx/Kconfig"

endif
```

## arch/arm/mach-octeontx/Kconfig
```kconfig
if ARCH_OCTEONTX

choice
	prompt "OcteonTX board select"
	optional

config TARGET_OCTEONTX_81XX
	bool "Marvell OcteonTX CN81XX"

config TARGET_OCTEONTX_83XX
	bool "Marvell OcteonTX CN83XX"

endchoice

config SYS_SOC
	string
	default "octeontx"

config SYS_PCI_64BIT
	bool
	default y

endif
```

## arch/arm/mach-octeontx2/Kconfig
```kconfig
if ARCH_OCTEONTX2

choice
	prompt "OcteonTX2 board select"
	optional

config TARGET_OCTEONTX2_95XX
	bool "Marvell OcteonTX2 CN95XX"

config TARGET_OCTEONTX2_96XX
	bool "Marvell OcteonTX2 CN96XX"

config TARGET_OCTEONTX2_LOKI
	bool "Marvell OcteonTX2 LOKI"

config TARGET_OCTEONTX2_98XX
	bool "Marvell OcteonTX2 CN98XX"

config TARGET_OCTEONTX2_95MM
	bool "Marvell OcteonTX2 CN95MM"

endchoice

config SYS_SOC
	string
	default "octeontx2"

config SYS_PCI_64BIT
	bool
	default y

endif
```

## arch/arm/mach-omap2/Kconfig
```kconfig
if ARCH_OMAP2PLUS

choice
	prompt "OMAP2+ platform select"
	default TARGET_BRXRE1

config TARGET_BRXRE1
	bool "Support BRXRE1"
	select BOARD_LATE_INIT

config TARGET_BRPPT1
	bool "Support BRPPT1"
	select BOARD_LATE_INIT

config TARGET_DRACO
	bool "Support draco"
	select BOARD_LATE_INIT
	select DM
	select DM_SERIAL
	select DM_GPIO

config TARGET_THUBAN
	bool "Support thuban"
	select BOARD_LATE_INIT
	select DM
	select DM_SERIAL
	select DM_GPIO

config TARGET_RASTABAN
	bool "Support rastaban"
	select BOARD_LATE_INIT
	select DM
	select DM_SERIAL
	select DM_GPIO

config TARGET_ETAMIN
	bool "Support etamin"
	select BOARD_LATE_INIT
	select DM
	select DM_SERIAL
	select DM_GPIO

config TARGET_PXM2
	bool "Support pxm2"
	select BOARD_LATE_INIT
	select DM
	select DM_SERIAL
	select DM_GPIO

config TARGET_RUT
	bool "Support rut"
	select BOARD_LATE_INIT
	select DM
	select DM_SERIAL
	select DM_GPIO

config TARGET_TI814X_EVM
	bool "Support ti814x_evm"

config TARGET_TI816X_EVM
	bool "Support ti816x_evm"

config OMAP34XX
	bool "OMAP34XX SoC"
	select ARM_ERRATA_430973
	select ARM_ERRATA_454179
	select ARM_ERRATA_621766
	select ARM_ERRATA_725233
	select USE_TINY_PRINTF
	imply SPL_EXT_SUPPORT
	imply SPL_FAT_SUPPORT
	imply SPL_GPIO_SUPPORT
	imply SPL_I2C_SUPPORT
	imply SPL_LIBCOMMON_SUPPORT
	imply SPL_LIBDISK_SUPPORT
	imply SPL_LIBGENERIC_SUPPORT
	imply SPL_MMC_SUPPORT
	imply SPL_NAND_SUPPORT
	imply SPL_POWER_SUPPORT
	imply SPL_SERIAL_SUPPORT
	imply SYS_THUMB_BUILD

config OMAP44XX
	bool "OMAP44XX SoC"
	select USE_TINY_PRINTF
	imply SPL_DISPLAY_PRINT
	imply SPL_EXT_SUPPORT
	imply SPL_FAT_SUPPORT
	imply SPL_GPIO_SUPPORT
	imply SPL_I2C_SUPPORT
	imply SPL_LIBCOMMON_SUPPORT
	imply SPL_LIBDISK_SUPPORT
	imply SPL_LIBGENERIC_SUPPORT
	imply SPL_MMC_SUPPORT
	imply SPL_NAND_SUPPORT
	imply SPL_POWER_SUPPORT
	imply SPL_SERIAL_SUPPORT
	imply SYS_THUMB_BUILD

config OMAP54XX
	bool "OMAP54XX SoC"
	select ARM_ERRATA_798870
	select SYS_THUMB_BUILD
	imply SPL_DISPLAY_PRINT
	imply SPL_ENV_SUPPORT
	imply SPL_EXT_SUPPORT
	imply SPL_FAT_SUPPORT
	imply SPL_GPIO_SUPPORT
	imply SPL_I2C_SUPPORT
	imply SPL_LIBCOMMON_SUPPORT
	imply SPL_LIBDISK_SUPPORT
	imply SPL_LIBGENERIC_SUPPORT
	imply SPL_MMC_SUPPORT
	imply SPL_NAND_SUPPORT
	imply SPL_POWER_SUPPORT
	imply SPL_SERIAL_SUPPORT

config AM43XX
	bool "AM43XX SoC"
	imply SPL_DM
	imply SPL_DM_SEQ_ALIAS
	imply SPL_OF_CONTROL
	imply SPL_OF_TRANSLATE
	imply SPL_SEPARATE_BSS
	imply SPL_SYS_MALLOC_SIMPLE
	imply SYS_THUMB_BUILD
	help
	  Support for AM43xx SOC from Texas Instruments.
	  The AM43xx high performance SOC features a Cortex-A9
	  ARM core, a quad core PRU-ICSS for industrial Ethernet
	  protocols, dual camera support, optional 3D graphics
	  and an optional customer programmable secure boot.

config AM33XX
	bool "AM33XX SoC"
	imply SYS_THUMB_BUILD
	help
	  Support for AM335x SOC from Texas Instruments.
	  The AM335x high performance SOC features a Cortex-A8
	  ARM core, a dual core PRU-ICSS for industrial Ethernet
	  protocols, optional 3D graphics and an optional customer
	  programmable secure boot.

config TARGET_CM_T43
	bool "Support cm_t43"

endchoice


config TI_SECURE_DEVICE
	bool "HS Device Type Support"
	depends on OMAP54XX || AM43XX || AM33XX || ARCH_KEYSTONE
	help
	  If a high secure (HS) device type is being used, this config
	  must be set. This option impacts various aspects of the
	  build system (to create signed boot images that can be
	  authenticated) and the code. See the doc/README.ti-secure
	  file for further details.

source "arch/arm/mach-omap2/omap3/Kconfig"

source "arch/arm/mach-omap2/omap4/Kconfig"

source "arch/arm/mach-omap2/omap5/Kconfig"

source "arch/arm/mach-omap2/am33xx/Kconfig"

source "board/BuR/brxre1/Kconfig"
source "board/BuR/brppt1/Kconfig"
source "board/siemens/draco/Kconfig"
source "board/siemens/pxm2/Kconfig"
source "board/siemens/rut/Kconfig"
source "board/ti/ti814x/Kconfig"
source "board/ti/ti816x/Kconfig"
source "board/ti/am43xx/Kconfig"
source "board/ti/am335x/Kconfig"
source "board/compulab/cm_t335/Kconfig"
source "board/compulab/cm_t43/Kconfig"

endif
```

## arch/arm/mach-omap2/omap3/Kconfig
```kconfig
if OMAP34XX

choice
	prompt "OMAP3 board select"
	optional

config TARGET_AM3517_EVM
	bool "AM3517 EVM"

config TARGET_MT_VENTOUX
	bool "TeeJet Mt.Ventoux"

config TARGET_OMAP3_BEAGLE
	bool "TI OMAP3 BeagleBoard"
	select DM
	select DM_SERIAL
	select DM_GPIO

config TARGET_CM_T35
	bool "CompuLab CM-T3530 and CM-T3730 boards"

config TARGET_CM_T3517
	bool "CompuLab CM-T3517 boards"

config TARGET_DEVKIT8000
	bool "TimLL OMAP3 Devkit8000"
	select DM
	select DM_SERIAL
	select DM_GPIO

config TARGET_OMAP3_EVM
	bool "TI OMAP3 EVM"

config TARGET_OMAP3_IGEP00X0
	bool "IGEP"
	select DM
	select DM_SERIAL
	select DM_GPIO

config TARGET_OMAP3_OVERO
	bool "OMAP35xx Gumstix Overo"
	select DM
	select DM_SERIAL
	select DM_GPIO

config TARGET_OMAP3_ZOOM1
	bool "TI Zoom1"
	select DM
	select DM_SERIAL
	select DM_GPIO

config TARGET_AM3517_CRANE
	bool "am3517_crane"

config TARGET_OMAP3_PANDORA
	bool "OMAP3 Pandora"

config TARGET_ECO5PK
	bool "ECO5PK"

config TARGET_TRICORDER
	bool "Tricorder"

config TARGET_MCX
	bool "MCX"
	select BOARD_LATE_INIT

config TARGET_OMAP3_LOGIC
	bool "OMAP3 Logic"
	select BOARD_LATE_INIT
	select DM
	select DM_SERIAL
	select DM_GPIO

config TARGET_NOKIA_RX51
	bool "Nokia RX51"

config TARGET_TAO3530
	bool "TAO3530"

config TARGET_TWISTER
	bool "Twister"

config TARGET_OMAP3_CAIRO
	bool "QUIPOS CAIRO"
	select DM
	select DM_SERIAL
	select DM_GPIO

config TARGET_SNIPER
	bool "LG Optimus Black"
	select DM
	select DM_SERIAL
	select DM_GPIO

endchoice

config SYS_SOC
	default "omap3"

source "board/logicpd/am3517evm/Kconfig"
source "board/teejet/mt_ventoux/Kconfig"
source "board/ti/beagle/Kconfig"
source "board/compulab/cm_t35/Kconfig"
source "board/compulab/cm_t3517/Kconfig"
source "board/timll/devkit8000/Kconfig"
source "board/ti/evm/Kconfig"
source "board/isee/igep00x0/Kconfig"
source "board/overo/Kconfig"
source "board/logicpd/zoom1/Kconfig"
source "board/ti/am3517crane/Kconfig"
source "board/pandora/Kconfig"
source "board/8dtech/eco5pk/Kconfig"
source "board/corscience/tricorder/Kconfig"
source "board/htkw/mcx/Kconfig"
source "board/logicpd/omap3som/Kconfig"
source "board/nokia/rx51/Kconfig"
source "board/technexion/tao3530/Kconfig"
source "board/technexion/twister/Kconfig"
source "board/quipos/cairo/Kconfig"
source "board/lg/sniper/Kconfig"

endif
```

## arch/arm/mach-omap2/omap4/Kconfig
```kconfig
if OMAP44XX

choice
	prompt "OMAP4 board select"
	optional
	help
	  Select your OMAP4 board, available boards are:
	  - TI OMAP4 Variscite SOM

config TARGET_OMAP4_VAR_SOM
	bool "TI OMAP4 Variscite SOM"
	help
	  OMAP4-based system on module.
	  Boots from the SD card reader

endchoice

config SYS_SOC
	default "omap4"

source "board/variscite/omap4_var_som/Kconfig"

endif
```
