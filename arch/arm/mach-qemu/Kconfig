## arch/arm/mach-qemu/Kconfig
```kconfig
if ARCH_QEMU

config SYS_VENDOR
	default "emulation"

choice
	prompt "QEMU ARM architecture"
	default TARGET_QEMU_ARM_64BIT

config TARGET_QEMU_ARM_32BIT
	bool "ARMv7-A, 32bit"
	select ARCH_SUPPORT_PSCI
	select BOARD_LATE_INIT
	select CPU_V7A
	select SYS_ARCH_TIMER

config TARGET_QEMU_ARM_64BIT
	bool "ARMv8, 64bit"
	select ARM64
	select BOARD_LATE_INIT

config TARGET_QEMU_ARM_SBSA
	bool "SBSA Reference"
	select ARM64
	select BINMAN
	select BOARD_LATE_INIT
	select ENABLE_ARM_SOC_BOOT0_HOOK
	select MISC_INIT_R
endchoice

if TARGET_QEMU_ARM_32BIT || TARGET_QEMU_ARM_64BIT

config SYS_BOARD
	default "qemu-arm"

config SYS_CONFIG_NAME
	default "qemu-arm"

endif

if TARGET_QEMU_ARM_SBSA

config SYS_BOARD
	default "qemu-sbsa"

config SYS_CONFIG_NAME
	default "qemu-sbsa"

config SYS_SOC
	default "qemu-sbsa"

endif

endif
```

## arch/arm/mach-renesas/Kconfig.rcar4
```kconfig
if RCAR_GEN4

menu "Select Target SoC"

config R8A779A0
	bool "Renesas SoC R8A779A0"
	select GICV3
	imply CLK_R8A779A0
	imply PINCTRL_PFC_R8A779A0

config R8A779F0
	bool "Renesas SoC R8A779F0"
	select GICV3
	imply CLK_R8A779F0
	imply PINCTRL_PFC_R8A779F0

config R8A779G0
	bool "Renesas SoC R8A779G0"
	select GICV3
	select BINMAN
	select SUPPORT_SPL
	imply SPL
	imply SPL_BOARD_INIT
	imply SPL_LIBCOMMON_SUPPORT
	imply SPL_LIBGENERIC_SUPPORT
	imply SPL_SERIAL
	imply SPL_SYS_MALLOC_SIMPLE
	imply SPL_TINY_MEMSET
	imply SPL_USE_TINY_PRINTF
	imply CLK_R8A779G0
	imply PINCTRL_PFC_R8A779G0

config R8A779H0
	bool "Renesas SoC R8A779H0"
	select GICV3
	imply CLK_R8A779H0
	imply PINCTRL_PFC_R8A779H0

endmenu

choice
	prompt "Renesas ARM64 SoCs board select"
	optional

config TARGET_FALCON
	bool "Falcon board"
	imply R8A779A0
	help
          Support for Renesas R-Car Gen3 Falcon platform

config TARGET_SPIDER
	bool "Spider board"
	imply R8A779F0
	help
	  Support for Renesas R-Car Gen4 Spider platform

config TARGET_S4SK
	bool "S4SK board"
	imply R8A779F0
	help
	  Support for Renesas R-Car Gen4 S4SK platform

config TARGET_WHITEHAWK
	bool "White Hawk board"
	imply R8A779G0
	help
	  Support for Renesas R-Car Gen4 White Hawk platform

config TARGET_SPARROWHAWK
	bool "Sparrow Hawk board"
	imply R8A779G0
	help
	  Support for Renesas R-Car Gen4 Sparrow Hawk platform

config TARGET_GRAYHAWK
	bool "Gray Hawk board"
	imply R8A779H0
	help
	  Support for Renesas R-Car Gen4 Gray Hawk platform

endchoice

source "board/renesas/falcon/Kconfig"
source "board/renesas/spider/Kconfig"
source "board/renesas/s4sk/Kconfig"
source "board/renesas/whitehawk/Kconfig"
source "board/renesas/sparrowhawk/Kconfig"
source "board/renesas/grayhawk/Kconfig"

endif
```

## arch/arm/mach-renesas/Kconfig.rcar5
```kconfig
if RCAR_GEN5

config RCAR_64_RSIP
	bool "Renesas ARM SoCs R-Car Gen5 (use Cortex-M33 RSIP)"
	select SKIP_RELOCATE_CODE
	select TMU_TIMER
	help
	  Build U-Boot for the Cortex-M33 RSIP core present on selected SoC.
	  The default is n, meaning U-Boot is built for the Cortex-A core.

menu "Select Target SoC"

config R8A78000
	bool "Renesas SoC R8A78000"
	select GICV3
	imply PINCTRL_PFC_R8A78000

endmenu

choice
	prompt "Renesas ARM64 SoCs board select"
	optional

config TARGET_IRONHIDE
	bool "Ironhide board"
	imply R8A78000
	help
	  Support for Renesas R-Car Gen5 Ironhide platform

endchoice

source "board/renesas/ironhide/Kconfig"

config SKIP_RELOCATE_CODE_DATA_OFFSET
	default 0xa0000000 if RCAR_64_RSIP

endif
```

## arch/arm/mach-rmobile/Kconfig
```kconfig
if ARCH_RMOBILE

choice
	prompt "Target Renesas SoC select"
	default RCAR_32

config RCAR_32
	bool "Renesas ARM SoCs R-Car Gen1/Gen2 (32bit)"
	select CPU_V7A

config RCAR_GEN3
	bool "Renesas ARM SoCs R-Car Gen3 (64bit)"
	select ARM64
	select CMD_CACHE
	select OF_BOARD_SETUP
	select PHY
	select PINCONF
	select PINCTRL
	select PINCTRL_PFC
	select POSITION_INDEPENDENT
	select SUPPORT_SPL
	imply CMD_FS_UUID
	imply CMD_GPT
	imply CMD_MMC_SWRITE if MMC
	imply CMD_UUID
	imply SPL
	imply SPL_BOARD_INIT
	imply SPL_GZIP
	imply SPL_LIBCOMMON_SUPPORT
	imply SPL_LIBGENERIC_SUPPORT
	imply SPL_SERIAL
	imply SPL_SYS_MALLOC_SIMPLE
	imply SPL_TINY_MEMSET
	imply SPL_USE_TINY_PRINTF
	imply SPL_YMODEM_SUPPORT
	imply SUPPORT_EMMC_RPMB if MMC

config RZA1
	prompt "Renesas ARM SoCs RZ/A1 (32bit)"
	select CPU_V7A

endchoice

config SYS_SOC
	default "rmobile" if ARCH_RMOBILE

source "arch/arm/mach-rmobile/Kconfig.32"
source "arch/arm/mach-rmobile/Kconfig.64"
source "arch/arm/mach-rmobile/Kconfig.rza1"

endif
```

## arch/arm/mach-rmobile/Kconfig.64
```kconfig
if RCAR_64

config SYS_MALLOC_F_LEN
	default 0x8000 if RCAR_64

config OF_LIBFDT_OVERLAY
	default y if RCAR_64

source "arch/arm/mach-rmobile/Kconfig.rcar3"
source "arch/arm/mach-rmobile/Kconfig.rcar4"

endif
```

## arch/arm/mach-rmobile/Kconfig.rcar4
```kconfig
if RCAR_GEN4

menu "Select Target SoC"

config R8A779A0
	bool "Renesas SoC R8A779A0"
	select GICV3
	imply CLK_R8A779A0
	imply PINCTRL_PFC_R8A779A0

config R8A779F0
	bool "Renesas SoC R8A779F0"
	select GICV3
	imply CLK_R8A779F0
	imply PINCTRL_PFC_R8A779F0

endmenu

choice
	prompt "Renesas ARM64 SoCs board select"
	optional

config TARGET_FALCON
	bool "Falcon board"
	imply R8A779A0
	help
          Support for Renesas R-Car Gen3 Falcon platform

endchoice

source "board/renesas/falcon/Kconfig"

endif
```

## arch/arm/mach-rmobile/Kconfig.rza1
```kconfig
if RZA1

# required by the Ethernet driver
config R7S72100
	bool
	default y

# required by serial and usb driver
config CPU_RZA1
	bool
	default y

choice
	prompt "Renesas RZ/A1 board select"

endchoice

config SYS_SOC
	default "rmobile"

endif
```

## arch/arm/mach-rmobile/Kconfig.rzg2l
```kconfig
# Copyright (C) 2023 Renesas Electronics Corporation
# SPDX-License-Identifier: GPL-2.0+

if RZG2L

config R9A07G044L
	bool "Renesas R9A07G044L SoC"
	help
	  Enable support for the Renesas R9A07G044L (RZ/G2L) SoC.

config MULTI_DTB_FIT_UNCOMPRESS_SZ
	default 0x80000 if TARGET_RZG2L_SMARC_EVK

config MULTI_DTB_FIT_USER_DEF_ADDR
	default 0x49000000 if TARGET_RZG2L_SMARC_EVK

endif
```

## arch/arm/mach-rockchip/Kconfig
```kconfig
if ARCH_ROCKCHIP

config ROCKCHIP_RK3036
	bool "Support Rockchip RK3036"
	select CPU_V7
	select SUPPORT_SPL
	select SPL
	help
	  The Rockchip RK3036 is a ARM-based SoC with a dual-core Cortex-A7
	  including NEON and GPU, Mali-400 graphics, several DDR3 options
	  and video codec support. Peripherals include Gigabit Ethernet,
	  USB2 host and OTG, SDIO, I2S, UART, SPI, I2C and PWMs.

config ROCKCHIP_RK3188
	bool "Support Rockchip RK3188"
	select CPU_V7
	select SPL_BOARD_INIT if SPL
	select SUPPORT_SPL
	select SUPPORT_TPL
	select SPL
	select TPL
	select BOARD_LATE_INIT
	select ROCKCHIP_BROM_HELPER
	help
	  The Rockchip RK3188 is a ARM-based SoC with a quad-core Cortex-A9
	  including NEON and GPU, 512KB L2 cache, Mali-400 graphics, two
	  video interfaces, several memory options and video codec support.
	  Peripherals include Fast Ethernet, USB2 host and OTG, SDIO, I2S,
	  UART, SPI, I2C and PWMs.

config ROCKCHIP_RK322X
	bool "Support Rockchip RK3228/RK3229"
	select CPU_V7
	select SUPPORT_SPL
	select SPL
	select ROCKCHIP_BROM_HELPER
	select DEBUG_UART_BOARD_INIT
	help
	  The Rockchip RK3229 is a ARM-based SoC with a dual-core Cortex-A7
	  including NEON and GPU, Mali-400 graphics, several DDR3 options
	  and video codec support. Peripherals include Gigabit Ethernet,
	  USB2 host and OTG, SDIO, I2S, UART, SPI, I2C and PWMs.

config ROCKCHIP_RK3288
	bool "Support Rockchip RK3288"
	select CPU_V7
	select SPL_BOARD_INIT if SPL
	select SUPPORT_SPL
	select SPL
	help
	  The Rockchip RK3288 is a ARM-based SoC with a quad-core Cortex-A17
	  including NEON and GPU, 1MB L2 cache, Mali-T7 graphics, two
	  video interfaces supporting HDMI and eDP, several DDR3 options
	  and video codec support. Peripherals include Gigabit Ethernet,
	  USB2 host and OTG, SDIO, I2S, UARTs, SPI, I2C and PWMs.

config ROCKCHIP_RK3328
	bool "Support Rockchip RK3328"
	select ARM64
	help
	  The Rockchip RK3328 is a ARM-based SoC with a quad-core Cortex-A53.
	  including NEON and GPU, 1MB L2 cache, Mali-T7 graphics, two
	  video interfaces supporting HDMI and eDP, several DDR3 options
	  and video codec support. Peripherals include Gigabit Ethernet,
	  USB2 host and OTG, SDIO, I2S, UARTs, SPI, I2C and PWMs.

config ROCKCHIP_RK3368
	bool "Support Rockchip RK3368"
	select ARM64
	select SUPPORT_SPL
	select SUPPORT_TPL
	select TPL_NEEDS_SEPARATE_TEXT_BASE if SPL
	select TPL_NEEDS_SEPARATE_STACK if TPL
	imply SPL_SEPARATE_BSS
	imply SPL_SERIAL_SUPPORT
	imply TPL_SERIAL_SUPPORT
	select ENABLE_ARM_SOC_BOOT0_HOOK
	select DEBUG_UART_BOARD_INIT
	select SYS_NS16550
	help
	  The Rockchip RK3368 is a ARM-based SoC with a octa-core (organised
	  into a big and little cluster with 4 cores each) Cortex-A53 including
	  AdvSIMD, 512KB L2 cache (for the big cluster) and 256 KB L2 cache
	  (for the little cluster), PowerVR G6110 based graphics, one video
	  output processor supporting LVDS/HDMI/eDP, several DDR3 options and
	  video codec support.

	  On-chip peripherals include Gigabit Ethernet, USB2 host and OTG, SDIO,
	  I2S, UARTs, SPI, I2C and PWMs.

if ROCKCHIP_RK3368

config TPL_LDSCRIPT
	default "arch/arm/mach-rockchip/rk3368/u-boot-tpl.lds"

config TPL_TEXT_BASE
        default 0xff8c1000

config TPL_MAX_SIZE
        default 28672

config TPL_STACK
        default 0xff8cffff

endif

config ROCKCHIP_RK3399
	bool "Support Rockchip RK3399"
	select ARM64
	select SUPPORT_SPL
	select SPL
	select SPL_SEPARATE_BSS
	select SPL_SERIAL_SUPPORT
	select SPL_DRIVERS_MISC_SUPPORT
	select ENABLE_ARM_SOC_BOOT0_HOOK
	select DEBUG_UART_BOARD_INIT
	help
	  The Rockchip RK3399 is a ARM-based SoC with a dual-core Cortex-A72
	  and quad-core Cortex-A53.
	  including NEON and GPU, 1MB L2 cache, Mali-T7 graphics, two
	  video interfaces supporting HDMI and eDP, several DDR3 options
	  and video codec support. Peripherals include Gigabit Ethernet,
	  USB2 host and OTG, SDIO, I2S, UARTs, SPI, I2C and PWMs.

config ROCKCHIP_RV1108
	bool "Support Rockchip RV1108"
	select CPU_V7
	help
	  The Rockchip RV1108 is a ARM-based SoC with a single-core Cortex-A7
	  and a DSP.

config SPL_ROCKCHIP_BACK_TO_BROM
	bool "SPL returns to bootrom"
	default y if ROCKCHIP_RK3036
	select ROCKCHIP_BROM_HELPER
	depends on SPL
	help
	  Rockchip SoCs have ability to load SPL & U-Boot binary. If enabled,
          SPL will return to the boot rom, which will then load the U-Boot
          binary to keep going on.

config TPL_ROCKCHIP_BACK_TO_BROM
	bool "TPL returns to bootrom"
	default y if ROCKCHIP_RK3368
	select ROCKCHIP_BROM_HELPER
	depends on TPL
	help
	  Rockchip SoCs have ability to load SPL & U-Boot binary. If enabled,
          SPL will return to the boot rom, which will then load the U-Boot
          binary to keep going on.

config ROCKCHIP_SPL_RESERVE_IRAM
	hex "Size of IRAM reserved in SPL"
	default 0x4000
	help
	  SPL may need reserve memory for firmware loaded by SPL, whose load
	  address is in IRAM and may overlay with SPL text area if not
	  reserved.

config ROCKCHIP_BROM_HELPER
	bool

config SPL_MMC_SUPPORT
	default y if !SPL_ROCKCHIP_BACK_TO_BROM

source "arch/arm/mach-rockchip/rk3036/Kconfig"
source "arch/arm/mach-rockchip/rk3188/Kconfig"
source "arch/arm/mach-rockchip/rk322x/Kconfig"
source "arch/arm/mach-rockchip/rk3288/Kconfig"
source "arch/arm/mach-rockchip/rk3328/Kconfig"
source "arch/arm/mach-rockchip/rk3368/Kconfig"
source "arch/arm/mach-rockchip/rk3399/Kconfig"
source "arch/arm/mach-rockchip/rv1108/Kconfig"
endif
```

## arch/arm/mach-rockchip/fit_spl_optee.its
```
/*
 * Copyright (C) 2017 Rockchip Electronic Co.,Ltd
 *
 * Simple U-boot fit source file containing U-Boot, dtb and optee
 */

/dts-v1/;

/ {
	description = "Simple image with OP-TEE support";
	#address-cells = <1>;

	images {
		uboot {
			description = "U-Boot";
			data = /incbin/("../../../u-boot-nodtb.bin");
			type = "standalone";
			os = "U-Boot";
			arch = "arm";
			compression = "none";
			load = <0x61000000>;
		};
		optee {
			description = "OP-TEE";
			data = /incbin/("../../../tee.bin");
			type = "firmware";
			arch = "arm";
			os = "tee";
			compression = "none";
			load = <0x68400000>;
			entry = <0x68400000>;
		};
		fdt {
			description = "dtb";
			data = /incbin/("../../../u-boot.dtb");
			type = "flat_dt";
			compression = "none";
		};
	};

	configurations {
		default = "conf";
		conf {
			description = "Rockchip armv7 with OP-TEE";
			firmware = "optee";
			loadables = "uboot";
			fdt = "fdt";
		};
	};
};
```

## arch/arm/mach-rockchip/px30/Kconfig
```kconfig
if ROCKCHIP_PX30

config TARGET_EVB_PX30
	bool "EVB_PX30"
	help
	  This target config option used for below listed px30 boards.

	  EVB_PX30:
	  * EVB_PX30 is an evaluation board for Rockchip PX30.

config TARGET_ODROID_GO2
	bool "ODROID_GO2"

config TARGET_PX30_CORE
	bool "Engicam PX30.Core"
	help
	  PX30.Core EDIMM2.2:
	  * PX30.Core is an EDIMM SOM based on Rockchip PX30 from Engicam.
	  * EDIMM2.2 is a Form Factor Capacitive Evaluation Board from Engicam.
	  * PX30.Core needs to mount on top of EDIMM2.2 for creating complete
	    PX30.Core EDIMM2.2 Starter Kit.

	  PX30.Core CTOUCH2:
	  * PX30.Core is an EDIMM SOM based on Rockchip PX30 from Engicam.
	  * CTOUCH2.0 is a general purpose Carrier board with capacitive
	    touch interface support.
	  * PX30.Core needs to mount on top of CTOUCH2.0 for creating complete
	    PX30.Core C.TOUCH Carrier board.

config ROCKCHIP_BOOT_MODE_REG
	default 0xff010200

config SYS_SOC
	default "px30"

config SYS_MALLOC_F_LEN
	default 0x400

config SPL_SERIAL_SUPPORT
	default y

config TPL_LDSCRIPT
	default "arch/arm/mach-rockchip/u-boot-tpl-v8.lds"

config TPL_TEXT_BASE
	default 0xff0e1000

config TPL_MAX_SIZE
	default 10240

config TPL_STACK
	default 0xff0e4fff

config DEBUG_UART_CHANNEL
	int "Mux channel to use for debug UART2/UART3"
	depends on DEBUG_UART_BOARD_INIT
	default 0
	help
	  UART2 and UART3 can use two different set of pins to route the output.
	  For using the UART for early debugging the route to use needs
	  to be declared (0 or 1).

source "board/engicam/px30_core/Kconfig"
source "board/hardkernel/odroid_go2/Kconfig"
source "board/rockchip/evb_px30/Kconfig"

endif
```

## arch/arm/mach-rockchip/rk3036/Kconfig
```kconfig
if ROCKCHIP_RK3036

config TARGET_EVB_RK3036
	bool "EVB_RK3036"

config TARGET_KYLIN_RK3036
	bool "KYLIN_RK3036"

config SYS_SOC
	default "rockchip"

config SYS_MALLOC_F_LEN
	default 0x400

source "board/rockchip/evb_rk3036/Kconfig"
source "board/rockchip/kylin_rk3036/Kconfig"

endif
```

## arch/arm/mach-rockchip/rk3066/Kconfig
```kconfig
if ROCKCHIP_RK3066

config ROCKCHIP_BOOT_MODE_REG
	default 0x20004040

config SYS_SOC
	default "rk3066"

config SYS_MALLOC_F_LEN
	default 0x0800

config SPL_LIBCOMMON_SUPPORT
	default y

config SPL_LIBGENERIC_SUPPORT
	default y

config SPL_SERIAL
	default y

config TPL_LIBCOMMON_SUPPORT
	default y

config TPL_LIBGENERIC_SUPPORT
	default y

config TPL_SERIAL
	default y

endif
```

## arch/arm/mach-rockchip/rk3188/Kconfig
```kconfig
if ROCKCHIP_RK3188

config SYS_SOC
	default "rockchip"

config SYS_MALLOC_F_LEN
	default 0x0800

config SPL_LIBCOMMON_SUPPORT
	default y

config SPL_LIBGENERIC_SUPPORT
	default y

config SPL_SERIAL_SUPPORT
	default y

config TPL_LIBCOMMON_SUPPORT
	default y

config TPL_SERIAL_SUPPORT
	default y

endif
```

## arch/arm/mach-rockchip/rk322x/Kconfig
```kconfig
if ROCKCHIP_RK322X


config TARGET_EVB_RK3229
	bool "EVB_RK3229"
	select BOARD_LATE_INIT

config SYS_SOC
	default "rk322x"

config SYS_MALLOC_F_LEN
	default 0x400

config SPL_SERIAL_SUPPORT
	default y

config TPL_MAX_SIZE
        default 28672

config TPL_STACK
        default 0x10088000

config TPL_TEXT_BASE
        default 0x10081000

source "board/rockchip/evb_rk3229/Kconfig"

endif
```
