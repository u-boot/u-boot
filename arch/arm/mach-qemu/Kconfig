## arch/arm/mach-rockchip/rk3288/Kconfig
```kconfig
if ROCKCHIP_RK3288

config TARGET_FIREFLY_RK3288
	bool "Firefly-RK3288"
	help
	  Firefly is a RK3288-based development board with 2 USB ports,
	  HDMI, VGA, micro-SD card, audio, WiFi  and Gigabit Ethernet, It
	  also includes on-board eMMC and 1GB of SDRAM. Expansion connectors
	  provide access to display pins, I2C, SPI, UART and GPIOs.

config TARGET_EVB_RK3288
	bool "Evb-RK3288"
	help
	  EVB-RK3288 is a RK3288-based development board with 2 USB ports,
	  HDMI, VGA, micro-SD card, audio, WiFi  and Gigabit Ethernet, It
	  also includes on-board eMMC and 2GB of SDRAM. Expansion connectors
	  provide access to display pins, I2C, SPI, UART and GPIOs.

config TARGET_FENNEC_RK3288
	bool "Fennec-RK3288"
	help
	  Fennec is a RK3288-based development board with 2 USB ports,
	  HDMI, micro-SD card, audio, WiFi and Gigabit Ethernet. It also
	  includes on-board eMMC and 2GB of SDRAM. Expansion connectors
	  provide access to display pins, I2C, SPI, UART and GPIOs.

config TARGET_POPMETAL_RK3288
	bool "PopMetal-RK3288"
	help
	  PopMetal is a RK3288-based development board with 3 USB host ports,
	  1 micro USB OTG port, HDMI, VGA, micro-SD card, audio, WiFi, Gigabit
	  Ethernet and lots of sensors. It also includes on-board 8 GeMMC and
	  2GB DDR3. Expansion connectors provide access to I2C, SPI, UART,
	  GPIOs and display interface.

config TARGET_MINIARM_RK3288
	bool "miniarm-RK3288"
	help
	  Miniarm is a RK3288-based development board with 2 USB ports, HDMI,
	  micro-SD card, audio, Gigabit Ethernet. It also includes on-board
	  8GB eMMC and 2GB of SDRAM. Expansion connectors provide access to
	  I2C, SPI, UART, GPIOs.

config TARGET_CHROMEBOOK_JERRY
	bool "Google/Rockchip Veyron-Jerry Chromebook"
	help
	  Jerry is a RK3288-based clamshell device with 2 USB 3.0 ports,
	  HDMI, an 11.9 inch EDP display, micro-SD card, touchpad and
	  WiFi. It includes a Chrome OS EC (Cortex-M3) to provide access to
	  the keyboard and battery functions.

config TARGET_ROCK2
	bool "Radxa Rock 2"
	help
	  Rock 2 is a SOM and base-board combination based on RK3288. It
	  includes Ethernet, HDMI, 3 USB, micro-SD, audio, SATA, WiFi and
	  space for a real-time-clock battery. There is also an expansion
	  interface which provides access to many pins.

config ROCKCHIP_FAST_SPL
	bool "Change the CPU to full speed in SPL"
	depends on TARGET_CHROMEBOOK_JERRY
	help
	  Some boards want to boot as fast as possible. We can increase the
	  CPU frequency in SPL if the power supply is configured to the correct
	  voltage. This option is only available on boards which support it
	  and have the required PMIC code.

config SYS_SOC
	default "rockchip"

config SYS_MALLOC_F_LEN
	default 0x0800

source "board/chipspark/popmetal_rk3288/Kconfig"

source "board/firefly/firefly-rk3288/Kconfig"

source "board/google/chromebook_jerry/Kconfig"

source "board/radxa/rock2/Kconfig"

source "board/rockchip/evb_rk3288/Kconfig"

source "board/rockchip/fennec_rk3288/Kconfig"

source "board/rockchip/miniarm_rk3288/Kconfig"

endif
```

## arch/arm/mach-rockchip/rk3308/Kconfig
```kconfig
if ROCKCHIP_RK3308

config SYS_SOC
	default "rk3308"

config SYS_MALLOC_F_LEN
	default 0x400

config SPL_SERIAL_SUPPORT
	default y

config ROCKCHIP_BOOT_MODE_REG
	default 0xff000500
endif
```

## arch/arm/mach-rockchip/rk3328/Kconfig
```kconfig
if ROCKCHIP_RK3328

choice
	prompt "RK3328 board select"

config TARGET_EVB_RK3328
	bool "RK3328 evaluation board"
	help
	  RK3328evb is a evaluation board for Rockchip rk3328,
	  with full function and phisical connectors support like
	  usb2.0 host ports, LVDS, JTAG, MAC, SDcard, HDMI, USB-2-serial...

endchoice

config ROCKCHIP_BOOT_MODE_REG
	default 0xff1005c8

config SYS_SOC
	default "rk3328"

config SYS_MALLOC_F_LEN
	default 0x2000

config SPL_LIBCOMMON_SUPPORT
	default y

config SPL_LIBGENERIC_SUPPORT
	default y

source "board/rockchip/evb_rk3328/Kconfig"

endif
```

## arch/arm/mach-rockchip/rk3368/Kconfig
```kconfig
if ROCKCHIP_RK3368

choice
	prompt "RK3368 board"

config TARGET_SHEEP
	bool "Sheep board"
	help
	  Sheep board is designed by Rockchip as a EVB board
	  for rk3368.

config TARGET_GEEKBOX
	bool "GeekBox"

config TARGET_EVB_PX5
        bool "Evb-PX5"
	select ARCH_EARLY_INIT_R
        help
	 PX5 EVB is designed by Rockchip for automotive field
         with integrated CVBS (TP2825) / MIPI DSI / CSI / LVDS
         HDMI video input/output interface, audio codec ES8396,
         WIFI/BT (on RTL8723BS), Gsensor BMA250E and light&proximity
         sensor STK3410.
endchoice

config ROCKCHIP_BOOT_MODE_REG
	default 0xff738200

config ROCKCHIP_STIMER_BASE
	default 0xff830020

config SYS_SOC
	default "rk3368"

config SYS_MALLOC_F_LEN
	default 0x4000

config SPL_LIBCOMMON_SUPPORT
	default y

config SPL_LIBGENERIC_SUPPORT
	default y

source "board/rockchip/sheep_rk3368/Kconfig"
source "board/geekbuying/geekbox/Kconfig"
source "board/rockchip/evb_px5/Kconfig"

config SPL_STACK_R_ADDR
	default 0x04000000

config TPL_STACK
        default 0xff8cffff

config TPL_TEXT_BASE
        default 0xff8c1000

endif
```

## arch/arm/mach-rockchip/rk3399/Kconfig
```kconfig
if ROCKCHIP_RK3399

choice
	prompt "RK3399 board select"

config TARGET_EVB_RK3399
	bool "RK3399 evaluation board"
	help
	  RK3399evb is a evaluation board for Rockchp rk3399,
	  with full function and phisical connectors support like type-C ports,
	  usb2.0 host ports, LVDS, JTAG, MAC, SDcard, HDMI, USB-2-serial...

endchoice

config SYS_SOC
	default "rockchip"

config SYS_MALLOC_F_LEN
	default 0x0800

source "board/rockchip/evb_rk3399/Kconfig"

endif
```

## arch/arm/mach-rockchip/rk3506/Kconfig
```kconfig
if ROCKCHIP_RK3506

config ROCKCHIP_BOOT_MODE_REG
	default 0xff910200

config ROCKCHIP_STIMER_BASE
	default 0xff980000

config SYS_SOC
	default "rk3506"

config SYS_CONFIG_NAME
	default "rk3506_common"

endif
```

## arch/arm/mach-rockchip/rk3528/Kconfig
```kconfig
if ROCKCHIP_RK3528

config TARGET_RADXA_ROCK_2_RK3528
	bool "Radxa ROCK 2A/2F"
	help
	  Radxa ROCK 2A/2F single board computers with a RK3528A SoC.

config ROCKCHIP_BOOT_MODE_REG
	default 0xff370200

config ROCKCHIP_STIMER_BASE
	default 0xff620000

config SYS_SOC
	default "rk3528"

source "board/radxa/rock-2-rk3528/Kconfig"

config SYS_CONFIG_NAME
	default "rk3528_common"

endif
```

## arch/arm/mach-rockchip/rk3568/Kconfig
```kconfig
if ROCKCHIP_RK3568

choice
	prompt "RK3568/RK3566 board select"

config TARGET_EVB_RK3568
	bool "RK3568 evaluation board"
	help
	  RK3568 EVB is a evaluation board for Rockchp RK3568.

config TARGET_ANBERNIC_RGXX3_RK3566
	bool "Anbernic RGXX3"
	help
	  Anbernic RGXX3 gaming device with Rockchip RK3566. This
	  config can be used with the RG353M, RG353P, RG353V, RG353VS,
	  and RG503. The correct device tree name will automatically
	  be selected by the bootloader.

config TARGET_ODROID_M1_RK3568
	bool "ODROID-M1"
	help
	  Hardkernel ODROID-M1 single board computer with a RK3568B2 SoC.

config TARGET_ODROID_M1S_RK3566
	bool "ODROID-M1S"
	help
	  Hardkernel ODROID-M1S single board computer with a RK3566 SoC.

config TARGET_POWKIDDY_X55_RK3566
	bool "Powkiddy X55"
	help
	  Powkiddy X55 handheld gaming console with an RK3566 SoC.

config TARGET_QNAP_TS433_RK3568
	bool "QNAP-TS433"
	help
	  Qnap TS433 4-bay NAS with a RK3568 SoC.

	  It provides the following featureset:
	   * 4GB LPDDR4
	   * 4GB eMMC
	   * 2 SATA ports connected to two RK3568's SATA controllers
	   * 2 SATA ports connected to a JMicron JMB58x AHCI SATA controller
	   * 1 1G network controller
	   * 1 2.5G Realtek RTL8125 network controller

config TARGET_QUARTZ64_RK3566
	bool "Pine64 Quartz64"
	help
	  Pine64 Quartz64 single board computer with a RK3566 SoC.

config TARGET_RADXA_ZERO_3_RK3566
	bool "Radxa ZERO 3W/3E"
	help
	  Radxa ZERO 3W/3E single board computers with a RK3566 SoC.

config TARGET_ORANGEPI_3B_RK3566
	bool "Xunlong Orange Pi 3B"
	help
	  Xunlong Orange Pi 3B single board computer with a RK3566 SoC.

endchoice

config ROCKCHIP_BOOT_MODE_REG
	default 0xfdc20200

config ROCKCHIP_STIMER_BASE
	default 0xfdd1c020

config SYS_SOC
	default "rk3568"

config TEXT_BASE
	default 0x00a00000

source "board/rockchip/evb_rk3568/Kconfig"
source "board/anbernic/rgxx3_rk3566/Kconfig"
source "board/hardkernel/odroid_m1/Kconfig"
source "board/hardkernel/odroid_m1s/Kconfig"
source "board/pine64/quartz64_rk3566/Kconfig"
source "board/powkiddy/x55/Kconfig"
source "board/qnap/ts433/Kconfig"
source "board/radxa/zero3-rk3566/Kconfig"
source "board/xunlong/orangepi-3b-rk3566/Kconfig"

config SYS_CONFIG_NAME
	default "rk3568_common"

endif
```

## arch/arm/mach-rockchip/rk3576/Kconfig
```kconfig
if ROCKCHIP_RK3576

config TARGET_ROC_PC_RK3576
	bool "Firefly ROC-RK3576-PC"
	help
	  ROC-RK3576-PC is a single board computer from Firefly
	  using the Rockchip RK3576.

config ROCKCHIP_BOOT_MODE_REG
	default 0x26024040

config ROCKCHIP_STIMER_BASE
	default 0x27400000

config SYS_SOC
	default "rk3576"

source board/firefly/roc-pc-rk3576/Kconfig

config SYS_CONFIG_NAME
	default "rk3576_common"

endif
```
