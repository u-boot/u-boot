## arch/arm/mach-socfpga/Kconfig
```kconfig
if ARCH_SOCFPGA

config SYS_MMCSD_RAW_MODE_U_BOOT_PARTITION_TYPE
	default 0xa2

config TARGET_SOCFPGA_ARRIA5
	bool
	select TARGET_SOCFPGA_GEN5

config TARGET_SOCFPGA_ARRIA10
	bool
	select SPL_BOARD_INIT if SPL
	select ALTERA_SDRAM

config TARGET_SOCFPGA_CYCLONE5
	bool
	select TARGET_SOCFPGA_GEN5

config TARGET_SOCFPGA_GEN5
	bool
	select ALTERA_SDRAM

choice
	prompt "Altera SOCFPGA board select"
	optional

config TARGET_SOCFPGA_ARRIA10_SOCDK
	bool "Altera SOCFPGA SoCDK (Arria 10)"
	select TARGET_SOCFPGA_ARRIA10

config TARGET_SOCFPGA_ARRIA5_SOCDK
	bool "Altera SOCFPGA SoCDK (Arria V)"
	select TARGET_SOCFPGA_ARRIA5

config TARGET_SOCFPGA_CYCLONE5_SOCDK
	bool "Altera SOCFPGA SoCDK (Cyclone V)"
	select TARGET_SOCFPGA_CYCLONE5

config TARGET_SOCFPGA_DEVBOARDS_DBM_SOC1
	bool "Devboards DBM-SoC1 (Cyclone V)"
	select TARGET_SOCFPGA_CYCLONE5

config TARGET_SOCFPGA_EBV_SOCRATES
	bool "EBV SoCrates (Cyclone V)"
	select TARGET_SOCFPGA_CYCLONE5

config TARGET_SOCFPGA_IS1
	bool "IS1 (Cyclone V)"
	select TARGET_SOCFPGA_CYCLONE5

config TARGET_SOCFPGA_SAMTEC_VINING_FPGA
	bool "samtec VIN|ING FPGA (Cyclone V)"
	select BOARD_LATE_INIT
	select TARGET_SOCFPGA_CYCLONE5

config TARGET_SOCFPGA_SR1500
	bool "SR1500 (Cyclone V)"
	select TARGET_SOCFPGA_CYCLONE5

config TARGET_SOCFPGA_TERASIC_DE0_NANO
	bool "Terasic DE0-Nano-Atlas (Cyclone V)"
	select TARGET_SOCFPGA_CYCLONE5

config TARGET_SOCFPGA_TERASIC_DE10_NANO
	bool "Terasic DE10-Nano (Cyclone V)"
	select TARGET_SOCFPGA_CYCLONE5

config TARGET_SOCFPGA_TERASIC_DE1_SOC
	bool "Terasic DE1-SoC (Cyclone V)"
	select TARGET_SOCFPGA_CYCLONE5

config TARGET_SOCFPGA_TERASIC_SOCKIT
	bool "Terasic SoCkit (Cyclone V)"
	select TARGET_SOCFPGA_CYCLONE5

endchoice

config SYS_BOARD
	default "arria5-socdk" if TARGET_SOCFPGA_ARRIA5_SOCDK
	default "arria10-socdk" if TARGET_SOCFPGA_ARRIA10_SOCDK
	default "cyclone5-socdk" if TARGET_SOCFPGA_CYCLONE5_SOCDK
	default "dbm-soc1" if TARGET_SOCFPGA_DEVBOARDS_DBM_SOC1
	default "de0-nano-soc" if TARGET_SOCFPGA_TERASIC_DE0_NANO
	default "de1-soc" if TARGET_SOCFPGA_TERASIC_DE1_SOC
	default "de10-nano" if TARGET_SOCFPGA_TERASIC_DE10_NANO
	default "is1" if TARGET_SOCFPGA_IS1
	default "sockit" if TARGET_SOCFPGA_TERASIC_SOCKIT
	default "socrates" if TARGET_SOCFPGA_EBV_SOCRATES
	default "sr1500" if TARGET_SOCFPGA_SR1500
	default "vining_fpga" if TARGET_SOCFPGA_SAMTEC_VINING_FPGA

config SYS_VENDOR
	default "altera" if TARGET_SOCFPGA_ARRIA5_SOCDK
	default "altera" if TARGET_SOCFPGA_ARRIA10_SOCDK
	default "altera" if TARGET_SOCFPGA_CYCLONE5_SOCDK
	default "devboards" if TARGET_SOCFPGA_DEVBOARDS_DBM_SOC1
	default "ebv" if TARGET_SOCFPGA_EBV_SOCRATES
	default "samtec" if TARGET_SOCFPGA_SAMTEC_VINING_FPGA
	default "terasic" if TARGET_SOCFPGA_TERASIC_DE0_NANO
	default "terasic" if TARGET_SOCFPGA_TERASIC_DE1_SOC
	default "terasic" if TARGET_SOCFPGA_TERASIC_DE10_NANO
	default "terasic" if TARGET_SOCFPGA_TERASIC_SOCKIT

config SYS_SOC
	default "socfpga"

config SYS_CONFIG_NAME
	default "socfpga_arria5_socdk" if TARGET_SOCFPGA_ARRIA5_SOCDK
	default "socfpga_arria10_socdk" if TARGET_SOCFPGA_ARRIA10_SOCDK
	default "socfpga_cyclone5_socdk" if TARGET_SOCFPGA_CYCLONE5_SOCDK
	default "socfpga_dbm_soc1" if TARGET_SOCFPGA_DEVBOARDS_DBM_SOC1
	default "socfpga_de0_nano_soc" if TARGET_SOCFPGA_TERASIC_DE0_NANO
	default "socfpga_de1_soc" if TARGET_SOCFPGA_TERASIC_DE1_SOC
	default "socfpga_de10_nano" if TARGET_SOCFPGA_TERASIC_DE10_NANO
	default "socfpga_is1" if TARGET_SOCFPGA_IS1
	default "socfpga_sockit" if TARGET_SOCFPGA_TERASIC_SOCKIT
	default "socfpga_socrates" if TARGET_SOCFPGA_EBV_SOCRATES
	default "socfpga_sr1500" if TARGET_SOCFPGA_SR1500
	default "socfpga_vining_fpga" if TARGET_SOCFPGA_SAMTEC_VINING_FPGA

endif
```

## arch/arm/mach-stm32/Kconfig
```kconfig
if STM32

config STM32F4
	bool "stm32f4 family"

config STM32F1
	bool "stm32f1 family"

config STM32F7
	bool "stm32f7 family"
	select SUPPORT_SPL
	select SPL
	select SPL_CLK
	select SPL_DM
	select SPL_DM_SEQ_ALIAS
	select SPL_DRIVERS_MISC_SUPPORT
	select SPL_GPIO_SUPPORT
	select SPL_LIBCOMMON_SUPPORT
	select SPL_LIBGENERIC_SUPPORT
	select SPL_MTD_SUPPORT
	select SPL_OF_CONTROL
	select SPL_OF_LIBFDT
	select SPL_OF_TRANSLATE
	select SPL_OS_BOOT
	select SPL_PINCTRL
	select SPL_RAM
	select SPL_SERIAL_SUPPORT
	select SPL_SYS_MALLOC_SIMPLE
	select SPL_XIP_SUPPORT

source "arch/arm/mach-stm32/stm32f4/Kconfig"
source "arch/arm/mach-stm32/stm32f1/Kconfig"
source "arch/arm/mach-stm32/stm32f7/Kconfig"

endif
```

## arch/arm/mach-stm32/stm32f4/Kconfig
```kconfig
if STM32F4

config TARGET_STM32F429_DISCOVERY
	bool "STM32F429 Discovery board"

source "board/st/stm32f429-discovery/Kconfig"

endif
```

## arch/arm/mach-stm32mp/Kconfig
```kconfig
if ARCH_STM32MP

config SPL
	select SPL_BOARD_INIT
	select SPL_CLK
	select SPL_DM
	select SPL_DM_SEQ_ALIAS
	select SPL_DRIVERS_MISC
	select SPL_FRAMEWORK
	select SPL_GPIO
	select SPL_LIBCOMMON_SUPPORT
	select SPL_LIBGENERIC_SUPPORT
	select SPL_OF_CONTROL
	select SPL_OF_TRANSLATE
	select SPL_PINCTRL
	select SPL_REGMAP
	select SPL_DM_RESET
	select SPL_SERIAL
	select SPL_SYSCON
	select SPL_WATCHDOG if WATCHDOG
	imply BOOTSTAGE_STASH if SPL_BOOTSTAGE
	imply SPL_BOOTSTAGE if BOOTSTAGE
	imply SPL_DISPLAY_PRINT
	imply SPL_LIBDISK_SUPPORT
	imply SPL_SPI_LOAD if SPL_SPI

config SYS_SOC
	default "stm32mp"

config SYS_MALLOC_LEN
	default 0x2000000

config ENV_SIZE
	default 0x2000

choice
	prompt "Select STMicroelectronics STM32MPxxx Soc"
	default STM32MP15X

config STM32MP13X
	bool "Support STMicroelectronics STM32MP13x Soc"
	select ARCH_EARLY_INIT_R
	select ARM_SMCCC if TFABOOT
	select ARCH_SUPPORT_PSCI if !TFABOOT
	select BINMAN if !TFABOOT
	select CPU_V7A
	select CPU_V7_HAS_NONSEC
	select CPU_V7_HAS_VIRT
	select OF_BOARD if TFABOOT
	select OF_BOARD_SETUP
	select PINCTRL_STM32
	select STM32_RCC
	select STM32_RESET
	select STM32_SERIAL
	select SUPPORT_SPL if !TFABOOT
	select SYS_ARCH_TIMER
	imply CMD_NVEDIT_INFO
	imply OF_UPSTREAM
	help
		support of STMicroelectronics SOC STM32MP13x family
		STMicroelectronics MPU with core ARMv7

config STM32MP15X
	bool "Support STMicroelectronics STM32MP15x Soc"
	select ARCH_EARLY_INIT_R
	select ARCH_SUPPORT_PSCI
	select BINMAN
	select CPU_V7A
	select CPU_V7_HAS_NONSEC
	select CPU_V7_HAS_VIRT
	select OF_BOARD if TFABOOT
	select OF_BOARD_SETUP
	select PINCTRL_STM32
	select STM32_RCC
	select STM32_RESET
	select STM32_SERIAL
	select SUPPORT_SPL
	select SYS_ARCH_TIMER
	imply CMD_NVEDIT_INFO
	imply OF_UPSTREAM
	help
		support of STMicroelectronics SOC STM32MP15x family
		STM32MP157, STM32MP153 or STM32MP151
		STMicroelectronics MPU with core ARMv7
		dual core A7 for STM32MP157/3, monocore for STM32MP151

config STM32MP23X
	bool "Support STMicroelectronics STM32MP23x Soc"
	select ARM64
	select CLK_STM32MP25
	select OF_BOARD
	select PINCTRL_STM32
	select STM32_RCC
	select STM32_RESET
	select STM32_SERIAL
	select STM32MP_TAMP_NVMEM
	select SYS_ARCH_TIMER
	select TFABOOT
	imply CLK_SCMI
	imply CMD_NVEDIT_INFO
	imply DM_REGULATOR
	imply DM_REGULATOR_SCMI
	imply OF_UPSTREAM
	imply OPTEE
	imply RESET_SCMI
	imply SYSRESET_PSCI
	imply TEE
	imply VERSION_VARIABLE
	help
		Support of STMicroelectronics SOC STM32MP23x family
		STMicroelectronics MPU with 2 * A53 core and 1 M33 core

config STM32MP25X
	bool "Support STMicroelectronics STM32MP25x Soc"
	select ARM64
	select CLK_STM32MP25
	select OF_BOARD
	select PINCTRL_STM32
	select STM32_RCC
	select STM32_RESET
	select STM32_SERIAL
	select SYS_ARCH_TIMER
	select TFABOOT
	imply CLK_SCMI
	imply CMD_NVEDIT_INFO
	imply DM_REGULATOR
	imply DM_REGULATOR_SCMI
	imply OF_UPSTREAM
	imply OPTEE
	imply RESET_SCMI
	imply SYSRESET_PSCI
	imply TEE
	imply VERSION_VARIABLE
	help
		Support of STMicroelectronics SOC STM32MP25x family
		STMicroelectronics MPU with 2 * A53 core and 1 M33 core
endchoice

config NR_DRAM_BANKS
	default 1

config DDR_CACHEABLE_SIZE
	hex "Size of the DDR marked cacheable in pre-reloc stage"
	default 0x40000000
	help
		Define the size of the DDR marked as cacheable in U-Boot
		pre-reloc stage.
		This option can be useful to avoid speculatif access
		to secured area of DDR used by TF-A or OP-TEE before U-Boot
		initialization.
		The areas marked "no-map" in device tree should be located
		before this limit: STM32_DDR_BASE + DDR_CACHEABLE_SIZE.

config SYS_MMCSD_RAW_MODE_U_BOOT_PARTITION_MMC2
	hex "Partition on MMC2 to use to load U-Boot from"
	depends on SYS_MMCSD_RAW_MODE_U_BOOT_USE_PARTITION
	default 1
	help
	  Partition on the second MMC to load U-Boot from when the MMC is being
	  used in raw mode

config STM32_ECDSA_VERIFY
	bool "STM32 ECDSA verification via the ROM API"
	depends on SPL_ECDSA_VERIFY
	default y
	help
	  Say y to enable the uclass driver for ECDSA verification using the
	  ROM API provided on STM32MP.
	  The ROM API is only available during SPL for now.

config STM32MP_TAMP_NVMEM
	bool "STM32 TAMP backup registers via NVMEM API"
	select NVMEM
	default y
	help
	  Say y to enable the uclass driver for TAMP Backup registers using the
	  NVMEM API. It allows to access to boot mode or others shared information
	  between software components/execution levels.

config CMD_STM32KEY
	bool "command stm32key to fuse public key hash"
	depends on CMDLINE
	help
		fuse public key hash in corresponding fuse used to authenticate
		binary.
		This command is used to evaluate the secure boot on stm32mp SOC,
		it is deactivated by default in real products.

config MFD_STM32_TIMERS
	bool "STM32 multifonction timer support"
	help
	  Select this to enable support for the multifunction timer found on
	  STM32 devices.

source "arch/arm/mach-stm32mp/Kconfig.13x"
source "arch/arm/mach-stm32mp/Kconfig.15x"
source "arch/arm/mach-stm32mp/Kconfig.23x"
source "arch/arm/mach-stm32mp/Kconfig.25x"
source "arch/arm/mach-stm32mp/cmd_stm32prog/Kconfig"

config STM32MP15_PWR
	bool "Enable driver for STM32MP15x PWR"
	depends on DM_REGULATOR && DM_PMIC && (STM32MP13X || STM32MP15X)
	default y if STM32MP15X
	help
		This config enables implementation of driver-model pmic and
		regulator uclass features for access to STM32MP15x PWR.

config SPL_STM32MP15_PWR
	bool "Enable driver for STM32MP15x PWR in SPL"
	depends on SPL && SPL_DM_REGULATOR && SPL_DM_PMIC && (STM32MP13X || STM32MP15X)
	default y if STM32MP15X
	help
		This config enables implementation of driver-model pmic and
		regulator uclass features for access to STM32MP15x PWR in SPL.

endif
```

## arch/arm/mach-stm32mp/cmd_stm32prog/Kconfig
```kconfig
config CMD_STM32PROG
	bool "command stm32prog for STM32CudeProgrammer"
	select DFU
	select DFU_RAM
	select DFU_VIRT
	select PARTITION_TYPE_GUID
	imply CMD_GPT if MMC
	imply CMD_MTD if MTD
	imply DFU_MMC if MMC
	imply DFU_MTD if MTD
	help
		activate a specific command stm32prog for STM32MP soc family
		witch update the device with the tools STM32CubeProgrammer,
		using UART with STM32 protocol or USB with DFU protocol
		NB: access to not volatile memory (NOR/NAND/SD/eMMC) is based
		    on U-Boot DFU framework
```

## arch/arm/mach-tegra/Kconfig
```kconfig
if TEGRA

config SPL_GPIO_SUPPORT
	default y

config SPL_LIBCOMMON_SUPPORT
	default y

config SPL_LIBGENERIC_SUPPORT
	default y

config SPL_SERIAL_SUPPORT
	default y

config TEGRA_IVC
	bool "Tegra IVC protocol"
	help
	  IVC (Inter-VM Communication) protocol is a Tegra-specific IPC
	  (Inter Processor Communication) framework. Within the context of
	  U-Boot, it is typically used for communication between the main CPU
	  and various auxiliary processors.

config TEGRA_COMMON
	bool "Tegra common options"
	select CLK
	select DM
	select DM_ETH
	select DM_GPIO
	select DM_I2C
	select DM_KEYBOARD
	select DM_MMC
	select DM_PWM
	select DM_RESET
	select DM_SERIAL
	select DM_SPI
	select DM_SPI_FLASH
	select MISC
	select OF_CONTROL
	select VIDCONSOLE_AS_LCD if DM_VIDEO

config TEGRA_NO_BPMP
	bool "Tegra common options for SoCs without BPMP"
	select TEGRA_CAR
	select TEGRA_CAR_CLOCK
	select TEGRA_CAR_RESET

config TEGRA_ARMV7_COMMON
	bool "Tegra 32-bit common options"
	select CPU_V7
	select SPL
	select SUPPORT_SPL
	select TEGRA_COMMON
	select TEGRA_GPIO
	select TEGRA_NO_BPMP

config TEGRA_ARMV8_COMMON
	bool "Tegra 64-bit common options"
	select ARM64
	select TEGRA_COMMON

choice
	prompt "Tegra SoC select"
	optional

config TEGRA20
	bool "Tegra20 family"
	select TEGRA_ARMV7_COMMON

config TEGRA30
	bool "Tegra30 family"
	select TEGRA_ARMV7_COMMON

config TEGRA114
	bool "Tegra114 family"
	select TEGRA_ARMV7_COMMON

config TEGRA124
	bool "Tegra124 family"
	select TEGRA_ARMV7_COMMON

config TEGRA210
	bool "Tegra210 family"
	select TEGRA_GPIO
	select TEGRA_ARMV8_COMMON
	select TEGRA_NO_BPMP

config TEGRA186
	bool "Tegra186 family"
	select DM_MAILBOX
	select TEGRA186_BPMP
	select TEGRA186_CLOCK
	select TEGRA186_GPIO
	select TEGRA186_RESET
	select TEGRA_ARMV8_COMMON
	select TEGRA_HSP
	select TEGRA_IVC

endchoice

config TEGRA_DISCONNECT_UDC_ON_BOOT
	bool "Disconnect USB device mode controller on boot"
	default y
	help
	  When loading U-Boot into RAM over USB protocols using tools such as
	  tegrarcm or L4T's exec-uboot.sh/tegraflash.py, Tegra's USB device
	  mode controller is initialized and enumerated by the host PC running
	  the tool. Unfortunately, these tools do not shut down the USB
	  controller before executing the downloaded code, and so the host PC
	  does not "de-enumerate" the USB device. This option shuts down the
	  USB controller when U-Boot boots to avoid leaving a stale USB device
	  present.

config SYS_MALLOC_F_LEN
	default 0x1800

source "arch/arm/mach-tegra/tegra20/Kconfig"
source "arch/arm/mach-tegra/tegra30/Kconfig"
source "arch/arm/mach-tegra/tegra114/Kconfig"
source "arch/arm/mach-tegra/tegra124/Kconfig"
source "arch/arm/mach-tegra/tegra210/Kconfig"
source "arch/arm/mach-tegra/tegra186/Kconfig"

endif
```

## arch/arm/mach-tegra/tegra114/Kconfig
```kconfig
if TEGRA114

choice
	prompt "Tegra114 board select"
	optional

config TARGET_DALMORE
	bool "NVIDIA Tegra114 Dalmore evaluation board"
	select BOARD_LATE_INIT

config TARGET_SURFACE_2
	bool "Microsoft Surface 2"
	select BOARD_LATE_INIT

config TARGET_TEGRATAB
	bool "NVIDIA Tegra114 TegraTab evaluation board"
	select BOARD_LATE_INIT

config TARGET_TRANSFORMER_T114
	bool "ASUS Tegra114 Transformer board"
	select BOARD_LATE_INIT

endchoice

config SYS_SOC
	default "tegra114"

source "board/nvidia/dalmore/Kconfig"
source "board/microsoft/surface-2/Kconfig"
source "board/nvidia/tegratab/Kconfig"
source "board/asus/transformer-t114/Kconfig"

endif
```

## arch/arm/mach-tegra/tegra186/Kconfig
```kconfig
# Copyright (c) 2016, NVIDIA CORPORATION.
#
# SPDX-License-Identifier: GPL-2.0

if TEGRA186

choice
	prompt "Tegra186 board select"

endchoice

config SYS_SOC
	default "tegra186"

endif
```

## arch/arm/mach-tegra/tegra20/Kconfig
```kconfig
if TEGRA20

choice
	prompt "Tegra20 board select"

config TARGET_HARMONY
	bool "NVIDIA Tegra20 Harmony evaluation board"

config TARGET_MEDCOM_WIDE
	bool "Avionic Design Medcom-Wide board"

config TARGET_PAZ00
	bool "Paz00 board"

config TARGET_PLUTUX
	bool "Avionic Design Plutux board"

config TARGET_SEABOARD
	bool "NVIDIA Seaboard"

config TARGET_TEC
	bool "Avionic Design Tamonten Evaluation Carrier"

config TARGET_TRIMSLICE
	bool "Compulab TrimSlice board"

config TARGET_VENTANA
	bool "NVIDIA Tegra20 Ventana evaluation board"

config TARGET_WHISTLER
	bool "NVIDIA Tegra20 Whistler evaluation board"

config TARGET_COLIBRI_T20
	bool "Toradex Colibri T20 board"

endchoice

config SYS_SOC
	default "tegra20"

source "board/nvidia/harmony/Kconfig"
source "board/avionic-design/medcom-wide/Kconfig"
source "board/compal/paz00/Kconfig"
source "board/avionic-design/plutux/Kconfig"
source "board/nvidia/seaboard/Kconfig"
source "board/avionic-design/tec/Kconfig"
source "board/compulab/trimslice/Kconfig"
source "board/nvidia/ventana/Kconfig"
source "board/nvidia/whistler/Kconfig"
source "board/toradex/colibri_t20/Kconfig"

endif
```
