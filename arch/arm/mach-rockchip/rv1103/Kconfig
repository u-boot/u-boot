## arch/arm/mach-tegra/tegra210/Kconfig
```kconfig
if TEGRA210

choice
	prompt "Tegra210 board select"

config TARGET_E2220_1170
	bool "NVIDIA Tegra210 E2220-1170 board"
	help
	  E2220-1170 is a Tegra210 bringup board with onboard SoC, DRAM,
	  eMMC, SD card slot, HDMI, USB micro-B port, and sockets for various
	  expansion modules.

config TARGET_P2571
	bool "NVIDIA Tegra210 P2571 base board"
	help
	  P2571 is a P2530 married to a P1963 I/O board

endchoice

config SYS_SOC
	default "tegra210"

source "board/nvidia/e2220-1170/Kconfig"
source "board/nvidia/p2571/Kconfig"

endif
```

## arch/arm/mach-u8500/Kconfig
```kconfig
if ARCH_U8500

config SYS_SOC
	default "u8500"

choice
	prompt "U8500 board selection"

config TARGET_STEMMY
	bool "Samsung (stemmy) board"
	select MISC_INIT_R
	help
	  The Samsung "stemmy" board supports Samsung smartphones released with
	  the ST-Ericsson NovaThor U8500 SoC, e.g.

	      - Samsung Galaxy S III mini (GT-I8190)	"golden"
	      - Samsung Galaxy S Advance (GT-I9070)	"janice"
	      - Samsung Galaxy Xcover 2 (GT-S7710)	"skomer"
	      - Samsung Galaxy Ace 2 (GT-I8160)		"codina"

	  and likely others as well (untested).

	  See board/ste/stemmy/README for details.

endchoice

source "board/ste/stemmy/Kconfig"

endif
```

## arch/arm/mach-uniphier/Kconfig
```kconfig
if ARCH_UNIPHIER

config SYS_CONFIG_NAME
	default "uniphier"

config ARCH_UNIPHIER_32BIT
	bool
	select CPU_V7
	select CPU_V7_HAS_NONSEC
	select ARMV7_NONSEC

config ARCH_UNIPHIER_64BIT
	bool
	select ARM64
	select SPL_SEPARATE_BSS
	select ARMV8_MULTIENTRY
	select ARMV8_SPIN_TABLE

choice
        prompt "UniPhier SoC select"
        default ARCH_UNIPHIER_PRO4

config ARCH_UNIPHIER_SLD3
	bool "UniPhier PH1-sLD3 SoC"
	select ARCH_UNIPHIER_32BIT

config ARCH_UNIPHIER_LD4_SLD8
	bool "UniPhier PH1-LD4/PH1-sLD8 SoC"
	select ARCH_UNIPHIER_32BIT

config ARCH_UNIPHIER_PRO4
	bool "UniPhier PH1-Pro4 SoC"
	select ARCH_UNIPHIER_32BIT

config ARCH_UNIPHIER_PRO5_PXS2_LD6B
	bool "UniPhier PH1-Pro5/ProXstream2/PH1-LD6b SoC"
	select ARCH_UNIPHIER_32BIT

config ARCH_UNIPHIER_LD11
	bool "UniPhier PH1-LD11 SoC"
	select ARCH_UNIPHIER_64BIT

config ARCH_UNIPHIER_LD20
	bool "UniPhier PH1-LD20 SoC"
	select ARCH_UNIPHIER_64BIT
	select OF_BOARD_SETUP

endchoice

config ARCH_UNIPHIER_LD4
	bool "Enable UniPhier PH1-LD4 SoC support"
	depends on ARCH_UNIPHIER_LD4_SLD8
	default y

config ARCH_UNIPHIER_SLD8
	bool "Enable UniPhier PH1-sLD8 SoC support"
	depends on ARCH_UNIPHIER_LD4_SLD8
	default y

config ARCH_UNIPHIER_PRO5
	bool "Enable UniPhier PH1-Pro5 SoC support"
	depends on ARCH_UNIPHIER_PRO5_PXS2_LD6B
	default y

config ARCH_UNIPHIER_PXS2
	bool "Enable UniPhier ProXstream2 SoC support"
	depends on ARCH_UNIPHIER_PRO5_PXS2_LD6B
	default y

config ARCH_UNIPHIER_LD6B
	bool "Enable UniPhier PH1-LD6b SoC support"
	depends on ARCH_UNIPHIER_PRO5_PXS2_LD6B
	default y

config CACHE_UNIPHIER
	bool "Enable the UniPhier L2 cache controller"
	depends on ARCH_UNIPHIER_32BIT
	default y
	help
	  This option allows to use the UniPhier System Cache as L2 cache.

config MICRO_SUPPORT_CARD
	bool "Use Micro Support Card"
	help
	  This option provides support for the expansion board, available
	  on some UniPhier reference boards.

	  Say Y to use the on-board UART, Ether, LED devices.

config CMD_PINMON
	bool "Enable boot mode pins monitor command"
	default y
	help
	  The command "pinmon" shows the state of the boot mode pins.
	  The boot mode pins are latched when the system reset is deasserted
	  and determine which device the system should load a boot image from.

config CMD_DDRPHY_DUMP
	bool "Enable dump command of DDR PHY parameters"
	depends on ARCH_UNIPHIER_LD4 || ARCH_UNIPHIER_PRO4 || ARCH_UNIPHIER_SLD8
	default y
	help
	  The command "ddrphy" shows the resulting parameters of DDR PHY
	  training; it is useful for the evaluation of DDR PHY training.

config CMD_DDRMPHY_DUMP
	bool "Enable dump command of DDR Multi PHY parameters"
	depends on ARCH_UNIPHIER_PXS2 || ARCH_UNIPHIER_LD6B
	default y
	help
	  The command "ddrmphy" shows the resulting parameters of DDR Multi PHY
	  training; it is useful for the evaluation of DDR Multi PHY training.

endif
```

## arch/arm/mach-zynq/Kconfig
```kconfig
if ARCH_ZYNQ

config SPL_FAT_SUPPORT
	default y

config SPL_LIBCOMMON_SUPPORT
	default y

config SPL_LIBDISK_SUPPORT
	default y

config SPL_LIBGENERIC_SUPPORT
	default y

config SPL_MMC_SUPPORT
	default y if ZYNQ_SDHCI

config SPL_SERIAL_SUPPORT
	default y

config SPL_SPI_FLASH_SUPPORT
	default y if ZYNQ_QSPI

config SPL_SPI_SUPPORT
	default y if ZYNQ_QSPI

config SYS_BOARD
	default "zynq"

config SYS_VENDOR
	string "Vendor name"
	default "xilinx"

config SYS_SOC
	default "zynq"

config SYS_CONFIG_NAME
	string "Board configuration name"
	default "zynq-common"
	help
	  This option contains information about board configuration name.
	  Based on this option include/configs/<CONFIG_SYS_CONFIG_NAME>.h header
	  will be used for board configuration.

config SYS_MALLOC_F_LEN
	default 0x600

config BOOT_INIT_FILE
	string "boot.bin init register filename"
	default ""
	help
	  Add register writes to boot.bin format (max 256 pairs).
	  Expect a table of register-value pairs, e.g. "0x12345678 0x4321"

endif
```

## arch/arm/mach-zynqmp-r5/Kconfig
```kconfig
# SPDX-License-Identifier: GPL-2.0

if ARCH_ZYNQMP_R5

config SYS_BOARD
	string "Board name"
	default "zynqmp_r5"

config SYS_VENDOR
	string "Vendor name"
	default "xilinx"

config SYS_SOC
	default "zynqmp-r5"

config CPU_FREQ_HZ
	int "CPU frequency"
	default 800000000
	help
	  The value, in Hz, that the CPU clock is running at.

endif
```

## arch/avr32/Kconfig
```kconfig
menu "AVR32 architecture"
	depends on AVR32

config SYS_ARCH
	default "avr32"

choice
	prompt "Target select"
	optional

config TARGET_ATNGW100
	bool "Support atngw100"

config TARGET_ATNGW100MKII
	bool "Support atngw100mkii"

config TARGET_ATSTK1002
	bool "Support atstk1002"

config TARGET_GRASSHOPPER
	bool "Support grasshopper"

endchoice

source "board/atmel/atngw100/Kconfig"
source "board/atmel/atngw100mkii/Kconfig"
source "board/atmel/atstk1000/Kconfig"
source "board/in-circuit/grasshopper/Kconfig"

endmenu
```

## arch/blackfin/Kconfig
```kconfig
menu "Blackfin architecture"
	depends on BLACKFIN

config SYS_ARCH
	default "blackfin"

choice
	prompt "Target select"
	optional

config TARGET_BCT_BRETTL2
	bool "Support bct-brettl2"

config TARGET_BF506F_EZKIT
	bool "Support bf506f-ezkit"

config TARGET_BF518F_EZBRD
	bool "Support bf518f-ezbrd"

config TARGET_BF525_UCR2
	bool "Support bf525-ucr2"

config TARGET_BF526_EZBRD
	bool "Support bf526-ezbrd"

config TARGET_BF527_AD7160_EVAL
	bool "Support bf527-ad7160-eval"

config TARGET_BF527_EZKIT
	bool "Support bf527-ezkit"

config TARGET_BF527_SDP
	bool "Support bf527-sdp"

config TARGET_BF533_EZKIT
	bool "Support bf533-ezkit"

config TARGET_BF533_STAMP
	bool "Support bf533-stamp"

config TARGET_BF537_MINOTAUR
	bool "Support bf537-minotaur"

config TARGET_BF537_PNAV
	bool "Support bf537-pnav"

config TARGET_BF537_SRV1
	bool "Support bf537-srv1"

config TARGET_BF537_STAMP
	bool "Support bf537-stamp"

config TARGET_BF538F_EZKIT
	bool "Support bf538f-ezkit"

config TARGET_BF548_EZKIT
	bool "Support bf548-ezkit"

config TARGET_BF561_ACVILON
	bool "Support bf561-acvilon"

config TARGET_BF561_EZKIT
	bool "Support bf561-ezkit"

config TARGET_BF609_EZKIT
	bool "Support bf609-ezkit"

config TARGET_BLACKSTAMP
	bool "Support blackstamp"

config TARGET_BLACKVME
	bool "Support blackvme"

config TARGET_BR4
	bool "Support br4"

config TARGET_CM_BF527
	bool "Support cm-bf527"

config TARGET_CM_BF533
	bool "Support cm-bf533"

config TARGET_CM_BF537E
	bool "Support cm-bf537e"

config TARGET_CM_BF537U
	bool "Support cm-bf537u"

config TARGET_CM_BF548
	bool "Support cm-bf548"

config TARGET_CM_BF561
	bool "Support cm-bf561"

config TARGET_DNP5370
	bool "Support dnp5370"

config TARGET_IBF_DSP561
	bool "Support ibf-dsp561"

config TARGET_IP04
	bool "Support ip04"

config TARGET_PR1
	bool "Support pr1"

config TARGET_TCM_BF518
	bool "Support tcm-bf518"

config TARGET_TCM_BF537
	bool "Support tcm-bf537"

endchoice

source "board/bct-brettl2/Kconfig"
source "board/bf506f-ezkit/Kconfig"
source "board/bf518f-ezbrd/Kconfig"
source "board/bf525-ucr2/Kconfig"
source "board/bf526-ezbrd/Kconfig"
source "board/bf527-ad7160-eval/Kconfig"
source "board/bf527-ezkit/Kconfig"
source "board/bf527-sdp/Kconfig"
source "board/bf533-ezkit/Kconfig"
source "board/bf533-stamp/Kconfig"
source "board/bf537-minotaur/Kconfig"
source "board/bf537-pnav/Kconfig"
source "board/bf537-srv1/Kconfig"
source "board/bf537-stamp/Kconfig"
source "board/bf538f-ezkit/Kconfig"
source "board/bf548-ezkit/Kconfig"
source "board/bf561-acvilon/Kconfig"
source "board/bf561-ezkit/Kconfig"
source "board/bf609-ezkit/Kconfig"
source "board/blackstamp/Kconfig"
source "board/blackvme/Kconfig"
source "board/br4/Kconfig"
source "board/cm-bf527/Kconfig"
source "board/cm-bf533/Kconfig"
source "board/cm-bf537e/Kconfig"
source "board/cm-bf537u/Kconfig"
source "board/cm-bf548/Kconfig"
source "board/cm-bf561/Kconfig"
source "board/dnp5370/Kconfig"
source "board/ibf-dsp561/Kconfig"
source "board/ip04/Kconfig"
source "board/pr1/Kconfig"
source "board/tcm-bf518/Kconfig"
source "board/tcm-bf537/Kconfig"

endmenu
```

## arch/loongarch/cpu/generic/Kconfig
```kconfig
# SPDX-License-Identifier: GPL-2.0+
#
# Copyright (C) 2024 Jiaxun yang <jiaxun.yang@flygoat.com>
#

config GENERIC_LOONGARCH
	bool
	select SYS_CACHE_SHIFT_6
	imply CPU
	imply CPU_LOONGARCH
	imply LOONGARCH_TIMER
	imply CMD_CPU
```

## arch/m68k/Kconfig
```kconfig
menu "M68000 architecture"
	depends on M68K

config SYS_ARCH
	default "m68k"

choice
	prompt "Target select"

config TARGET_M52277EVB
	bool "Support M52277EVB"

config TARGET_M5235EVB
	bool "Support M5235EVB"

config TARGET_COBRA5272
	bool "Support cobra5272"

config TARGET_EB_CPU5282
	bool "Support eb_cpu5282"

config TARGET_M5208EVBE
	bool "Support M5208EVBE"

config TARGET_M5249EVB
	bool "Support M5249EVB"

config TARGET_M5253DEMO
	bool "Support M5253DEMO"

config TARGET_M5253EVBE
	bool "Support M5253EVBE"

config TARGET_M5272C3
	bool "Support M5272C3"

config TARGET_M5275EVB
	bool "Support M5275EVB"

config TARGET_M5282EVB
	bool "Support M5282EVB"

config TARGET_ASTRO_MCF5373L
	bool "Support astro_mcf5373l"

config TARGET_M53017EVB
	bool "Support M53017EVB"

config TARGET_M5329EVB
	bool "Support M5329EVB"

config TARGET_M5373EVB
	bool "Support M5373EVB"

config TARGET_M54418TWR
	bool "Support M54418TWR"

config TARGET_M54451EVB
	bool "Support M54451EVB"

config TARGET_M54455EVB
	bool "Support M54455EVB"

config TARGET_M5475EVB
	bool "Support M5475EVB"

config TARGET_M5485EVB
	bool "Support M5485EVB"

config TARGET_AMCORE
	bool "Support AMCORE"

endchoice

source "board/BuS/eb_cpu5282/Kconfig"
source "board/astro/mcf5373l/Kconfig"
source "board/cobra5272/Kconfig"
source "board/freescale/m5208evbe/Kconfig"
source "board/freescale/m52277evb/Kconfig"
source "board/freescale/m5235evb/Kconfig"
source "board/freescale/m5249evb/Kconfig"
source "board/freescale/m5253demo/Kconfig"
source "board/freescale/m5253evbe/Kconfig"
source "board/freescale/m5272c3/Kconfig"
source "board/freescale/m5275evb/Kconfig"
source "board/freescale/m5282evb/Kconfig"
source "board/freescale/m53017evb/Kconfig"
source "board/freescale/m5329evb/Kconfig"
source "board/freescale/m5373evb/Kconfig"
source "board/freescale/m54418twr/Kconfig"
source "board/freescale/m54451evb/Kconfig"
source "board/freescale/m54455evb/Kconfig"
source "board/freescale/m547xevb/Kconfig"
source "board/freescale/m548xevb/Kconfig"
source "board/sysam/amcore/Kconfig"

endmenu
```

## arch/microblaze/Kconfig
```kconfig
menu "MicroBlaze architecture"
	depends on MICROBLAZE

config SYS_ARCH
	default "microblaze"

config NEEDS_MANUAL_RELOC
	bool "Disable position-independent pre-relocation code"
	default y
	help
	  U-Boot expects to be linked to a specific hard-coded address, and to
	  be loaded to and run from that address. This option lifts that
	  restriction, thus allowing the code to be loaded to and executed from
	  almost any 4K aligned address. This logic relies on the relocation
	  information that is embedded in the binary to support U-Boot
	  relocating itself to the top-of-RAM later during execution.

config STATIC_RELA
	def_bool y if !NEEDS_MANUAL_RELOC

choice
	prompt "Target select"
	optional

config TARGET_MICROBLAZE_GENERIC
	bool "Support microblaze-generic"
	select BOARD_LATE_INIT
	select DM
	select DM_SERIAL
	select OF_CONTROL
	select SUPPORT_SPL
	select SPL_LIBCOMMON_SUPPORT if SPL
	select SPL_LIBGENERIC_SUPPORT if SPL
	select SYSRESET
	select DM_SPI
	select DM_SPI_FLASH
	select SPI
	imply CMD_DM

endchoice

source "board/xilinx/Kconfig"
source "board/xilinx/microblaze-generic/Kconfig"

endmenu
```
