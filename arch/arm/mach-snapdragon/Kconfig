## arch/arm/mach-snapdragon/Kconfig
```kconfig
if ARCH_SNAPDRAGON

config SYS_SOC
	default "snapdragon"

config SYS_VENDOR
	string "Snapdragon board vendor"
	default "qualcomm"
	help
	  Allows to specify vendor for the Snapdragon SoCs based boards.
	  Based on this option board/<CONFIG_SYS_VENDOR>/<CONFIG_SYS_BOARD>
	  will be used as the custom board directory.

config SYS_MALLOC_LEN
	default 0x10000000

config SYS_MALLOC_F_LEN
	default 0x2000

config SPL_SYS_MALLOC_F_LEN
	default 0x2000

config SYS_MALLOC_LEN
	default 0x800000

config LNX_KRNL_IMG_TEXT_OFFSET_BASE
	default 0x80000000

config SYS_BOARD
	string "Snapdragon SoCs based board"
	help
	  Allows to specify the Snapdragon SoCs based board name.
	  Based on this option board/<CONFIG_SYS_VENDOR>/<CONFIG_SYS_BOARD>
	  will be used as the custom board directory.

config SYS_CONFIG_NAME
	string "Board configuration name"
	default SYS_BOARD if SYS_BOARD != ""
	default "qcom"
	help
	  This option contains information about board configuration name.
	  Based on this option include/configs/<CONFIG_SYS_CONFIG_NAME>.h header
	  will be used for board configuration.

config QCOM_GENERATE_MBN
	bool "Generate an MBN-compatible ELF binary"
	help
	  Enable this if you intend to flash U-Boot as a first-stage bootloader.
	  The build system will generate a board-specific ELF file with the appropriate
	  MBN hash segments and test keys.

	  New platforms can be added to tools/qcom/mkmbn/mkmbn.py if they aren't already
	  supported.

endif
```

## arch/loongarch/Kconfig
```kconfig
menu "LoongArch architecture"
	depends on LOONGARCH

config SYS_ARCH
	default "loongarch"

choice
	prompt "Target select"

config TARGET_QEMU_LOONGARCH_VIRT
	bool "Support QEMU Virt Board"

endchoice

# board-specific options below
source "board/emulation/qemu-loongarch/Kconfig"

# platform-specific options below
source "arch/loongarch/cpu/generic/Kconfig"

# architecture-specific options below
choice
	prompt "Base ISA"

config ARCH_LA64
	bool "LoongArch64"
	select 64BIT
	select PHYS_64BIT
	help
	  Choose this option to target the LoongArch64 base ISA.

endchoice

config DMA_ADDR_T_64BIT
	bool
	default y if 64BIT

config SHOW_REGS
	bool "Show registers on unhandled exception"
	default y
	help
	  By default only the program counter and the return address register
	  are shown in crash dumps. Enable this symbol to show all registers
	  in main U-Boot.

config FRAMEPOINTER
	bool "Build with frame pointer for stack unwinding"
	default y
	help
	  Choose this option to use the framepointer so the stack can be
	  unwound if needed. This is useful for tracing where faults came
	  from as the source may be several functions back.

	  If you say Y here, the code size will increase due to having to
	  store the fp.

config STACK_SIZE_SHIFT
	int
	default 14

config OF_BOARD_FIXUP
	default y if OF_SEPARATE

endmenu
```

## arch/riscv/cpu/k3/Kconfig
```kconfig
# SPDX-License-Identifier: GPL-2.0-or-later
#
# Copyright (C) 2026 Yixun Lan <dlan@kernel.org>

if TARGET_SPACEMIT_K3

config SPACEMIT_K3
	bool
	select BINMAN
	select ARCH_EARLY_INIT_R
	select SYS_CACHE_SHIFT_6
	imply CPU
	imply CPU_RISCV
	imply RISCV_TIMER if RISCV_SMODE
	imply CMD_CPU
	imply OF_UPSTREAM

endif
```

## board/anbernic/rg-ds_rk3568/Kconfig
```kconfig
if TARGET_RG_DS_RK3568

config SYS_BOARD
	default "rg-ds_rk3568"

config SYS_VENDOR
	default "anbernic"

config SYS_CONFIG_NAME
	default "anbernic-rg-ds-rk3568"

endif
```

## board/davinci/da8xxevm/Kconfig
```kconfig
if TARGET_OMAPL138_LCDK

config SYS_BOARD
	default "da8xxevm"

config SYS_VENDOR
	default "davinci"

config SYS_CONFIG_NAME
	default "omapl138_lcdk"

config NAND_6BYTES_OOB_FREE_10BYTES_ECC
	def_bool y

endif

source "board/ti/common/Kconfig"
```

## board/firefly/roc-pc-rk3588s/Kconfig
```kconfig
if TARGET_ROC_PC_RK3588S

config SYS_BOARD
	default "roc-pc-rk3588s"

config SYS_VENDOR
	default "firefly"

config SYS_CONFIG_NAME
	default "roc-pc-rk3588s"

endif
```

## board/nxp/imx91_qsb/Kconfig
```kconfig
if TARGET_IMX91_9X9_QSB

config SYS_BOARD
	default "imx91_qsb"

config SYS_VENDOR
	default "nxp"

config SYS_CONFIG_NAME
	default "imx91_qsb"

endif
```

## board/nxp/imx95_frdm/Kconfig
```kconfig
if TARGET_IMX95_15X15_FRDM || TARGET_IMX95_19X19_FRDM_PRO

config SYS_BOARD
	default "imx95_frdm"

config SYS_VENDOR
	default "nxp"

config SYS_CONFIG_NAME
	default "imx95_frdm"

endif
```

## board/nxp/imx95_navq/Kconfig
```kconfig
if TARGET_IMX95_NAVQ

config SYS_BOARD
	default "imx95_navq"

config SYS_VENDOR
	default "nxp"

config SYS_CONFIG_NAME
	default "imx95_navq"

endif
```

## board/nxp/lx2160a/Kconfig
```kconfig
if TARGET_LX2160ARDB

config SYS_BOARD
	default "lx2160a"

config SYS_VENDOR
	default "nxp"

config SYS_SOC
	default "fsl-layerscape"

config SYS_CONFIG_NAME
	default "lx2160ardb"

endif

if TARGET_LX2160AQDS

config SYS_BOARD
	default "lx2160a"

config SYS_VENDOR
	default "nxp"

config SYS_SOC
	default "fsl-layerscape"

config SYS_CONFIG_NAME
	default "lx2160aqds"

endif

if TARGET_LX2162AQDS

config SYS_BOARD
	default "lx2160a"

config SYS_VENDOR
	default "nxp"

config SYS_SOC
	default "fsl-layerscape"

config SYS_CONFIG_NAME
	default "lx2162aqds"

endif

if TARGET_NBXV3

config SYS_BOARD
	default "lx2160a"

config SYS_VENDOR
	default "nxp"

config SYS_SOC
	default "fsl-layerscape"

config SYS_CONFIG_NAME
	default "nbxv3"

config NBXV3_DM_EVENT
	bool
	default y
	select DM_EVENT

config NBXV3_PMBUS
	bool
	default y
	select PMBUS
	select CMD_PMBUS
	select DM_REGULATOR
	select DM_REGULATOR_PMBUS_HELPER
	select DM_REGULATOR_MPQ8785
	select DM_REGULATOR_PMBUS_GENERIC
	select CMD_REGULATOR

config NBXV3_DPLL
	bool
	default y
	select SPI
	select DM_SPI
	select FSL_DSPI

config NBXV3_FAN
	bool
	default y
	select DM_REGULATOR
	select DM_REGULATOR_FIXED

endif
```

## board/phytec/phycore_imx8mm/Kconfig
```kconfig
if TARGET_PHYCORE_IMX8MM

config SYS_BOARD
	default "phycore_imx8mm"

config SYS_VENDOR
	default "phytec"

config SYS_CONFIG_NAME
	default "phycore_imx8mm"

config IMX_CONFIG
	default "board/phytec/phycore_imx8mm/imximage-8mm-sd.cfg"

config PHYCORE_IMX8MM_RAM_SIZE_FIX
	bool "Set phyCORE-i.MX8MM RAM size fix instead of detecting"
	default false
	help
	  RAM size is automatic being detected with the help of
	  the EEPROM introspection data. Set RAM size to a fix value
	  instead.

choice
	prompt "phyCORE-i.MX8MM RAM size"
	depends on PHYCORE_IMX8MM_RAM_SIZE_FIX
	default PHYCORE_IMX8MM_RAM_SIZE_2GB
	help
	  Select a fixed RAM size instead of EEPROM introspection
	  data.

config PHYCORE_IMX8MM_RAM_SIZE_1GB
	bool "1GB RAM"
	help
	  Set RAM size fix to 1GB for phyCORE-i.MX8MM
	  instead of runtime detection from EEPROM.

config PHYCORE_IMX8MM_RAM_SIZE_2GB
	bool "2GB RAM"
	help
	  Set RAM size fix to 2GB for phyCORE-i.MX8MM
	  instead of runtime detection from EEPROM.

config PHYCORE_IMX8MM_RAM_SIZE_4GB
	bool "4GB RAM"
	help
	  Set RAM size fix to 4GB for phyCORE-i.MX8MM
	  instead of runtime detection from EEPROM.

endchoice

config PHYCORE_IMX8MM_RAM_STATIC_SOM_REV
	bool "Set static phyCORE-i.MX8MM SoM revision for RAM timing setup"
	default false
	help
	  phyCORE-i.MX8MM SoM revision 7 uses a updated set of optimized
	  RAM timings compared to revision 6 and older. Set the SoM
	  revision during compile time instead of being detected.

choice
	prompt "phyCORE-i.MX8MM RAM timing SoM revision static config"
	depends on PHYCORE_IMX8MM_RAM_STATIC_SOM_REV
	default PHYCORE_IMX8MM_USE_SOM_REV_7
	help
	  Use a fixed revision setting instead of runtime
	  auto detection.

config PHYCORE_IMX8MM_USE_SOM_REV_6
	bool "RAM Timings for SoM Revisions 6 and older"
	help
	  Use optimized RAM Timings for phyCORE-i.MX8MM SoM Revisions 6
	  and older instead of autodetecting.

config PHYCORE_IMX8MM_USE_SOM_REV_7
	bool "RAM Timings for SoM Revision 7"
	help
	  Use optimized RAM Timings for phyCORE-i.MX8MM SoM Revision 7
	  instead of autodetecting.
endchoice

source "board/phytec/common/Kconfig"
endif
```

## board/purism/librem5-devkit/Kconfig
```kconfig
if TARGET_LIBREM5_DEVKIT

config SYS_BOARD
	default "librem5-devkit"

config SYS_VENDOR
	default "purism"

config SYS_CONFIG_NAME
	default "librem5-devkit"

config ENV_SOURCE_FILE
	default "librem5-devkit"

config IMX_CONFIG
	default "board/purism/librem5-devkit/imximage-8mq-lpddr4.cfg"

endif
```

## board/spacemit/k3/Kconfig
```kconfig
# SPDX-License-Identifier: GPL-2.0-or-later
#
# Copyright (C) 2026 Yixun Lan <dlan@kernel.org>

if TARGET_SPACEMIT_K3

config SYS_BOARD
	default "k3"

config SYS_VENDOR
	default "spacemit"

config SYS_CPU
	default "k3"

config SYS_CONFIG_NAME
	default "spacemit-k3"

config TEXT_BASE
	default 0x102000000

config SPL_OPENSBI_LOAD_ADDR
	hex
	default 0x100000000

config BOARD_SPECIFIC_OPTIONS
	def_bool y
	select SPACEMIT_K3

endif
```

## configs/LicheePi_Zero_Dock_defconfig
```kconfig
CONFIG_ARM=y
CONFIG_ARCH_SUNXI=y
CONFIG_DEFAULT_DEVICE_TREE="allwinner/sun8i-v3s-licheepi-zero-dock"
CONFIG_SPL=y
CONFIG_MACH_SUN8I_V3S=y
CONFIG_SUN8I_EMAC=y
```

## configs/LicheePi_Zero_defconfig
```kconfig
CONFIG_ARM=y
CONFIG_ARCH_SUNXI=y
CONFIG_DEFAULT_DEVICE_TREE="allwinner/sun8i-v3s-licheepi-zero"
CONFIG_SPL=y
CONFIG_MACH_SUN8I_V3S=y
CONFIG_NO_NET=y
```

## configs/am62ax_evm_a53_ethboot_defconfig
```kconfig
#include <configs/am62ax_evm_a53_defconfig>

CONFIG_SPL_DRIVERS_MISC=y
CONFIG_SPL_BOARD_INIT=y
CONFIG_SPL_DMA=y
CONFIG_SPL_ENV_SUPPORT=y
CONFIG_SPL_ETH=y
CONFIG_SPL_NET=y
CONFIG_SPL_NET_VCI_STRING="AM62AX U-Boot A53 SPL"
CONFIG_SPL_SYSCON=y
```

## configs/am62ax_evm_r5_ethboot_defconfig
```kconfig
#include <configs/am62ax_evm_r5_defconfig>

# CONFIG_NO_NET is not set
CONFIG_SPL_GPIO=y
CONFIG_SPL_MMC=n
CONFIG_SPL_STACK_R_ADDR=0x82000000
CONFIG_SPL_STACK_R_MALLOC_SIMPLE_LEN=0x200000
CONFIG_SPL_DMA=y
CONFIG_SPL_ENV_SUPPORT=y
CONFIG_SPL_ETH=y
CONFIG_SPL_I2C=y
CONFIG_NET=y
CONFIG_SPL_NET=y
CONFIG_SPL_NET_VCI_STRING="AM62AX U-Boot R5 SPL"
CONFIG_CMD_DHCP=y
CONFIG_SPL_SYSCON=y
CONFIG_DMA_CHANNELS=y
CONFIG_TI_K3_NAVSS_UDMA=y
CONFIG_DM_I2C=y
CONFIG_PHY_TI_DP83867=y
CONFIG_TI_AM65_CPSW_NUSS=y
```

## configs/ax3005_scm3005_defconfig
```kconfig
CONFIG_ARM=y
CONFIG_COUNTER_FREQUENCY=1000000000
CONFIG_POSITION_INDEPENDENT=y
CONFIG_ARCH_AXIADO=y
CONFIG_TEXT_BASE=0x80000000
CONFIG_SYS_MALLOC_F_LEN=0x8000
CONFIG_TARGET_SCM3005=y
CONFIG_NR_DRAM_BANKS=1
CONFIG_ENV_SIZE=0x10000
CONFIG_ENV_OFFSET=0x5000
CONFIG_DEFAULT_DEVICE_TREE="ax3005-scm3005"
CONFIG_SYS_BOOTM_LEN=0x20000000
CONFIG_SYS_LOAD_ADDR=0x80100000
CONFIG_ARMV8_MULTIENTRY=y
CONFIG_ARMV8_SET_SMPEN=y
CONFIG_ARMV8_SPIN_TABLE=y
CONFIG_SYS_CUSTOM_LDSCRIPT=y
CONFIG_SYS_LDSCRIPT="arch/arm/cpu/armv8/u-boot.lds"
CONFIG_FIT=y
CONFIG_BOOTDELAY=5
CONFIG_AUTOBOOT_KEYED=y
CONFIG_AUTOBOOT_PROMPT="Press \"<Esc><Esc>\" to stop autobooting in %d seconds\n"
CONFIG_AUTOBOOT_STOP_STR="\x1b\x1b"
CONFIG_OF_BOARD_SETUP=y
CONFIG_USE_BOOTARGS=y
CONFIG_BOOTARGS="console=ttyPS3,115200 maxcpus=4 nr_cpus=4 earlycon hugepages=16 root=/dev/ram rw phram.phram=ramrofs,0x80B00000,0x6400000"
CONFIG_USE_BOOTCOMMAND=y
CONFIG_BOOTCOMMAND="bootm ${loadaddr}"
CONFIG_USE_PREBOOT=y
CONFIG_DEFAULT_FDT_FILE="ax3005-scm3005.dtb"
# CONFIG_DISPLAY_CPUINFO is not set
CONFIG_HUSH_PARSER=y
# CONFIG_AUTO_COMPLETE is not set
# CONFIG_SYS_LONGHELP is not set
CONFIG_SYS_PROMPT="Axiado> "
# CONFIG_CMD_BOOTEFI is not set
# CONFIG_CMD_ELF is not set
# CONFIG_CMD_GO is not set
CONFIG_CMD_NVEDIT_EFI=y
CONFIG_CMD_MEMTEST=y
CONFIG_SYS_ALT_MEMTEST=y
CONFIG_CMD_CLK=y
CONFIG_CMD_DFU=y
CONFIG_CMD_DM=y
CONFIG_CMD_GPT=y
CONFIG_CMD_GPT_RENAME=y
CONFIG_CMD_MMC=y
CONFIG_CMD_PART=y
CONFIG_CMD_TFTPPUT=y
CONFIG_CMD_CACHE=y
CONFIG_CMD_EXT2=y
CONFIG_CMD_EXT4=y
CONFIG_CMD_EXT4_WRITE=y
CONFIG_CMD_FAT=y
CONFIG_CMD_FS_GENERIC=y
CONFIG_OF_CONTROL=y
CONFIG_MULTI_DTB_FIT=y
CONFIG_ENV_OVERWRITE=y
CONFIG_ENV_IS_IN_MMC=y
CONFIG_CLK=y
CONFIG_MMC_IO_VOLTAGE=y
CONFIG_MMC_UHS_SUPPORT=y
CONFIG_MMC_HS400_SUPPORT=y
CONFIG_MMC_SDHCI=y
CONFIG_MMC_SDHCI_ADMA=y
CONFIG_PHY=y
# CONFIG_TOOLS_MKEFICAPSULE is not set
```

## configs/imx95_15x15_frdm_defconfig
```kconfig
#include <configs/imx95_frdm.config>
CONFIG_DEFAULT_DEVICE_TREE="freescale/imx95-15x15-frdm"
CONFIG_TARGET_IMX95_15X15_FRDM=y
CONFIG_DEFAULT_FDT_FILE="imx95-15x15-frdm.dtb"
```

## configs/imx95_19x19_frdm_pro_defconfig
```kconfig
#include <configs/imx95_frdm.config>
CONFIG_SF_DEFAULT_SPEED=40000000
CONFIG_DEFAULT_DEVICE_TREE="freescale/imx95-19x19-frdm-pro"
CONFIG_TARGET_IMX95_19X19_FRDM_PRO=y
CONFIG_DEFAULT_FDT_FILE="imx95-19x19-frdm-pro.dtb"
CONFIG_SYS_RX_ETH_BUFFER=8
CONFIG_DM_SPI_FLASH=y
CONFIG_SPI_FLASH_SFDP_SUPPORT=y
CONFIG_SPI_FLASH_WINBOND=y
CONFIG_SPI=y
CONFIG_DM_SPI=y
CONFIG_NXP_FSPI=y
```

## configs/khadas-vim1s_defconfig
```kconfig
CONFIG_ARM=y
CONFIG_SYS_BOARD="vim1s"
CONFIG_ARCH_MESON=y
CONFIG_TEXT_BASE=0x0
CONFIG_SYS_MALLOC_LEN=0x8000000
CONFIG_NR_DRAM_BANKS=1
CONFIG_HAS_CUSTOM_SYS_INIT_SP_ADDR=y
CONFIG_CUSTOM_SYS_INIT_SP_ADDR=0x00200000
CONFIG_ENV_SIZE=0x10000
CONFIG_DM_GPIO=y
CONFIG_DEFAULT_DEVICE_TREE="amlogic/meson-s4-s905y4-khadas-vim1s"
CONFIG_OF_LIBFDT_OVERLAY=y
CONFIG_DM_RESET=y
CONFIG_MESON_S4=y
CONFIG_SYS_LOAD_ADDR=0x20000000
CONFIG_IDENT_STRING=" vim1s"
CONFIG_REMAKE_ELF=y
CONFIG_FIT=y
CONFIG_FIT_SIGNATURE=y
CONFIG_FIT_VERBOSE=y
CONFIG_OF_BOARD_SETUP=y
# CONFIG_DISPLAY_CPUINFO is not set
CONFIG_MISC_INIT_R=y
CONFIG_SYS_MAXARGS=32
CONFIG_CMD_ADC=y
CONFIG_CMD_CLK=y
CONFIG_CMD_GPIO=y
CONFIG_CMD_PWM=y
CONFIG_CMD_GPT=y
CONFIG_CMD_I2C=y
CONFIG_CMD_MMC=y
CONFIG_CMD_WDT=y
CONFIG_CMD_RTC=y
CONFIG_OF_CONTROL=y
CONFIG_OF_UPSTREAM=y
CONFIG_SARADC_MESON=y
CONFIG_BUTTON=y
CONFIG_BUTTON_ADC=y
CONFIG_BUTTON_GPIO=y
CONFIG_DM_I2C=y
CONFIG_I2C_SET_DEFAULT_BUS_NUM=y
CONFIG_SYS_I2C_MESON=y
CONFIG_LED=y
CONFIG_LED_PWM=y
CONFIG_MMC_MESON_GX=y
CONFIG_DM_MDIO=y
CONFIG_DM_MDIO_MUX=y
CONFIG_DM_ETH_PHY=y
CONFIG_ETH_DESIGNWARE_MESON8B=y
CONFIG_MDIO_MUX_MESON_G12A=y
CONFIG_PHY_MESON_GXL=y
CONFIG_PINCTRL=y
CONFIG_PINCTRL_MESON_S4=y
CONFIG_DM_REGULATOR=y
CONFIG_REGULATOR_PWM=y
CONFIG_DM_REGULATOR_FIXED=y
CONFIG_DM_REGULATOR_GPIO=y
CONFIG_DM_PWM=y
CONFIG_PWM_MESON=y
CONFIG_DM_RTC=y
CONFIG_RTC_PCF8563=y
CONFIG_BAUDRATE=888888
CONFIG_MESON_SERIAL=y
CONFIG_WDT=y
CONFIG_WDT_MESON_GXBB=y
# CONFIG_TOOLS_MKEFICAPSULE is not set
```
