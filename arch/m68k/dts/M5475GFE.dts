// SPDX-License-Identifier: GPL-2.0+
/*
 * Copyright (C) 2018 Angelo Dureghello <angelo@sysam.it>
 */

/dts-v1/;
/include/ "mcf54xx.dtsi"

/ {
	model = "Freescale M5475GFE";
	compatible = "fsl,M5475GFE";
};

&fec0 {
	status = "okay";
};

&fec1 {
	status = "okay";
	mii-base = <0>;
};
