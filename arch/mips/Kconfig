## arch/mips/mach-mscc/Kconfig
```kconfig
# SPDX-License-Identifier: (GPL-2.0+ OR MIT)

menu "MSCC VCore-III platforms"
	depends on ARCH_MSCC

config SOC_VCOREIII
	select MIPS_TUNE_24KC
	select ROM_EXCEPTION_VECTORS
	select SUPPORTS_BIG_ENDIAN
	select SUPPORTS_CPU_MIPS32_R1
	select SUPPORTS_CPU_MIPS32_R2
	select SUPPORTS_LITTLE_ENDIAN
	bool

config SYS_SOC
	default "mscc"

config SOC_OCELOT
	bool
	select SOC_VCOREIII
	help
	  This supports MSCC Ocelot family of SOCs.

config SOC_LUTON
	bool
	select SOC_VCOREIII
	help
	  This supports MSCC Luton family of SOCs.

config SYS_CONFIG_NAME
	default "vcoreiii"

choice
	prompt "Board select"

config TARGET_OCELOT_PCB120
	bool "MSCC PCB120 Reference Board (aka VSC5635EV)"
	select SOC_OCELOT
	help
	  When selected, CONFIG_DEFAULT_DEVICE_TREE should be set to
	  ocelot_pcb120

config TARGET_OCELOT_PCB123
	bool "MSCC PCB123 Reference Board (aka VSC7514EV))"
	select SOC_OCELOT
	help
	  When selected, CONFIG_DEFAULT_DEVICE_TREE should be set to
	  ocelot_pcb123

config TARGET_LUTON_PCB091
	bool "MSCC PCB091 Reference Board"
	select SOC_LUTON
	select MSCC_BITBANG_SPI_GPIO
	help
	  When selected, CONFIG_DEFAULT_DEVICE_TREE should be set to
	  luton_pcb091
endchoice

choice
	prompt "DDR type"

config DDRTYPE_H5TQ4G63MFR
	bool "Hynix H5TQ4G63MFR-PBC (4Gbit, DDR3-800, 256Mbitx16)"

config DDRTYPE_MT41K256M16
	bool "Micron MT41K256M16 (4Gbit, DDR3L-800, 256Mbitx16)"

config DDRTYPE_H5TQ1G63BFA
	bool "Hynix H5TQ1G63BFA (1Gbit DDR3, x16)"

config DDRTYPE_MT41J128M16HA
	bool "Micron MT41J128M16HA-15E:D (2Gbit DDR3, x16)"

config DDRTYPE_MT41K128M16JT
	bool "Micron MT41K128M16JT-125 (2Gbit DDR3L, 128Mbitx16)"

config DDRTYPE_MT47H128M8HQ
	bool "Micron MT47H128M8-3 (1Gbit, DDR-533@CL4 @ 4.80ns 16Mbisx8x8)"

endchoice

source "board/mscc/ocelot/Kconfig"

source "board/mscc/luton/Kconfig"

endmenu
```

## arch/mips/mach-mt7620/Kconfig
```kconfig
menu "MediaTek MIPS platforms"
	depends on ARCH_MT7620

config SYS_MALLOC_F_LEN
	default 0x1000

config SYS_SOC
	default "mt7620" if SOC_MT7620

choice
	prompt "MediaTek MIPS SoC select"

config SOC_MT7620
	bool "MT7620/8"
	select MIPS_L1_CACHE_SHIFT_5
	help
	  This supports MediaTek MIPS MT7620 family.

endchoice

choice
	prompt "Board select"

endchoice

choice
	prompt "Boot mode"

config BOOT_RAM
	bool "RAM boot"
	depends on SUPPORTS_BOOT_RAM
	help
	  This builds an image that is linked to a RAM address. It can be used
	  for booting from CFE via TFTP using an ELF image, but it can also be
	  booted from RAM by other bootloaders using a BIN image.

config BOOT_ROM
	bool "ROM boot"
	depends on SUPPORTS_BOOT_RAM
	help
	  This builds an image that is linked to a ROM address. It can be
	  used as main bootloader image which is programmed onto the onboard
	  flash storage (SPI NOR).

endchoice

choice
	prompt "DDR2 size"

config ONBOARD_DDR2_SIZE_256MBIT
	bool "256MBit (32MByte) total size"
	depends on BOOT_ROM
	help
	  Use 256MBit (32MByte) of DDR total size

config ONBOARD_DDR2_SIZE_512MBIT
	bool "512MBit (64MByte) total size"
	depends on BOOT_ROM
	help
	  Use 512MBit (64MByte) of DDR total size

config ONBOARD_DDR2_SIZE_1024MBIT
	bool "1024MBit (128MByte) total size"
	depends on BOOT_ROM
	help
	  Use 1024MBit (128MByte) of DDR total size

config ONBOARD_DDR2_SIZE_2048MBIT
	bool "2048MBit (256MByte) total size"
	depends on BOOT_ROM
	help
	  Use 2048MBit (256MByte) of DDR total size

endchoice

choice
	prompt "DDR2 chip width"

config ONBOARD_DDR2_CHIP_WIDTH_8BIT
	bool "8bit DDR chip width"
	depends on BOOT_ROM
	help
	  Use DDR chips with 8bit width

config ONBOARD_DDR2_CHIP_WIDTH_16BIT
	bool "16bit DDR chip width"
	depends on BOOT_ROM
	help
	  Use DDR chips with 16bit width

endchoice

choice
	prompt "DDR2 bus width"

config ONBOARD_DDR2_BUS_WIDTH_16BIT
	bool "16bit DDR bus width"
	depends on BOOT_ROM
	help
	  Use 16bit DDR bus width

config ONBOARD_DDR2_BUS_WIDTH_32BIT
	bool "32bit DDR bus width"
	depends on BOOT_ROM
	help
	  Use 32bit DDR bus width

endchoice

config SUPPORTS_BOOT_RAM
	bool

endmenu
```

## arch/mips/mach-mtmips/Kconfig
```kconfig
menu "MediaTek MIPS platforms"
	depends on ARCH_MTMIPS

config SYS_VENDOR
	default "mediatek" if BOARD_MT7628_RFB || BOARD_MT7620_RFB || BOARD_MT7620_MT7530_RFB

config SYS_MALLOC_F_LEN
	default 0x1000

config SYS_SOC
	default "mt7620" if SOC_MT7620
	default "mt7628" if SOC_MT7628

config SYS_DCACHE_SIZE
	default 32768

config SYS_DCACHE_LINE_SIZE
	default 32

config SYS_ICACHE_SIZE
	default 65536

config SYS_ICACHE_LINE_SIZE
	default 32

config SYS_TEXT_BASE
	default 0x9c000000 if !SPL
	default 0x80200000 if SPL

config SPL_TEXT_BASE
	default 0x9c000000

config SPL_PAYLOAD
	default "u-boot-lzma.img" if SPL_LZMA

config BUILD_TARGET
	default "u-boot-with-spl.bin" if SPL
	default "u-boot.bin"

choice
	prompt "MediaTek MIPS SoC select"

config SOC_MT7620
	bool "MT7620"
	select SYS_CACHE_SHIFT_5
	select SYS_MIPS_CACHE_INIT_RAM_LOAD
	select PINCTRL_MT7620
	select MT7620_SERIAL
	select MISC
	select SPL_SEPARATE_BSS if SPL
	select SPL_LOADER_SUPPORT if SPL
	select SPL_OF_CONTROL if SPL_DM
	select SPL_OF_PLATDATA if SPL_DM
	select SPL_DM_SERIAL if SPL_DM
	help
	  This supports MediaTek MT7620.

config SOC_MT7628
	bool "MT7628"
	select SYS_CACHE_SHIFT_5
	select MIPS_INIT_STACK_IN_SRAM
	select MIPS_SRAM_INIT
	select SYS_MIPS_CACHE_INIT_RAM_LOAD
	select PINCTRL_MT7628
	select MTK_SERIAL
	select SYSRESET
	select SYSRESET_RESETCTL
	select SPL_SEPARATE_BSS if SPL
	select SPL_INIT_STACK_WITHOUT_MALLOC_F if SPL
	select SPL_LOADER_SUPPORT if SPL
	select SPL_OF_CONTROL if SPL_DM
	select SPL_SIMPLE_BUS if SPL_DM
	select SPL_DM_SERIAL if SPL_DM
	select SPL_CLK if SPL_DM && SPL_SERIAL
	select SPL_SYSRESET if SPL_DM
	select SPL_OF_LIBFDT if SPL_OF_CONTROL
	help
	  This supports MediaTek MT7628/MT7688.

endchoice

source "arch/mips/mach-mtmips/mt7620/Kconfig"
source "arch/mips/mach-mtmips/mt7628/Kconfig"

endmenu
```

## arch/mips/mach-mtmips/mt7620/Kconfig
```kconfig
if SOC_MT7620

config DEBUG_UART_BOARD_INIT
	default y

choice
	prompt "Board select"

config BOARD_MT7620_RFB
	bool "MediaTek MT7620 RFB"
	help
	  The reference design of MT7620A (WS2120). The board has 64 MiB DDR2,
	  8 MiB SPI-NOR flash, 1 built-in 6 port switch (two GE PHYs and five
	  FE PHYs,one port can be configured to use either FE PHY or GE PHY),
	  1 UART, 1 USB host, 1 SDXC, 1 PCIe socket and JTAG pins.

config BOARD_MT7620_MT7530_RFB
	bool "MediaTek MT7620-MT7530 RFB"
	help
	  The reference design of MT7620DA (MTKC712). The board has 64 MiB
	  intergrated DDR2 KGD, 16 MiB SPI-NOR flash, an external 5-port giga
	  switch MT7530 and 1 UART.

config BOARD_EDUP_EP2913
	bool "EDUP EP-2913"
	help
	  A Wifi range extender with one 100Mbps port (Internal FE).
	  The stock board has 32 MiB DDR1 RAM and 4 MiB SPI flash.
	  This profile has been tested to support 64 MiB of DDR1 RAM.
	  The RAM installed is NP25D3216512K-5.

endchoice

choice
	prompt "CPU frequency select"
	default CPU_FREQ_580MHZ

config CPU_FREQ_480MHZ
	bool "480MHz"

config CPU_FREQ_500MHZ
	bool "500MHz"

config CPU_FREQ_520MHZ
	bool "520MHz"

config CPU_FREQ_540MHZ
	bool "540MHz"

config CPU_FREQ_560MHZ
	bool "560MHz"

config CPU_FREQ_580MHZ
	bool "580MHz"

config CPU_FREQ_600MHZ
	bool "600MHz"

config CPU_FREQ_620MHZ
	bool "620MHz"

endchoice

config CPU_FREQ_MULTI
	int
	range 0 7
	default 0 if CPU_FREQ_480MHZ
	default 1 if CPU_FREQ_500MHZ
	default 2 if CPU_FREQ_520MHZ
	default 3 if CPU_FREQ_540MHZ
	default 4 if CPU_FREQ_560MHZ
	default 5 if CPU_FREQ_580MHZ
	default 6 if CPU_FREQ_600MHZ
	default 7 if CPU_FREQ_620MHZ

config SYS_CONFIG_NAME
	default "mt7620" if  BOARD_MT7620_RFB || BOARD_MT7620_MT7530_RFB || BOARD_EDUP_EP2913

config SYS_BOARD
	string "Board name"
	default "mt7620" if  BOARD_MT7620_RFB || BOARD_MT7620_MT7530_RFB || BOARD_EDUP_EP2913

endif
```

## arch/mips/mach-pic32/Kconfig
```kconfig
menu "Microchip PIC32 platforms"
	depends on MACH_PIC32

config SYS_SOC
	default "none"

endmenu
```

## arch/nds32/Kconfig
```kconfig
menu "NDS32 architecture"
	depends on NDS32

config SYS_ARCH
	default "nds32"

choice
	prompt "Target select"
	optional

config TARGET_ADP_AG101P
	bool "Support adp-ag101p"

config TARGET_ADP_AE3XX
	bool "Support adp-ae3xx"

endchoice

config SYS_ICACHE_OFF
	bool "Do not enable icache"
	default n
	help
	  Do not enable instruction cache in U-Boot.

config SYS_DCACHE_OFF
	bool "Do not enable dcache"
	default n
	help
	  Do not enable data cache in U-Boot.

source "board/AndesTech/adp-ag101p/Kconfig"
source "board/AndesTech/adp-ae3xx/Kconfig"

endmenu
```

## arch/nios2/Kconfig
```kconfig
menu "Nios II architecture"
	depends on NIOS2

config SYS_ARCH
	default "nios2"

endmenu
```

## arch/openrisc/Kconfig
```kconfig
menu "OpenRISC architecture"
	depends on OPENRISC

config SYS_ARCH
	default "openrisc"

choice
	prompt "Target select"
	optional

config TARGET_OPENRISC_GENERIC
	bool "Support openrisc-generic"

endchoice

source "board/openrisc/openrisc-generic/Kconfig"

endmenu
```

## arch/powerpc/Kconfig
```kconfig
menu "PowerPC architecture"
	depends on PPC

config SYS_ARCH
	default "powerpc"

choice
	prompt "CPU select"
	optional

config MPC83xx
	bool "MPC83xx"
	select CREATE_ARCH_SYMLINK
	select SYS_FSL_HAS_SEC
	select SYS_FSL_SEC_BE
	select SYS_FSL_SEC_COMPAT_2

config MPC85xx
	bool "MPC85xx"
	select CREATE_ARCH_SYMLINK
	select SYS_FSL_DDR
	select SYS_FSL_DDR_BE
	select SYS_FSL_IFC_BE
	select BINMAN if MPC85XX_HAVE_RESET_VECTOR && OF_SEPARATE
	imply CMD_HASH
	imply CMD_IRQ
	imply USB_EHCI_HCD if USB

config MPC8xx
	bool "MPC8xx"
	select BOARD_EARLY_INIT_F
	imply CMD_REGINFO
	imply WDT_MPC8xx

endchoice

config HIGH_BATS
	bool "Enable high BAT registers"
	help
	  Enable BATs (block address translation registers) 4-7 on machines
	  that support them.

config SYS_INIT_RAM_LOCK
	bool "Lock some portion of L1 for initial ram stack"
	depends on MPC83xx || MPC85xx

source "arch/powerpc/cpu/mpc83xx/Kconfig"
source "arch/powerpc/cpu/mpc85xx/Kconfig"
source "arch/powerpc/cpu/mpc8xx/Kconfig"
source "arch/powerpc/lib/Kconfig"

endmenu
```

## arch/powerpc/cpu/74xx_7xx/Kconfig
```kconfig
menu "74xx_7xx CPU"
	depends on 74xx_7xx

config SYS_CPU
	default "74xx_7xx"

choice
	prompt "Target select"

config TARGET_P3G4
	bool "Support P3G4"

config TARGET_ZUMA
	bool "Support ZUMA"

config TARGET_PPMC7XX
	bool "Support ppmc7xx"

config TARGET_ELPPC
	bool "Support ELPPC"

config TARGET_MPC7448HPC2
	bool "Support mpc7448hpc2"

endchoice

source "board/eltec/elppc/Kconfig"
source "board/evb64260/Kconfig"
source "board/freescale/mpc7448hpc2/Kconfig"
source "board/ppmc7xx/Kconfig"

endmenu
```

## arch/powerpc/cpu/mpc512x/Kconfig
```kconfig
menu "mpc512x CPU"
	depends on MPC512X

config SYS_CPU
	default "mpc512x"

choice
	prompt "Target select"
	optional

config TARGET_PDM360NG
	bool "Support pdm360ng"

config TARGET_ARIA
	bool "Support aria"

config TARGET_MECP5123
	bool "Support mecp5123"

config TARGET_MPC5121ADS
	bool "Support mpc5121ads"

config TARGET_AC14XX
	bool "Support ac14xx"

endchoice

source "board/davedenx/aria/Kconfig"
source "board/esd/mecp5123/Kconfig"
source "board/freescale/mpc5121ads/Kconfig"
source "board/ifm/ac14xx/Kconfig"
source "board/pdm360ng/Kconfig"

endmenu
```

## arch/powerpc/cpu/mpc5xx/Kconfig
```kconfig
menu "mpc5xx CPU"
	depends on 5xx

config SYS_CPU
	default "mpc5xx"

choice
	prompt "Target select"
	optional

config TARGET_PATI
	bool "Support PATI"

endchoice

source "board/mpl/pati/Kconfig"

endmenu
```

## arch/powerpc/cpu/mpc5xxx/Kconfig
```kconfig
menu "mpc5xxx CPU"
	depends on MPC5xxx

config SYS_CPU
	default "mpc5xxx"

choice
	prompt "Target select"

config TARGET_A3M071
	bool "Support a3m071"
	select SUPPORT_SPL

config TARGET_A4M072
	bool "Support a4m072"

config TARGET_CANMB
	bool "Support canmb"

config TARGET_CM5200
	bool "Support cm5200"

config TARGET_INKA4X0
	bool "Support inka4x0"

config TARGET_IPEK01
	bool "Support ipek01"

config TARGET_JUPITER
	bool "Support jupiter"

config TARGET_MOTIONPRO
	bool "Support motionpro"

config TARGET_MUNICES
	bool "Support munices"

config TARGET_V38B
	bool "Support v38b"

config TARGET_O2D
	bool "Support O2D"

config TARGET_O2D300
	bool "Support O2D300"

config TARGET_O2DNT2
	bool "Support O2DNT2"

config TARGET_O2I
	bool "Support O2I"

config TARGET_O2MNT
	bool "Support O2MNT"

config TARGET_O3DNT
	bool "Support O3DNT"

config TARGET_DIGSY_MTC
	bool "Support digsy_mtc"

config TARGET_PCM030
	bool "Support pcm030"

config TARGET_CHARON
	bool "Support charon"

config TARGET_TQM5200
	bool "Support TQM5200"

endchoice

source "board/a3m071/Kconfig"
source "board/a4m072/Kconfig"
source "board/canmb/Kconfig"
source "board/cm5200/Kconfig"
source "board/ifm/o2dnt2/Kconfig"
source "board/inka4x0/Kconfig"
source "board/intercontrol/digsy_mtc/Kconfig"
source "board/ipek01/Kconfig"
source "board/jupiter/Kconfig"
source "board/motionpro/Kconfig"
source "board/munices/Kconfig"
source "board/phytec/pcm030/Kconfig"
source "board/tqc/tqm5200/Kconfig"
source "board/v38b/Kconfig"

endmenu
```

## arch/powerpc/cpu/mpc824x/Kconfig
```kconfig
menu "mpc824x CPU"
	depends on MPC824X

config SYS_CPU
	default "mpc824x"

choice
	prompt "Target select"

config TARGET_A3000
	bool "Support A3000"

config TARGET_CPC45
	bool "Support CPC45"

config TARGET_CU824
	bool "Support CU824"

config TARGET_EXALION
	bool "Support eXalion"

config TARGET_MUSENKI
	bool "Support MUSENKI"

config TARGET_MVBLUE
	bool "Support MVBLUE"

config TARGET_SANDPOINT8240
	bool "Support Sandpoint8240"

config TARGET_SANDPOINT8245
	bool "Support Sandpoint8245"

config TARGET_UTX8245
	bool "Support utx8245"

endchoice

source "board/a3000/Kconfig"
source "board/cpc45/Kconfig"
source "board/cu824/Kconfig"
source "board/eXalion/Kconfig"
source "board/musenki/Kconfig"
source "board/mvblue/Kconfig"
source "board/sandpoint/Kconfig"
source "board/utx8245/Kconfig"

endmenu
```

## arch/powerpc/cpu/mpc8260/Kconfig
```kconfig
menu "mpc8260 CPU"
	depends on MPC8260

config SYS_CPU
	default "mpc8260"

choice
	prompt "Target select"
	optional

config TARGET_KM82XX
	bool "Support km82xx"
	imply CMD_CRAMFS
	imply FS_CRAMFS

endchoice

source "board/keymile/km82xx/Kconfig"

endmenu
```
