## arch/powerpc/cpu/mpc86xx/Kconfig
```kconfig
menu "mpc86xx CPU"
	depends on MPC86xx

config SYS_CPU
	default "mpc86xx"

choice
	prompt "Target select"

config TARGET_SBC8641D
	bool "Support sbc8641d"

config TARGET_MPC8610HPCD
	bool "Support MPC8610HPCD"

config TARGET_MPC8641HPCN
	bool "Support MPC8641HPCN"

config TARGET_XPEDITE517X
	bool "Support xpedite517x"

endchoice

source "board/freescale/mpc8610hpcd/Kconfig"
source "board/freescale/mpc8641hpcn/Kconfig"
source "board/sbc8641d/Kconfig"
source "board/xes/xpedite517x/Kconfig"

endmenu
```

## arch/powerpc/cpu/mpc8xx/Kconfig
```kconfig
menu "mpc8xx CPU"
	depends on MPC8xx

config SYS_CPU
	default "mpc8xx"

choice
	prompt "Target select"
	optional

config TARGET_MCR3000
	bool "Support MCR3000 board from CSSI"

endchoice

choice
	prompt "CPU select"
	default MPC866

config MPC866
	bool "MPC866"
	select SYS_CACHE_SHIFT_4

config MPC885
	bool "MPC885"
	select SYS_CACHE_SHIFT_4

endchoice

config 8xx_GCLK_FREQ
	int "CPU GCLK Frequency"

comment "Specific commands"

config CMD_IMMAP
	bool "Enable various commands to dump IMMR information"
	help
	  This enables various commands such as:

	    siuinfo - print System Interface Unit (SIU) registers
	    memcinfo - print Memory Controller registers

comment "Configuration Registers"

config SYS_SIUMCR
	hex "SIUMCR register"
	help
	  SIU Module Configuration (11-6)

config SYS_SYPCR
	hex "SYPCR register"
	help
	  System Protection Control (11-9)

config SYS_TBSCR
	hex "TBSCR register"
	help
	  Time Base Status and Control (11-26)

config SYS_PISCR
	hex "PISCR register"
	help
	  Periodic Interrupt Status and Control (11-31)

config SYS_PLPRCR_BOOL
	bool "Customise PLPRCR"

config SYS_PLPRCR
	hex "PLPRCR register"
	depends on SYS_PLPRCR_BOOL
	help
	  PLL, Low-Power, and Reset Control Register (15-30)

config SYS_SCCR
	hex "SCCR register"
	help
	  System Clock and reset Control Register (15-27)

config SYS_SCCR_MASK
	hex "MASK for setting SCCR register"

config SYS_DER
	hex "DER register"
	help
	  Debug Event Register (37-47)

source "board/cssi/MCR3000/Kconfig"

endmenu
```

## arch/powerpc/cpu/ppc4xx/Kconfig
```kconfig
menu "ppc4xx CPU"
	depends on 4xx

config SYS_CPU
	default "ppc4xx"

choice
	prompt "Target select"

config TARGET_CSB272
	bool "Support csb272"

config TARGET_CSB472
	bool "Support csb472"

config TARGET_LWMON5
	bool "Support lwmon5"
	select SUPPORT_SPL

config TARGET_PCS440EP
	bool "Support pcs440ep"

config TARGET_SBC405
	bool "Support sbc405"

config TARGET_SC3
	bool "Support sc3"

config TARGET_T3CORP
	bool "Support t3corp"

config TARGET_ZEUS
	bool "Support zeus"

config TARGET_ACADIA
	bool "Support acadia"

config TARGET_BAMBOO
	bool "Support bamboo"

config TARGET_BUBINGA
	bool "Support bubinga"

config TARGET_CANYONLANDS
	bool "Support canyonlands"

config TARGET_EBONY
	bool "Support ebony"

config TARGET_KATMAI
	bool "Support katmai"

config TARGET_KILAUEA
	bool "Support kilauea"

config TARGET_LUAN
	bool "Support luan"

config TARGET_MAKALU
	bool "Support makalu"

config TARGET_OCOTEA
	bool "Support ocotea"

config TARGET_REDWOOD
	bool "Support redwood"

config TARGET_SEQUOIA
	bool "Support sequoia"

config TARGET_TAIHU
	bool "Support taihu"

config TARGET_TAISHAN
	bool "Support taishan"

config TARGET_WALNUT
	bool "Support walnut"

config TARGET_YOSEMITE
	bool "Support yosemite"

config TARGET_YUCCA
	bool "Support yucca"

config TARGET_FX12MM
	bool "Support fx12mm"

config TARGET_V5FX30TEVAL
	bool "Support v5fx30teval"

config TARGET_CPCI2DP
	bool "Support CPCI2DP"

config TARGET_CPCI4052
	bool "Support CPCI4052"

config TARGET_PLU405
	bool "Support PLU405"

config TARGET_PMC405DE
	bool "Support PMC405DE"

config TARGET_PMC440
	bool "Support PMC440"

config TARGET_VOM405
	bool "Support VOM405"

config TARGET_DLVISION_10G
	bool "Support dlvision-10g"

config TARGET_IO
	bool "Support io"

config TARGET_IOCON
	bool "Support iocon"

config TARGET_NEO
	bool "Support neo"

config TARGET_IO64
	bool "Support io64"

config TARGET_DLVISION
	bool "Support dlvision"

config TARGET_GDPPC440ETX
	bool "Support gdppc440etx"

config TARGET_INTIP
	bool "Support intip"

config TARGET_ICON
	bool "Support icon"

config TARGET_MIP405
	bool "Support MIP405"

config TARGET_PIP405
	bool "Support PIP405"

config TARGET_ALPR
	bool "Support alpr"

config TARGET_P3P440
	bool "Support p3p440"

config TARGET_XPEDITE1000
	bool "Support xpedite1000"

config TARGET_ML507
	bool "Support ml507"

config TARGET_XILINX_PPC405_GENERIC
	bool "Support xilinx-ppc405-generic"

config TARGET_XILINX_PPC440_GENERIC
	bool "Support xilinx-ppc440-generic"

endchoice

source "board/amcc/acadia/Kconfig"
source "board/amcc/bamboo/Kconfig"
source "board/amcc/bubinga/Kconfig"
source "board/amcc/canyonlands/Kconfig"
source "board/amcc/ebony/Kconfig"
source "board/amcc/katmai/Kconfig"
source "board/amcc/kilauea/Kconfig"
source "board/amcc/luan/Kconfig"
source "board/amcc/makalu/Kconfig"
source "board/amcc/ocotea/Kconfig"
source "board/amcc/redwood/Kconfig"
source "board/amcc/sequoia/Kconfig"
source "board/amcc/taihu/Kconfig"
source "board/amcc/taishan/Kconfig"
source "board/amcc/walnut/Kconfig"
source "board/amcc/yosemite/Kconfig"
source "board/amcc/yucca/Kconfig"
source "board/avnet/fx12mm/Kconfig"
source "board/avnet/v5fx30teval/Kconfig"
source "board/csb272/Kconfig"
source "board/csb472/Kconfig"
source "board/esd/cpci2dp/Kconfig"
source "board/esd/cpci405/Kconfig"
source "board/esd/plu405/Kconfig"
source "board/esd/pmc405de/Kconfig"
source "board/esd/pmc440/Kconfig"
source "board/esd/vom405/Kconfig"
source "board/gdsys/405ep/Kconfig"
source "board/gdsys/405ex/Kconfig"
source "board/gdsys/dlvision/Kconfig"
source "board/gdsys/gdppc440etx/Kconfig"
source "board/gdsys/intip/Kconfig"
source "board/lwmon5/Kconfig"
source "board/mosaixtech/icon/Kconfig"
source "board/mpl/mip405/Kconfig"
source "board/mpl/pip405/Kconfig"
source "board/pcs440ep/Kconfig"
source "board/prodrive/alpr/Kconfig"
source "board/prodrive/p3p440/Kconfig"
source "board/sbc405/Kconfig"
source "board/sc3/Kconfig"
source "board/t3corp/Kconfig"
source "board/xes/xpedite1000/Kconfig"
source "board/xilinx/ml507/Kconfig"
source "board/xilinx/ppc405-generic/Kconfig"
source "board/xilinx/ppc440-generic/Kconfig"
source "board/zeus/Kconfig"

endmenu
```

## arch/powerpc/lib/Kconfig
```kconfig
config CACHE_FLUSH_WATCHDOG_THRESHOLD
	int "Bytes to flush between WATCHDOG_RESET calls"
	default 0
	help
	  The flush_cache() function periodically, and by default for
	  every cache line, calls WATCHDOG_RESET(). When flushing a
	  large area, that may add a significant amount of
	  overhead. This option allows you to set a threshold for how
	  many bytes to flush between each WATCHDOG_RESET call.
```
