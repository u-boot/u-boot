// SPDX-License-Identifier: GPL-2.0
/*
 * Copyright (C) 2020 MediaTek Inc.
 *
 * Author: Weijie Gao <weijie.gao@mediatek.com>
 */

&uartlite {
	u-boot,dm-pre-reloc;
};

&uartfull {
	u-boot,dm-pre-reloc;
};
