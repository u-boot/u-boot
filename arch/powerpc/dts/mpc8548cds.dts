// SPDX-License-Identifier: GPL-2.0+ OR X11
/*
 * MPC8548CDS Device Tree Source
 *
 * Copyright 2006 - 2012 Freescale Semiconductor Inc.
 * Copyright 2019 NXP
 */

/include/ "mpc8548.dtsi"

/ {
	model = "fsl,MPC8548CDS";
	compatible = "fsl,MPC8548CDS";
	#address-cells = <2>;
	#size-cells = <2>;
	interrupt-parent = <&mpic>;

	soc: soc8548@e0000000 {
		ranges = <0x0 0x0 0xe0000000 0x100000>;
	};
};

/include/ "mpc8548-post.dtsi"
