/dts-v1/;
/ {
	#address-cells = <1>;
	#size-cells = <1>;

	aliases {
		console = &uart0;
	};

	uart0: serial@8b000000 {
		compatible = "xlnx,xps-uartlite-1.00.a";
		interrupts = <0 0>;
		reg = <0x8b000000 0x10000>;
	};
} ;
