## arch/x86/cpu/baytrail/Kconfig
```kconfig
#
# Copyright (C) 2015 Google, Inc
#
# SPDX-License-Identifier:	GPL-2.0+
#

config INTEL_BAYTRAIL
	bool
	select HAVE_FSP if !EFI
	select ARCH_MISC_INIT if !EFI
	select CPU_INTEL_TURBO_NOT_PACKAGE_SCOPED
	imply HAVE_INTEL_ME if !EFI
	imply ENABLE_MRC_CACHE
	imply AHCI_PCI
	imply ICH_SPI
	imply INTEL_ICH6_GPIO
	imply MMC
	imply MMC_PCI
	imply MMC_SDHCI
	imply MMC_SDHCI_SDMA
	imply SCSI
	imply SCSI_AHCI
	imply SPI_FLASH
	imply SYS_NS16550
	imply USB
	imply USB_EHCI_HCD
	imply USB_XHCI_HCD
	imply VIDEO_VESA

if INTEL_BAYTRAIL
config INTERNAL_UART
	bool "Enable the SoC integrated legacy UART"
	help
	  There is a legacy UART integrated into the Bay Trail SoC.
	  A maximum baud rate of 115200 bps is supported. For this
	  reason, it is recommended that the UART port be used for
	  debug purposes only, eg: U-Boot console.

config DEBUG_UART
	bool
	select DEBUG_UART_BOARD_INIT

endif
```

## arch/x86/cpu/broadwell/Kconfig
```kconfig
#
# Copyright (C) 2016 Google Inc.
#
# SPDX-License-Identifier:	GPL-2.0

config INTEL_BROADWELL
	bool
	select CACHE_MRC_BIN

if INTEL_BROADWELL

config DCACHE_RAM_BASE
	default 0xff7c0000

config DCACHE_RAM_SIZE
	default 0x40000

config DCACHE_RAM_MRC_VAR_SIZE
	default 0x30000

config CPU_SPECIFIC_OPTIONS
	def_bool y
	select SMM_TSEG
	select X86_RAMTEST

config SMM_TSEG_SIZE
	hex
	default 0x800000

endif
```

## arch/x86/cpu/coreboot/Kconfig
```kconfig
if TARGET_COREBOOT

config SYS_COREBOOT
	bool
	default y
	imply AHCI_PCI
	imply E1000
	imply ICH_SPI
	imply MMC
	imply MMC_PCI
	imply MMC_SDHCI
	imply MMC_SDHCI_SDMA
	imply SCSI_AHCI
	imply SPI_FLASH
	imply SYS_NS16550
	imply USB
	imply USB_EHCI_HCD
	imply USB_XHCI_HCD
	imply VIDEO_COREBOOT
	imply CMD_CBFS
	imply FS_CBFS

config CBMEM_CONSOLE
	bool
	default y

endif
```

## arch/x86/cpu/ivybridge/Kconfig
```kconfig
#
# From Coreboot src/northbridge/intel/sandybridge/Kconfig
#
# Copyright (C) 2010 Google Inc.
#
# SPDX-License-Identifier:	GPL-2.0

config NORTHBRIDGE_INTEL_IVYBRIDGE
	bool
	select CACHE_MRC_BIN

if NORTHBRIDGE_INTEL_IVYBRIDGE

config CACHE_MRC_BIN
	bool
	default n

config CACHE_MRC_SIZE_KB
	int
	default 512

config DCACHE_RAM_BASE
	hex
	default 0xff7e0000

config DCACHE_RAM_SIZE
	hex
	default 0x20000

config HAVE_MRC
        bool "Add a System Agent binary"
        help
          Select this option to add a System Agent binary to
          the resulting U-Boot image. MRC stands for Memory Reference Code.
          It is a binary blob which U-Boot uses to set up SDRAM.

          Note: Without this binary U-Boot will not be able to set up its
          SDRAM so will not boot.

config DCACHE_RAM_MRC_VAR_SIZE
	hex
	default 0x4000
	help
	  This is the amount of CAR (Cache as RAM) reserved for use by the
	  memory reference code. This should be set to 16KB (0x4000 hex)
	  so that MRC has enough space to run.

config CPU_SPECIFIC_OPTIONS
	def_bool y
	select SMM_TSEG
	select X86_RAMTEST

config SMM_TSEG_SIZE
	hex
	default 0x800000

config ENABLE_VMX
	bool "Enable VMX for virtualization"
	default n
	help
	  Virtual Machine Extensions are provided in many x86 CPUs. These
	  provide various facilities for allowing a host OS to provide an
	  environment where potentially several guest OSes have only
	  limited access to the underlying hardware. This is achieved
	  without resorting to software trapping and/or instruction set
	  emulation (which would be very slow).

	  Intel's implementation of this is called VT-x. This option enables
	  VT-x this so that the OS that is booted by U-Boot can make use of
	  these facilities. If this option is not enabled, then the host OS
	  will be unable to support virtualisation, or it will run very
	  slowly.

config FSP_ADDR
	hex
	default 0xfff80000

config FSP_USE_UPD
	bool
	default n

config FSP_BROKEN_HOB
	bool
	default y

endif
```

## arch/x86/cpu/qemu/Kconfig
```kconfig
#
# Copyright (C) 2015, Bin Meng <bmeng.cn@gmail.com>
#
# SPDX-License-Identifier:	GPL-2.0+
#

config QEMU
	bool

if QEMU

config SYS_CAR_ADDR
	hex
	default 0xd0000

config SYS_CAR_SIZE
	hex
	default 0x10000

config ACPI_PM1_BASE
	hex
	default 0xe400
	help
	  ACPI Power Managment 1 (PM1) i/o-mapped base address.
	  This device is defined in ACPI specification, with 16 bytes in size.

endif
```

## arch/x86/cpu/queensbay/Kconfig
```kconfig
#
# Copyright (C) 2014, Bin Meng <bmeng.cn@gmail.com>
#
# SPDX-License-Identifier:	GPL-2.0+
#

config INTEL_QUEENSBAY
	bool
	select HAVE_FSP
	select HAVE_CMC

if INTEL_QUEENSBAY

config HAVE_CMC
	bool "Add a Chipset Micro Code state machine binary"
	help
	  Select this option to add a Chipset Micro Code state machine binary
	  to the resulting U-Boot image. It is a 64K data block of machine
	  specific code which must be put in the flash for the processor to
	  access when powered up before system BIOS is executed.

config CMC_FILE
	string "Chipset Micro Code state machine filename"
	depends on HAVE_CMC
	default "cmc.bin"
	help
	  The filename of the file to use as Chipset Micro Code state machine
	  binary in the board directory.

config CMC_ADDR
	hex "Chipset Micro Code state machine binary location"
	depends on HAVE_CMC
	default 0xfffb0000
	help
	  The location of the CMC binary is determined by a strap. It must be
	  put in flash at a location matching the strap-determined base address.

	  The default base address of 0xfffb0000 indicates that the binary must
	  be located at offset 0xb0000 from the beginning of a 1MB flash device.

config CPU_ADDR_BITS
	int
	default 32

config DISABLE_IGD
	bool "Disable Integrated Graphics Device (IGD)"
	help
	  Disable the Integrated Graphics Device (IGD) so that it does not
	  show in the PCI configuration space as a VGA disaplay controller.
	  This gives a chance for U-Boot to run PCI/PCIe based graphics
	  card's VGA BIOS and use that card for the graphics console.

endif
```

## arch/x86/cpu/tangier/Kconfig
```kconfig
#
# Copyright (c) 2017 Intel Corporation
#
# SPDX-License-Identifier:	GPL-2.0+
#

config INTEL_TANGIER
	bool
	depends on INTEL_MID

config SYS_CAR_ADDR
	hex
	default 0x19200000

config SYS_CAR_SIZE
	hex
	default 0x4000
	help
	  Space in bytes in eSRAM used as Cache-As-RAM (CAR).
	  Note this size must not exceed eSRAM's total size.

config SYS_USB_OTG_BASE
	hex
	default 0xf9100000
```

## arch/xtensa/Kconfig
```kconfig
menu "Xtensa architecture"
	depends on XTENSA

config SYS_ARCH
	string
	default "xtensa"

config SYS_CPU
	string "Xtensa Core Variant"

choice
	prompt "Target select"

config TARGET_XTFPGA
	bool "Support XTFPGA"
	select BOARD_POSTCLK_INIT

config TARGET_QEMU_XTENSA
	bool "Support QEMU Xtensa Virt Board"
	select BOARD_LATE_INIT

endchoice

config SYS_ICACHE_OFF
	bool "Do not enable icache"
	help
	  Do not enable instruction cache in U-Boot.

config SPL_SYS_ICACHE_OFF
	bool "Do not enable icache in SPL"
	depends on SPL
	default SYS_ICACHE_OFF
	help
	  Do not enable instruction cache in SPL.

config SYS_DCACHE_OFF
	bool "Do not enable dcache"
	help
	  Do not enable data cache in U-Boot.

config SPL_SYS_DCACHE_OFF
	bool "Do not enable dcache in SPL"
	depends on SPL
	default SYS_DCACHE_OFF
	help
	  Do not enable data cache in SPL.

config XTENSA_SEMIHOSTING
	bool "Support semihosting"
	help
	  Enable Xtensa semihosting debugging support.

choice
	prompt "Semihosting interface"
	default XTENSA_SIMCALL_ISS
	depends on XTENSA_SEMIHOSTING
	help
	  Choose semihosting interface that will be used for serial port,
	  block device and networking.

config XTENSA_SIMCALL_ISS
	bool "simcall"
	help
	  Use simcall instruction. simcall is only available on simulators,
	  it does nothing on hardware.

config XTENSA_SIMCALL_GDBIO
	bool "GDBIO"
	help
	  Use break instruction. It is available on real hardware when GDB
	  is attached to it via JTAG.

endchoice

source "board/cadence/xtfpga/Kconfig"
source "board/emulation/qemu-xtensa/Kconfig"

endmenu
```

## board/8dtech/eco5pk/Kconfig
```kconfig
if TARGET_ECO5PK

config SYS_BOARD
	default "eco5pk"

config SYS_VENDOR
	default "8dtech"

config SYS_CONFIG_NAME
	default "eco5pk"

endif
```

## board/AndesTech/adp-ag101/Kconfig
```kconfig
if TARGET_ADP_AG101

config SYS_CPU
	default "n1213"

config SYS_BOARD
	default "adp-ag101"

config SYS_VENDOR
	default "AndesTech"

config SYS_SOC
	default "ag101"

config SYS_CONFIG_NAME
	default "adp-ag101"

endif
```

## board/AndesTech/adp-ag101p/Kconfig
```kconfig
if TARGET_ADP_AG101P

config DEBUG_LED
	hex
	default 0x902FFFFC

config SYS_CPU
	default "n1213"

config SYS_BOARD
	default "adp-ag101p"

config SYS_VENDOR
	default "AndesTech"

config SYS_SOC
	default "ag101"

config SYS_CONFIG_NAME
	default "adp-ag101p"

endif
```
