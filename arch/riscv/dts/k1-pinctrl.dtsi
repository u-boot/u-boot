// SPDX-License-Identifier: (GPL-2.0 OR MIT)
/*
 * Copyright (C) 2022 Spacemit Inc.
 * Copyright (C) 2025 Yixun Lan <dlan@gentoo.org>
 */

#define K1_PADCONF(pin, func) (((pin) << 16) | (func))

&pinctrl {
	uart0_2_cfg: uart0-2-cfg {
		uart0-2-pins {
			pinmux = <K1_PADCONF(68, 2)>,
				 <K1_PADCONF(69, 2)>;

			bias-pull-up = <0>;
			drive-strength = <32>;
		};
	};
};
