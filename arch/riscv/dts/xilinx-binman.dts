// SPDX-License-Identifier: GPL-2.0
/*
 * binman file for AMD MicroBlaze V
 *
 * (C) Copyright 2025, Advanced Micro Devices, Inc.
 *
 * Michal Simek <michal.simek@amd.com>
 */

/dts-v1/;

#include "binman.dtsi"
