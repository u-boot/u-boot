/include/ "skeleton.dtsi"

/ {
	chosen {
		stdout-path = "/serial";
	};

	serial {
		compatible = "coreboot-uart";
		reg = <0x3f8 0x10>;
		reg-shift = <0>;
		io-mapped = <1>;
		multiplier = <1>;
		baudrate = <115200>;
		status = "disabled";
	};
};
