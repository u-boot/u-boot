/*
 * Copyright (c) 2015 Google, Inc
 *
 * SPDX-License-Identifier:	GPL-2.0+
 */

/dts-v1/;

/include/ "skeleton.dtsi"
/include/ "tsc_timer.dtsi"

/ {
	model = "EFI";
	compatible = "efi,app";

	chosen {
		stdout-path = &serial;
	};

	tsc-timer {
		clock-frequency = <1000000000>;
	};

	serial: serial {
		compatible = "efi,uart";
	};
};
