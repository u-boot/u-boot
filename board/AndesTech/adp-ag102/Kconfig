## board/AndesTech/adp-ag102/Kconfig
```kconfig
if TARGET_ADP_AG102

config SYS_CPU
	default "n1213"

config SYS_BOARD
	default "adp-ag102"

config SYS_VENDOR
	default "AndesTech"

config SYS_SOC
	default "ag102"

config SYS_CONFIG_NAME
	default "adp-ag102"

endif
```

## board/AndesTech/ax25-ae350/Kconfig
```kconfig
if TARGET_AX25_AE350

config SYS_CPU
	default "ax25"

config SYS_BOARD
	default "ax25-ae350"

config SYS_VENDOR
	default "AndesTech"

config SYS_SOC
	default "ae350"

config SYS_CONFIG_NAME
	default "ax25-ae350"

config ENV_SIZE
	default 0x2000 if ENV_IS_IN_SPI_FLASH

config ENV_OFFSET
	default 0x140000 if ENV_IS_IN_SPI_FLASH

config SPL_TEXT_BASE
	default 0x800000

config SPL_OPENSBI_LOAD_ADDR
	default 0x01000000

config BOARD_SPECIFIC_OPTIONS # dummy
	def_bool y
	select RISCV_NDS
	select SUPPORT_SPL
	select BINMAN if SPL
	imply SMP
	imply SPL_RAM_SUPPORT
	imply SPL_RAM_DEVICE

endif
```

## board/AndesTech/nx25-ae250/Kconfig
```kconfig
if TARGET_NX25_AE250

config SYS_CPU
	default "nx25"

config SYS_BOARD
	default "nx25-ae250"

config SYS_VENDOR
	default "AndesTech"

config SYS_SOC
	default "ae250"

config SYS_CONFIG_NAME
	default "nx25-ae250"

config ENV_SIZE
	default 0x2000 if ENV_IS_IN_SPI_FLASH

config ENV_OFFSET
	default 0x140000 if ENV_IS_IN_SPI_FLASH

endif
```

## board/Arcturus/ucp1020/Kconfig
```kconfig
if TARGET_UCP1020

config SYS_BOARD
	string
	default "ucp1020"

config SYS_VENDOR
	string
	default "Arcturus"

config SYS_CONFIG_NAME
	string
	default "UCP1020"

config SPI_FLASH
	bool
	default y

config SPI_PCI
	bool
	default y

choice
	prompt "Target image select"

config TARGET_UCP1020_NOR
	bool "NOR flash u-boot image"

config TARGET_UCP1020_SPIFLASH
	bool "SPI flash u-boot image"

endchoice

if TARGET_UCP1020_SPIFLASH
config UCBOOT
	bool
	default y

config SPIFLASH
	bool
	default y
endif

endif
```

## board/Barix/ipam390/Kconfig
```kconfig
if TARGET_IPAM390

config SYS_BOARD
	default "ipam390"

config SYS_VENDOR
	default "Barix"

config SYS_CONFIG_NAME
	default "ipam390"

endif
```

## board/BuR/common/Kconfig
```kconfig
# SPDX-License-Identifier: GPL-2.0+
#
# B&R Industrial Automation GmbH - http://www.br-automation.com

config BR_RESETC_I2CBUS
	int "I2C Bus address of B&R reset controller"
	depends on SYS_VENDOR = "BuR" && DM_I2C
	default 0
```

## board/BuR/kwb/Kconfig
```kconfig
if TARGET_KWB

config SYS_BOARD
	default "kwb"

config SYS_VENDOR
	default "BuR"

config SYS_SOC
	default "am33xx"

config SYS_CONFIG_NAME
	default "kwb"

endif
```

## board/BuR/tseries/Kconfig
```kconfig
if TARGET_TSERIES

config SYS_BOARD
	default "tseries"

config SYS_VENDOR
	default "BuR"

config SYS_SOC
	default "am33xx"

config SYS_CONFIG_NAME
	default "tseries"

endif
```

## board/BuR/zynq/Kconfig
```kconfig
# SPDX-License-Identifier: GPL-2.0+
#
# B&R Industrial Automation GmbH - http://www.br-automation.com
if ARCH_ZYNQ

config TARGET_ZYNQ_BR
	bool "Support BR Zynq builds"
	depends on SYS_VENDOR = "BuR"
	select BINMAN
	select SPL_BINMAN_FDT

endif

source "board/BuR/common/Kconfig"
```

## board/BuS/eb_cpu5282/Kconfig
```kconfig
if TARGET_EB_CPU5282

config SYS_CPU
	string
	default "mcf52x2"

config SYS_BOARD
	string
	default "eb_cpu5282"

config SYS_VENDOR
	string
	default "BuS"

config SYS_CONFIG_NAME
	string
	default "eb_cpu5282"

endif
```

## board/BuS/eb_cpux9k2/Kconfig
```kconfig
if TARGET_EB_CPUX9K2

config SYS_BOARD
	default "eb_cpux9k2"

config SYS_VENDOR
	default "BuS"

config SYS_CONFIG_NAME
	default "eb_cpux9k2"

endif
```

## board/BuS/vl_ma2sc/Kconfig
```kconfig
if TARGET_VL_MA2SC

config SYS_BOARD
	default "vl_ma2sc"

config SYS_VENDOR
	default "BuS"

config SYS_CONFIG_NAME
	default "vl_ma2sc"

endif
```

## board/CZ.NIC/turris_1x/Kconfig
```kconfig
# SPDX-License-Identifier: GPL-2.0+
# (C) 2022 Pali Rohár <pali@kernel.org>

if TARGET_TURRIS_1X

# Board identification
config SYS_BOARD
	default "turris_1x"
config SYS_VENDOR
	default "CZ.NIC"
config SYS_CONFIG_NAME
	default "turris_1x"
config DEFAULT_DEVICE_TREE
	default "turris1x"

endif
```

## board/CarMediaLab/flea3/Kconfig
```kconfig
if TARGET_FLEA3

config SYS_CPU
	string
	default "arm1136"

config SYS_BOARD
	string
	default "flea3"

config SYS_VENDOR
	string
	default "CarMediaLab"

config SYS_SOC
	string
	default "mx35"

config SYS_CONFIG_NAME
	string
	default "flea3"

endif
```

## board/LEOX/elpt860/Kconfig
```kconfig
if TARGET_ELPT860

config SYS_BOARD
	default "elpt860"

config SYS_VENDOR
	default "LEOX"

config SYS_CONFIG_NAME
	default "ELPT860"

endif
```

## board/LaCie/edminiv2/Kconfig
```kconfig
if TARGET_EDMINIV2

config SYS_BOARD
	string
	default "edminiv2"

config SYS_VENDOR
	string
	default "LaCie"

config SYS_CONFIG_NAME
	string
	default "edminiv2"

endif
```

## board/LaCie/net2big_v2/Kconfig
```kconfig
if TARGET_NET2BIG_V2

config SYS_BOARD
	string
	default "net2big_v2"

config SYS_VENDOR
	string
	default "LaCie"

config SYS_CONFIG_NAME
	string
	default "lacie_kw"

endif
```

## board/LaCie/netspace_v2/Kconfig
```kconfig
if TARGET_NETSPACE_V2

config SYS_BOARD
	string
	default "netspace_v2"

config SYS_VENDOR
	string
	default "LaCie"

config SYS_CONFIG_NAME
	string
	default "lacie_kw"

endif
```

## board/LaCie/wireless_space/Kconfig
```kconfig
if TARGET_WIRELESS_SPACE

config SYS_BOARD
	default "wireless_space"

config SYS_VENDOR
	default "LaCie"

config SYS_CONFIG_NAME
	default "wireless_space"

endif
```

## board/Marvell/aspenite/Kconfig
```kconfig
if TARGET_ASPENITE

config SYS_CPU
	string
	default "arm926ejs"

config SYS_BOARD
	string
	default "aspenite"

config SYS_VENDOR
	string
	default "Marvell"

config SYS_SOC
	string
	default "armada100"

config SYS_CONFIG_NAME
	string
	default "aspenite"

endif
```

## board/Marvell/common/Kconfig
```kconfig
menu "MVEBU Development Board Utilities"
	depends on ARCH_MVEBU

config BOARD_CONFIG_EEPROM
	bool "Support configuration EEPROM"
	default n
	help
	  If this option is enabled, U-Boot will initialize
	  configuration EEPROM on board.
	  It will be enabled once the CMD_MVEBU_BOX_INFO or
	  MULTI_DT_FILE is enabled

config MVEBU_SAR
	bool "Support MVEBU SAR Utility"
	default n
	help
	  Say Y here to add support for Sample
	  at Reset Utility. You need this only if
	  you work on a Marvell development board.
	  If not, keep this off to reduce code size

endmenu
```

## board/Marvell/db-88f6820-gp/Kconfig
```kconfig
if TARGET_DB_88F6820_GP

config SYS_BOARD
	default "db-88f6820-gp"

config SYS_VENDOR
	default "Marvell"

config SYS_CONFIG_NAME
	default "db-88f6820-gp"

endif
```

## board/Marvell/db-mv784mp-gp/Kconfig
```kconfig
if TARGET_DB_MV784MP_GP

config SYS_BOARD
	default "db-mv784mp-gp"

config SYS_VENDOR
	default "Marvell"

config SYS_SOC
	default "mvebu"

config SYS_CONFIG_NAME
	default "db-mv784mp-gp"

endif
```

## board/Marvell/db64360/Kconfig
```kconfig
if TARGET_DB64360

config SYS_BOARD
	default "db64360"

config SYS_VENDOR
	default "Marvell"

config SYS_CONFIG_NAME
	default "DB64360"

endif
```

## board/Marvell/db64460/Kconfig
```kconfig
if TARGET_DB64460

config SYS_BOARD
	default "db64460"

config SYS_VENDOR
	default "Marvell"

config SYS_CONFIG_NAME
	default "DB64460"

endif
```
