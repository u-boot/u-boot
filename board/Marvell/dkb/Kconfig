## board/Marvell/dkb/Kconfig
```kconfig
if TARGET_DKB

config SYS_BOARD
	default "dkb"

config SYS_VENDOR
	default "Marvell"

config SYS_SOC
	default "pantheon"

config SYS_CONFIG_NAME
	default "dkb"

endif
```

## board/Marvell/dreamplug/Kconfig
```kconfig
if TARGET_DREAMPLUG

config SYS_BOARD
	string
	default "dreamplug"

config SYS_VENDOR
	string
	default "Marvell"

config SYS_CONFIG_NAME
	string
	default "dreamplug"

endif
```

## board/Marvell/gplugd/Kconfig
```kconfig
if TARGET_GPLUGD

config SYS_CPU
	string
	default "arm926ejs"

config SYS_BOARD
	string
	default "gplugd"

config SYS_VENDOR
	string
	default "Marvell"

config SYS_SOC
	string
	default "armada100"

config SYS_CONFIG_NAME
	string
	default "gplugd"

endif
```

## board/Marvell/guruplug/Kconfig
```kconfig
if TARGET_GURUPLUG

config SYS_BOARD
	string
	default "guruplug"

config SYS_VENDOR
	string
	default "Marvell"

config SYS_CONFIG_NAME
	string
	default "guruplug"

endif
```

## board/Marvell/mv88f6281gtw_ge/Kconfig
```kconfig
if TARGET_MV88F6281GTW_GE

config SYS_BOARD
	default "mv88f6281gtw_ge"

config SYS_VENDOR
	default "Marvell"

config SYS_CONFIG_NAME
	default "mv88f6281gtw_ge"

endif
```

## board/Marvell/octeon_ebb7304/Kconfig
```kconfig
if TARGET_OCTEON_EBB7304

config SYS_BOARD
	default "octeon_ebb7304"

config SYS_VENDOR
	default "Marvell"

config SYS_CONFIG_NAME
	default "octeon_ebb7304"

config DEFAULT_DEVICE_TREE
	string
	default "mrvl,octeon-ebb7304"

endif
```

## board/Marvell/octeon_nic23/Kconfig
```kconfig
if TARGET_OCTEON_NIC23

config SYS_BOARD
	default "octeon_nic23"

config SYS_VENDOR
	default "Marvell"

config SYS_CONFIG_NAME
	default "octeon_nic23"

config DEFAULT_DEVICE_TREE
	string
	default "mrvl,octeon-nic23"

endif
```

## board/Marvell/octeontx/Kconfig
```kconfig
if TARGET_OCTEONTX_81XX || TARGET_OCTEONTX_83XX

config SYS_VENDOR
	default	"Marvell"

config SYS_BOARD
	default "octeontx"

config SYS_CONFIG_NAME
	default "octeontx_common"

endif
```

## board/Marvell/octeontx2/Kconfig
```kconfig
if TARGET_OCTEONTX2_95XX || TARGET_OCTEONTX2_96XX

config SYS_VENDOR
	default	"Marvell"

config SYS_BOARD
	default "octeontx2"

config SYS_CONFIG_NAME
	default "octeontx2_common"

endif
```

## board/Marvell/openrd/Kconfig
```kconfig
if TARGET_OPENRD

config SYS_BOARD
	string
	default "openrd"

config SYS_VENDOR
	string
	default "Marvell"

config SYS_CONFIG_NAME
	string
	default "openrd"

endif
```

## board/Marvell/rd6281a/Kconfig
```kconfig
if TARGET_RD6281A

config SYS_BOARD
	default "rd6281a"

config SYS_VENDOR
	default "Marvell"

config SYS_CONFIG_NAME
	default "rd6281a"

endif
```

## board/Marvell/sheevaplug/Kconfig
```kconfig
if TARGET_SHEEVAPLUG

config SYS_BOARD
	string
	default "sheevaplug"

config SYS_VENDOR
	string
	default "Marvell"

config SYS_CONFIG_NAME
	string
	default "sheevaplug"

endif
```

## board/RRvision/Kconfig
```kconfig
if TARGET_RRVISION

config SYS_BOARD
	default "RRvision"

config SYS_CONFIG_NAME
	default "RRvision"

endif
```

## board/Seagate/dockstar/Kconfig
```kconfig
if TARGET_DOCKSTAR

config SYS_BOARD
	string
	default "dockstar"

config SYS_VENDOR
	string
	default "Seagate"

config SYS_CONFIG_NAME
	string
	default "dockstar"

endif
```

## board/Seagate/goflexhome/Kconfig
```kconfig
if TARGET_GOFLEXHOME

config SYS_BOARD
	string
	default "goflexhome"

config SYS_VENDOR
	string
	default "Seagate"

config SYS_CONFIG_NAME
	string
	default "goflexhome"

endif
```

## board/a3000/Kconfig
```kconfig
if TARGET_A3000

config SYS_BOARD
	default "a3000"

config SYS_CONFIG_NAME
	default "A3000"

endif
```

## board/a3m071/Kconfig
```kconfig
if TARGET_A3M071

config SYS_BOARD
	default "a3m071"

config SYS_CONFIG_NAME
	default "a3m071"

endif
```

## board/a4m072/Kconfig
```kconfig
if TARGET_A4M072

config SYS_BOARD
	default "a4m072"

config SYS_CONFIG_NAME
	default "a4m072"

endif
```

## board/abilis/tb100/Kconfig
```kconfig
if TARGET_TB100

config SYS_CPU
	string
	default "arc700"

config SYS_BOARD
	string
	default "tb100"

config SYS_VENDOR
	string
	default "abilis"

config SYS_CONFIG_NAME
	string
	default "tb100"

endif
```

## board/acer/picasso/Kconfig
```kconfig
if TARGET_PICASSO

config SYS_BOARD
	default "picasso"

config SYS_VENDOR
	default "acer"

config TEGRA_BOARD_STRING
	string "Default Tegra board name"
	default "Acer Iconia Tab A500"

endif
```

## board/adi/sc573-ezkit/Kconfig
```kconfig
# SPDX-License-Identifier: GPL-2.0-or-later
#
# (C) Copyright 2024 - Analog Devices, Inc.

if TARGET_SC573_EZKIT

config SYS_BOARD
	default "sc573-ezkit"

config SYS_CONFIG_NAME
	default "sc573-ezkit"

config LDR_CPU
	default "ADSP-SC573-0.0"

config DEFAULT_DEVICE_TREE
	default "sc573-ezkit"

config ADI_IMAGE
	default "tiny"

config CUSTOM_SYS_INIT_SP_ADDR
	default 0x8203f000

# SPI Flash

config SF_DEFAULT_BUS
	default 2

config SF_DEFAULT_CS
	default 1

config SF_DEFAULT_SPEED
	default 10000000

# Clocks

config CGU0_DF_DIV
	default 0

config CGU0_VCO_MULT
	default 18

config CGU0_CCLK_DIV
	default 1

config CGU0_SCLK_DIV
	default 2

config CGU0_SCLK0_DIV
	default 2

config CGU0_SCLK1_DIV
	default 2

config CGU0_DCLK_DIV
	default 2

config CGU0_OCLK_DIV
	default 3

config CGU1_VCO_MULT
	default 5

config CGU1_DF_DIV
	default 0

config CGU1_CCLK_DIV
	default 1

config CGU1_SCLK_DIV
	default 2

config CGU1_SCLK0_DIV
	default 2

config CGU1_SCLK1_DIV
	default 2

config CGU1_DCLK_DIV
	default 2

config CGU1_OCLK_DIV
	default 3

config CDU0_CLKO0
	default 1

config CDU0_CLKO1
	default 1

config CDU0_CLKO2
	default 1

config CDU0_CLKO3
	default 1

config CDU0_CLKO4
	default 1

config CDU0_CLKO5
	default 1

config CDU0_CLKO6
	default 1

config CDU0_CLKO7
	default 5

config CDU0_CLKO8
	default 1

config CDU0_CLKO9
	default 1

endif
```

## board/adi/sc589-mini/Kconfig
```kconfig
# SPDX-License-Identifier: GPL-2.0-or-later
#
# (C) Copyright 2024 - Analog Devices, Inc.

if TARGET_SC589_MINI

config LDR_CPU
	default	"ADSP-SC589-0.1"

config SYS_BOARD
	default "sc589-mini"

config SYS_CONFIG_NAME
	default "sc589"

config DEFAULT_DEVICE_TREE
	default "sc589-mini"

config ADI_IMAGE
	default "minimal"

config CUSTOM_SYS_INIT_SP_ADDR
	default 0xC203f000

# SPI Flash

config SF_DEFAULT_BUS
	default 2

config SF_DEFAULT_CS
	default 1

config SF_DEFAULT_SPEED
	default 5000000

# Clocks

config CGU0_DF_DIV
	default 0

config CGU0_VCO_MULT
	default 18

config CGU0_CCLK_DIV
	default 1

config CGU0_SCLK_DIV
	default 2

config CGU0_SCLK0_DIV
	default 2

config CGU0_SCLK1_DIV
	default 2

config CGU0_DCLK_DIV
	default 1

config CGU0_OCLK_DIV
	default 3

config CGU1_VCO_MULT
	default 5

config CGU1_DF_DIV
	default 0

config CGU1_CCLK_DIV
	default 1

config CGU1_SCLK_DIV
	default 2

config CGU1_SCLK0_DIV
	default 2

config CGU1_SCLK1_DIV
	default 2

config CGU1_DCLK_DIV
	default 2

config CGU1_OCLK_DIV
	default 3

config CDU0_CLKO0
	default 1

config CDU0_CLKO1
	default 1

config CDU0_CLKO2
	default 1

config CDU0_CLKO3
	default 1

config CDU0_CLKO4
	default 1

config CDU0_CLKO5
	default 1

config CDU0_CLKO6
	default 1

config CDU0_CLKO7
	default 5

config CDU0_CLKO8
	default 1

config CDU0_CLKO9
	default 1

endif
```

## board/adi/sc594-som-ezkit/Kconfig
```kconfig
# SPDX-License-Identifier: GPL-2.0-or-later
#
# (C) Copyright 2024 - Analog Devices, Inc.

if TARGET_SC594_SOM_EZKIT

config LDR_CPU
	default "ADSP-SC594-0.0"

config SYS_BOARD
	default "sc594-som-ezkit"

config SYS_CONFIG_NAME
	default "sc594-som"

config DEFAULT_DEVICE_TREE
	default "sc594-som-ezkit"

config ADI_IMAGE
	default "minimal"

config CUSTOM_SYS_INIT_SP_ADDR
	default 0xA003f000

# SPL

config SPL_OF_LIBFDT_ASSUME_MASK
	default 0x0

# SPI Flash

config SF_DEFAULT_BUS
	default 2

config SF_DEFAULT_CS
	default 1

config SF_DEFAULT_SPEED
	default 10000000

# Clocks

config CGU0_DF_DIV
	default 0

config CGU0_VCO_MULT
	default 80

config CGU0_CCLK_DIV
	default 2

config CGU0_SCLK_DIV
	default 4

config CGU0_SCLK0_DIV
	default 4

config CGU0_SCLK1_DIV
	default 2

config CGU0_DCLK_DIV
	default 2

config CGU0_OCLK_DIV
	default 16

config CGU0_DIV_S1SELEX
	default 6

config CGU1_VCO_MULT
	default 64

config CGU1_DF_DIV
	default 0

config CGU1_CCLK_DIV
	default 2

config CGU1_SCLK_DIV
	default 4

config CGU1_SCLK0_DIV
	default 4

config CGU1_SCLK1_DIV
	default 2

config CGU1_DCLK_DIV
	default 2

config CGU1_OCLK_DIV
	default 16

config CGU1_DIV_S1SELEX
	default 6

config CDU0_CLKO0
	default 1

config CDU0_CLKO1
	default 1

config CDU0_CLKO2
	default 1

config CDU0_CLKO3
	default 3

config CDU0_CLKO4
	default 3

config CDU0_CLKO5
	default 1

config CDU0_CLKO6
	default 1

config CDU0_CLKO7
	default 1

config CDU0_CLKO8
	default 3

config CDU0_CLKO9
	default 1

config CDU0_CLKO10
	default 1

config CDU0_CLKO12
	default 1

endif
```

## board/adi/sc598-som-ezkit/Kconfig
```kconfig
# SPDX-License-Identifier: GPL-2.0-or-later
#
# (C) Copyright 2024 - Analog Devices, Inc.

if TARGET_SC598_SOM_EZKIT

config LDR_CPU
	default "ADSP-SC598-0.0"

config SYS_BOARD
	default "sc598-som-ezkit"

config SYS_CONFIG_NAME
	default "sc598-som"

config DEFAULT_DEVICE_TREE
	default "sc598-som-ezkit"

config ADI_IMAGE
	default "minimal"

config CUSTOM_SYS_INIT_SP_ADDR
	default 0x96000000

# SPL

config SPL_OF_LIBFDT_ASSUME_MASK
	default 0x0

# SPI Flash

config SF_DEFAULT_BUS
	default 2

config SF_DEFAULT_CS
	default 1

config SF_DEFAULT_SPEED
	default 10000000

# Clock Configs

config CGU0_DF_DIV
	default 0

config CGU0_VCO_MULT
	default 80

config CGU0_CCLK_DIV
	default 2

config CGU0_SCLK_DIV
	default 4

config CGU0_SCLK0_DIV
	default 4

config CGU0_SCLK1_DIV
	default 2

config CGU0_DCLK_DIV
	default 3

config CGU0_OCLK_DIV
	default 8

config CGU0_DIV_S1SELEX
	default 6

config CGU1_VCO_MULT
	default 72

config CGU1_DF_DIV
	default 0

config CGU1_CCLK_DIV
	default 16

config CGU1_SCLK_DIV
	default 8

config CGU1_SCLK0_DIV
	default 4

config CGU1_SCLK1_DIV
	default 2

config CGU1_DCLK_DIV
	default 18

config CGU1_OCLK_DIV
	default 16

config CGU1_DIV_S0SELEX
	default 36

config CGU1_DIV_S1SELEX
	default 90

endif
```

## board/afeb9260/Kconfig
```kconfig
if TARGET_AFEB9260

config SYS_BOARD
	default "afeb9260"

config SYS_CONFIG_NAME
	default "afeb9260"

endif
```
