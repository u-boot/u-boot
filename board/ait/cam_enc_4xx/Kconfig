## board/ait/cam_enc_4xx/Kconfig
```kconfig
if TARGET_CAM_ENC_4XX

config SYS_BOARD
	default "cam_enc_4xx"

config SYS_VENDOR
	default "ait"

config SYS_CONFIG_NAME
	default "cam_enc_4xx"

endif
```

## board/alphaproject/ap_sh4a_4a/Kconfig
```kconfig
if TARGET_AP_SH4A_4A

config SYS_CPU
	default "sh4"

config SYS_BOARD
	default "ap_sh4a_4a"

config SYS_VENDOR
	default "alphaproject"

config SYS_CONFIG_NAME
	default "ap_sh4a_4a"

endif
```

## board/altera/arria10-socdk/fit_kernel_qspi.its
```
// SPDX-License-Identifier: GPL-2.0
/*
 * Copyright (C) 2019 Intel Corporation
 *
 */

/dts-v1/;

/ {
	description = "FIT image with kernel and DTB";
	#address-cells = <1>;

	images {
		kernel {
			description = "Linux Kernel";
			data = /incbin/("../../../Image");
			type = "kernel";
			os = "linux";
			arch = "arm";
			compression = "none";
			load = <0x8000>;
			entry = <0x8000>;
		};

		fdt {
			description = "Linux DTB";
			data = /incbin/("../../../socfpga_arria10_socdk_qspi.dtb");
			type = "flat_dt";
			os = "linux";
			arch = "arm";
			compression = "none";

		};
	};

	configurations {
		default = "conf";
		conf {
			description = "Linux boot configuration";
			kernel = "kernel";
			fdt = "fdt";
		};
	};
};
```

## board/altera/arria10-socdk/fit_uboot.its
```
// SPDX-License-Identifier: GPL-2.0
 /*
 * Copyright (C) 2019 Intel Corporation <www.intel.com>
 *
 */

/dts-v1/;

/ {
	description = "FIT image with boot binaries";
	#address-cells = <1>;

	images {
		uboot {
			description = "U-Boot (32-bit)";
			data = /incbin/("../../../u-boot-nodtb.bin");
			type = "standalone";
			os = "U-Boot";
			arch = "arm";
			compression = "none";
			load = <0x01000040>;
			entry = <0x01000040>;
		};

		fdt {
			description = "U-Boot DTB";
			data = /incbin/("../../../u-boot.dtb");
			type = "flat_dt";
			os = "U-Boot";
			arch = "arm";
			compression = "none";
		};
	};

	configurations {
		default = "conf";
		conf {
			description = "Intel Arria10 SoCDK";
			loadables = "uboot";
			fdt = "fdt";
		};
	};
};
```

## board/altera/nios2-generic/Kconfig
```kconfig
if TARGET_NIOS2_GENERIC

config SYS_BOARD
	default "nios2-generic"

config SYS_VENDOR
	default "altera"

config SYS_CONFIG_NAME
	default "nios2-generic"

endif
```

## board/altera/socfpga/Kconfig
```kconfig
if TARGET_SOCFPGA_CYCLONE5

config SYS_CPU
	default "armv7"

config SYS_BOARD
	default "socfpga"

config SYS_VENDOR
	default "altera"

config SYS_SOC
	default "socfpga"

config SYS_CONFIG_NAME
	default "socfpga_cyclone5"

endif
```

## board/amcc/acadia/Kconfig
```kconfig
if TARGET_ACADIA

config SYS_BOARD
	default "acadia"

config SYS_VENDOR
	default "amcc"

config SYS_CONFIG_NAME
	default "acadia"

config DISPLAY_BOARDINFO
	bool
	default y

endif
```

## board/amcc/bamboo/Kconfig
```kconfig
if TARGET_BAMBOO

config SYS_BOARD
	default "bamboo"

config SYS_VENDOR
	default "amcc"

config SYS_CONFIG_NAME
	default "bamboo"

endif
```

## board/amcc/bluestone/Kconfig
```kconfig
if TARGET_BLUESTONE

config SYS_BOARD
	default "bluestone"

config SYS_VENDOR
	default "amcc"

config SYS_CONFIG_NAME
	default "bluestone"

endif
```

## board/amcc/bubinga/Kconfig
```kconfig
if TARGET_BUBINGA

config SYS_BOARD
	default "bubinga"

config SYS_VENDOR
	default "amcc"

config SYS_CONFIG_NAME
	default "bubinga"

config DISPLAY_BOARDINFO
	bool
	default y

endif
```

## board/amcc/canyonlands/Kconfig
```kconfig
if TARGET_CANYONLANDS

config SYS_BOARD
	default "canyonlands"

config SYS_VENDOR
	default "amcc"

config SYS_CONFIG_NAME
	default "canyonlands"

choice BOARD_TYPE
	prompt "Select which board to build for"
	optional

config CANYONLANDS
	bool "Glacier"
	help
	  Select this to build for the Canyonlands 460EX board.

config GLACIER
	bool "Glacier"
	help
	  Select this to build for the Glacier 460GT board.

config ARCHES
	bool "Arches"
	help
	  Select this to build for the Arches dual 460GT board.

endchoice

config DISPLAY_BOARDINFO
	bool
	default y

endif
```

## board/amcc/ebony/Kconfig
```kconfig
if TARGET_EBONY

config SYS_BOARD
	default "ebony"

config SYS_VENDOR
	default "amcc"

config SYS_CONFIG_NAME
	default "ebony"

config DISPLAY_BOARDINFO
	bool
	default y

endif
```

## board/amcc/katmai/Kconfig
```kconfig
if TARGET_KATMAI

config SYS_BOARD
	default "katmai"

config SYS_VENDOR
	default "amcc"

config SYS_CONFIG_NAME
	default "katmai"

endif
```

## board/amcc/kilauea/Kconfig
```kconfig
if TARGET_KILAUEA

config SYS_BOARD
	default "kilauea"

config SYS_VENDOR
	default "amcc"

config SYS_CONFIG_NAME
	default "kilauea"

endif
```

## board/amcc/luan/Kconfig
```kconfig
if TARGET_LUAN

config SYS_BOARD
	default "luan"

config SYS_VENDOR
	default "amcc"

config SYS_CONFIG_NAME
	default "luan"

config DISPLAY_BOARDINFO
	bool
	default y

endif
```

## board/amcc/makalu/Kconfig
```kconfig
if TARGET_MAKALU

config SYS_BOARD
	default "makalu"

config SYS_VENDOR
	default "amcc"

config SYS_CONFIG_NAME
	default "makalu"

config DISPLAY_BOARDINFO
	bool
	default y

endif
```

## board/amcc/ocotea/Kconfig
```kconfig
if TARGET_OCOTEA

config SYS_BOARD
	default "ocotea"

config SYS_VENDOR
	default "amcc"

config SYS_CONFIG_NAME
	default "ocotea"

config DISPLAY_BOARDINFO
	bool
	default y

endif
```

## board/amcc/redwood/Kconfig
```kconfig
if TARGET_REDWOOD

config SYS_BOARD
	default "redwood"

config SYS_VENDOR
	default "amcc"

config SYS_CONFIG_NAME
	default "redwood"

endif
```

## board/amcc/sequoia/Kconfig
```kconfig
if TARGET_SEQUOIA

config SYS_BOARD
	default "sequoia"

config SYS_VENDOR
	default "amcc"

config SYS_CONFIG_NAME
	default "sequoia"

config DISPLAY_BOARDINFO
	bool
	default y

endif
```

## board/amcc/taihu/Kconfig
```kconfig
if TARGET_TAIHU

config SYS_BOARD
	default "taihu"

config SYS_VENDOR
	default "amcc"

config SYS_CONFIG_NAME
	default "taihu"

config DISPLAY_BOARDINFO
	bool
	default y

endif
```

## board/amcc/taishan/Kconfig
```kconfig
if TARGET_TAISHAN

config SYS_BOARD
	default "taishan"

config SYS_VENDOR
	default "amcc"

config SYS_CONFIG_NAME
	default "taishan"

config DISPLAY_BOARDINFO
	bool
	default y

endif
```

## board/amcc/walnut/Kconfig
```kconfig
if TARGET_WALNUT

config SYS_BOARD
	default "walnut"

config SYS_VENDOR
	default "amcc"

config SYS_CONFIG_NAME
	default "walnut"

endif
```

## board/amcc/yosemite/Kconfig
```kconfig
if TARGET_YOSEMITE

config SYS_BOARD
	default "yosemite"

config SYS_VENDOR
	default "amcc"

config SYS_CONFIG_NAME
	default "yosemite"

config DISPLAY_BOARDINFO
	bool
	default y

endif
```

## board/amcc/yucca/Kconfig
```kconfig
if TARGET_YUCCA

config SYS_BOARD
	default "yucca"

config SYS_VENDOR
	default "amcc"

config SYS_CONFIG_NAME
	default "yucca"

config DISPLAY_BOARDINFO
	bool
	default y

endif
```

## board/amd/versal2/Kconfig
```kconfig
# SPDX-License-Identifier: GPL-2.0
#
# Copyright (C) 2020 - 2022, Xilinx, Inc.
# Copyright (C) 2022 - 2024, Advanced Micro Devices, Inc.
#
if ARCH_VERSAL2

config CMD_VERSAL2
	bool "Enable Versal Gen 2 specific commands"
	default y
	depends on ZYNQMP_FIRMWARE
	help
	  Select this to enable AMD Versal Gen 2 specific commands.
	  Commands like versal2 loadpdi are enabled by this.

endif
```
