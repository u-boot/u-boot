## board/amlogic/khadas-vim/Kconfig
```kconfig
if TARGET_KHADAS_VIM

config SYS_BOARD
	default "khadas-vim"

config SYS_VENDOR
	default "amlogic"

config SYS_CONFIG_NAME
	default "khadas-vim"

endif
```

## board/amlogic/khadas-vim2/Kconfig
```kconfig
if TARGET_KHADAS_VIM2

config SYS_BOARD
	default "khadas-vim2"

config SYS_VENDOR
	default "amlogic"

config SYS_CONFIG_NAME
	default "khadas-vim2"

endif
```

## board/amlogic/libretech-cc/Kconfig
```kconfig
if TARGET_LIBRETECH_CC

config SYS_BOARD
	default "libretech-cc"

config SYS_VENDOR
	default "amlogic"

config SYS_CONFIG_NAME
	default "libretech-cc"

endif
```

## board/amlogic/nanopi-k2/Kconfig
```kconfig
if TARGET_NANOPI_K2

config SYS_BOARD
	default "nanopi-k2"

config SYS_VENDOR
	default "amlogic"

config SYS_CONFIG_NAME
	default "nanopi-k2"

endif
```

## board/amlogic/odroid-c2/Kconfig
```kconfig
if TARGET_ODROID_C2

config SYS_BOARD
	default "odroid-c2"

config SYS_VENDOR
	default "amlogic"

config SYS_CONFIG_NAME
	default "odroid-c2"

endif
```

## board/amlogic/p212/Kconfig
```kconfig
if TARGET_P212

config SYS_BOARD
	default "p212"

config SYS_VENDOR
	default "amlogic"

config SYS_CONFIG_NAME
	default "p212"

endif
```

## board/amlogic/q200/Kconfig
```kconfig
if TARGET_Q200

config SYS_BOARD
	default "q200"

config SYS_VENDOR
	default "amlogic"

config SYS_CONFIG_NAME
	default "q200"

endif
```

## board/anbernic/rgxx3_rk3566/Kconfig
```kconfig
if TARGET_ANBERNIC_RGXX3_RK3566

config SYS_BOARD
	default "rgxx3_rk3566"

config SYS_VENDOR
	default "anbernic"

config SYS_CONFIG_NAME
	default "anbernic-rgxx3-rk3566"

endif
```

## board/andestech/voyager/Kconfig
```kconfig
if TARGET_ANDES_VOYAGER

config SYS_CPU
	default "andes"

config SYS_BOARD
	default "voyager"

config SYS_VENDOR
	default "andestech"

config SYS_SOC
	default "qilai"

config SYS_CONFIG_NAME
	default "voyager"

config ENV_SIZE
	default 0x2000 if ENV_IS_IN_SPI_FLASH

config ENV_OFFSET
	default 0x1F0000 if ENV_IS_IN_SPI_FLASH

config SPL_TEXT_BASE
	default 0x400800000

config SPL_OPENSBI_LOAD_ADDR
	default 0x400000000

config SYS_FDT_BASE
	hex
	default 0x81E0000 if OF_SEPARATE

config BOARD_SPECIFIC_OPTIONS # dummy
	def_bool y
	select RISCV_ANDES
	select SUPPORT_SPL
	select BINMAN if SPL
	imply SMP
	imply SPL_RAM_SUPPORT
	imply SPL_RAM_DEVICE
	imply OF_HAS_PRIOR_STAGE

endif
```

## board/aries/m28evk/Kconfig
```kconfig
if TARGET_M28EVK

config SYS_BOARD
	default "m28evk"

config SYS_VENDOR
	default "aries"

config SYS_SOC
	default "mxs"

config SYS_CONFIG_NAME
	default "m28evk"

endif
```

## board/aristainetos/Kconfig
```kconfig
if TARGET_ARISTAINETOS2

source "board/aristainetos/common/Kconfig"

config SYS_BOARD
	default "aristainetos"

config SYS_BOARD_VERSION
	default 2

endif

if TARGET_ARISTAINETOS2B

source "board/aristainetos/common/Kconfig"

config SYS_BOARD
	default "aristainetos"

config SYS_BOARD_VERSION
	default 3

endif

if TARGET_ARISTAINETOS2BCSL

source "board/aristainetos/common/Kconfig"

config SYS_BOARD
	default "aristainetos"

config SYS_BOARD_VERSION
	default 4

endif

if TARGET_ARISTAINETOS2C

source "board/aristainetos/common/Kconfig"

config SYS_BOARD
	default "aristainetos"

config SYS_BOARD_VERSION
	default 5

endif
```

## board/aristainetos/common/Kconfig
```kconfig
config SYS_BOARD_VERSION
	int "select version of aristainetos board"
	help
	  version of aristainetos board version
	  2 version 2
	  3 version 2b
	  4 version 2bcsl
	  5 version 2c

config SYS_I2C_MXC_I2C1
	default y

config SYS_I2C_MXC_I2C2
	default y

config SYS_I2C_MXC_I2C3
	default y

config SYS_I2C_MXC_I2C4
	default y

config SYS_MALLOC_LEN
	default 0x4000000

config ENV_SIZE
	default 0x3000

config ENV_SECT_SIZE
	default 0x10000

config ENV_OFFSET
	default 0xd0000

config SYS_CONFIG_NAME
	default "aristainetos2"
```

## board/armadeus/apf27/Kconfig
```kconfig
if TARGET_APF27

config SYS_BOARD
	default "apf27"

config SYS_VENDOR
	default "armadeus"

config SYS_SOC
	default "mx27"

config SYS_CONFIG_NAME
	default "apf27"

endif
```

## board/armltd/integrator/Kconfig
```kconfig
if TARGET_INTEGRATORAP_CM720T

config SYS_BOARD
	default "integrator"

config SYS_VENDOR
	default "armltd"

config SYS_CONFIG_NAME
	default "integratorap"

endif

if TARGET_INTEGRATORAP_CM920T

config SYS_BOARD
	default "integrator"

config SYS_VENDOR
	default "armltd"

config SYS_CONFIG_NAME
	default "integratorap"

endif

if TARGET_INTEGRATORCP_CM920T

config SYS_BOARD
	default "integrator"

config SYS_VENDOR
	default "armltd"

config SYS_CONFIG_NAME
	default "integratorcp"

endif

if TARGET_INTEGRATORAP_CM926EJS

config SYS_BOARD
	default "integrator"

config SYS_VENDOR
	default "armltd"

config SYS_CONFIG_NAME
	default "integratorap"

endif

if TARGET_INTEGRATORCP_CM926EJS

config SYS_BOARD
	default "integrator"

config SYS_VENDOR
	default "armltd"

config SYS_CONFIG_NAME
	default "integratorcp"

endif

if TARGET_INTEGRATORCP_CM1136

config SYS_BOARD
	default "integrator"

config SYS_VENDOR
	default "armltd"

config SYS_CONFIG_NAME
	default "integratorcp"

endif

if TARGET_INTEGRATORAP_CM946ES

config SYS_BOARD
	default "integrator"

config SYS_VENDOR
	default "armltd"

config SYS_CONFIG_NAME
	default "integratorap"

endif

if TARGET_INTEGRATORCP_CM946ES

config SYS_BOARD
	default "integrator"

config SYS_VENDOR
	default "armltd"

config SYS_CONFIG_NAME
	default "integratorcp"

endif
```

## board/armltd/versatile/Kconfig
```kconfig
if TARGET_VERSATILEAB

config SYS_CPU
	string
	default "arm926ejs"

config SYS_BOARD
	string
	default "versatile"

config SYS_VENDOR
	string
	default "armltd"

config SYS_SOC
	string
	default "versatile"

config SYS_CONFIG_NAME
	string
	default "versatile"

endif

if TARGET_VERSATILEPB

config SYS_CPU
	string
	default "arm926ejs"

config SYS_BOARD
	string
	default "versatile"

config SYS_VENDOR
	string
	default "armltd"

config SYS_SOC
	string
	default "versatile"

config SYS_CONFIG_NAME
	string
	default "versatile"

endif

if TARGET_VERSATILEQEMU

config SYS_CPU
	string
	default "arm926ejs"

config SYS_BOARD
	string
	default "versatile"

config SYS_VENDOR
	string
	default "armltd"

config SYS_SOC
	string
	default "versatile"

config SYS_CONFIG_NAME
	string
	default "versatile"

endif
```

## board/armltd/vexpress/Kconfig
```kconfig
if TARGET_VEXPRESS_CA15_TC2

config SYS_CPU
	string
	default "armv7"

config SYS_BOARD
	string
	default "vexpress"

config SYS_VENDOR
	string
	default "armltd"

config SYS_CONFIG_NAME
	string
	default "vexpress_ca15_tc2"

endif

if TARGET_VEXPRESS_CA5X2

config SYS_CPU
	string
	default "armv7"

config SYS_BOARD
	string
	default "vexpress"

config SYS_VENDOR
	string
	default "armltd"

config SYS_CONFIG_NAME
	string
	default "vexpress_ca5x2"

endif

if TARGET_VEXPRESS_CA9X4

config SYS_CPU
	string
	default "armv7"

config SYS_BOARD
	string
	default "vexpress"

config SYS_VENDOR
	string
	default "armltd"

config SYS_CONFIG_NAME
	string
	default "vexpress_ca9x4"

endif
```

## board/armltd/vexpress64/Kconfig
```kconfig
if ARCH_VEXPRESS64

config SYS_BOARD
	default "vexpress64"

config SYS_VENDOR
	default "armltd"

config SYS_CONFIG_NAME
	default "vexpress_aemv8"

choice
	prompt "VExpress64 board variant"

config TARGET_VEXPRESS64_BASE_FVP
	bool "Support Versatile Express ARMv8a FVP BASE model"
	select SEMIHOSTING
	select LINUX_KERNEL_IMAGE_HEADER
	select POSITION_INDEPENDENT
	select OF_BOARD

config TARGET_VEXPRESS64_JUNO
	bool "Support Versatile Express Juno Development Platform"
	select DM_ETH
	select USB
	select BLK
	imply OF_HAS_PRIOR_STAGE

endchoice

config JUNO_DTB_PART
	string "NOR flash partition holding DTB"
	default "board.dtb"
	help
	  The ARM partition name in the NOR flash memory holding the
	  device tree blob to configure U-Boot.

config LNX_KRNL_IMG_TEXT_OFFSET_BASE
	default SYS_TEXT_BASE

endif
```

## board/armsom/sige7-rk3588/Kconfig
```kconfig
if TARGET_SIGE7_RK3588

config SYS_BOARD
	default "sige7-rk3588"

config SYS_VENDOR
	default "armsom"

config SYS_CONFIG_NAME
	default "sige7-rk3588"

endif
```

## board/aspeed/evb_ast2700/Kconfig
```kconfig
if TARGET_EVB_AST2700

config SYS_BOARD
	default "evb_ast2700"

config SYS_VENDOR
	default "aspeed"

config SYS_CONFIG_NAME
	string "board configuration name"
	default "evb_ast2700"

endif
```

## board/aspeed/ibex_ast2700/Kconfig
```kconfig
if TARGET_ASPEED_AST2700_IBEX

config SYS_BOARD
	default "ibex_ast2700"

config SYS_VENDOR
	default "aspeed"

config SYS_CPU
	default "ast2700"

config SYS_CONFIG_NAME
	default "ibex_ast2700"

config BOARD_SPECIFIC_OPTIONS
	def_bool y
	select RISCV_AST2700
	select SUPPORT_SPL
	imply SPL_DRIVERS_MISC

endif
```

## board/astro/mcf5373l/Kconfig
```kconfig
if TARGET_ASTRO_MCF5373L

config SYS_CPU
	string
	default "mcf532x"

config SYS_BOARD
	string
	default "mcf5373l"

config SYS_VENDOR
	string
	default "astro"

config SYS_CONFIG_NAME
	string
	default "astro_mcf5373l"

endif
```

## board/asus/grouper/Kconfig
```kconfig
if TARGET_GROUPER

config SYS_BOARD
	default "grouper"

config SYS_VENDOR
	default "asus"

config TEGRA_BOARD_STRING
	string "Default Tegra board name"
	default "ASUS Google Nexus 7 (2012)"

endif
```

## board/asus/transformer-t114/Kconfig
```kconfig
if TARGET_TRANSFORMER_T114

config SYS_BOARD
	default "transformer-t114"

config SYS_VENDOR
	default "asus"

config TEGRA_BOARD_STRING
	string "Default Tegra board name"
	default "ASUS Transformer T114"

config TEGRA_PRAM_SIZE
	depends on TEGRA_PRAM
	default 0x20000

endif
```

## board/asus/transformer-t20/Kconfig
```kconfig
if TARGET_TRANSFORMER_T20

config SYS_BOARD
	default "transformer-t20"

config SYS_VENDOR
	default "asus"

config TEGRA_BOARD_STRING
	string "Default Tegra board name"
	default "ASUS Transformer T20"

endif
```

## board/asus/transformer-t30/Kconfig
```kconfig
if TARGET_TRANSFORMER_T30

config SYS_BOARD
	default "transformer-t30"

config SYS_VENDOR
	default "asus"

config TEGRA_BOARD_STRING
	string "Default Tegra board name"
	default "ASUS Transformer T30"

endif
```
