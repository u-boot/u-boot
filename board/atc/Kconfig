## board/atc/Kconfig
```kconfig
if TARGET_ATC

config SYS_BOARD
	default "atc"

config SYS_CONFIG_NAME
	default "atc"

endif
```

## board/atmark-techno/armadillo-800eva/Kconfig
```kconfig
if TARGET_ARMADILLO_800EVA

config SYS_BOARD
	string
	default "armadillo-800eva"

config SYS_VENDOR
	string
	default "atmark-techno"

config SYS_CONFIG_NAME
	string
	default "armadillo-800eva"

endif
```

## board/atmel/at91rm9200ek/Kconfig
```kconfig
if TARGET_AT91RM9200EK

config SYS_CPU
	string
	default "arm920t"

config SYS_BOARD
	string
	default "at91rm9200ek"

config SYS_VENDOR
	string
	default "atmel"

config SYS_SOC
	string
	default "at91"

config SYS_CONFIG_NAME
	string
	default "at91rm9200ek"

endif
```

## board/atmel/at91sam9260ek/Kconfig
```kconfig
if TARGET_AT91SAM9260EK

config SYS_CPU
	string
	default "arm926ejs"

config SYS_BOARD
	string
	default "at91sam9260ek"

config SYS_VENDOR
	string
	default "atmel"

config SYS_SOC
	string
	default "at91"

config SYS_CONFIG_NAME
	string
	default "at91sam9260ek"

endif
```

## board/atmel/at91sam9261ek/Kconfig
```kconfig
if TARGET_AT91SAM9261EK

config SYS_CPU
	default "arm926ejs"

config SYS_BOARD
	default "at91sam9261ek"

config SYS_VENDOR
	default "atmel"

config SYS_SOC
	default "at91"

config SYS_CONFIG_NAME
	default "at91sam9261ek"

endif
```

## board/atmel/at91sam9263ek/Kconfig
```kconfig
if TARGET_AT91SAM9263EK

config SYS_CPU
	string
	default "arm926ejs"

config SYS_BOARD
	string
	default "at91sam9263ek"

config SYS_VENDOR
	string
	default "atmel"

config SYS_SOC
	string
	default "at91"

config SYS_CONFIG_NAME
	string
	default "at91sam9263ek"

endif
```

## board/atmel/at91sam9n12ek/Kconfig
```kconfig
if TARGET_AT91SAM9N12EK

config SYS_CPU
	default "arm926ejs"

config SYS_BOARD
	default "at91sam9n12ek"

config SYS_VENDOR
	default "atmel"

config SYS_SOC
	default "at91"

config SYS_CONFIG_NAME
	default "at91sam9n12ek"

endif
```

## board/atmel/at91sam9rlek/Kconfig
```kconfig
if TARGET_AT91SAM9RLEK

config SYS_CPU
	string
	default "arm926ejs"

config SYS_BOARD
	string
	default "at91sam9rlek"

config SYS_VENDOR
	string
	default "atmel"

config SYS_SOC
	string
	default "at91"

config SYS_CONFIG_NAME
	string
	default "at91sam9rlek"

endif
```

## board/atmel/at91sam9x5ek/Kconfig
```kconfig
if TARGET_AT91SAM9X5EK

config SYS_CPU
	string
	default "arm926ejs"

config SYS_BOARD
	string
	default "at91sam9x5ek"

config SYS_VENDOR
	string
	default "atmel"

config SYS_SOC
	string
	default "at91"

config SYS_CONFIG_NAME
	string
	default "at91sam9x5ek"

endif
```

## board/atmel/atngw100/Kconfig
```kconfig
if TARGET_ATNGW100

config SYS_BOARD
	default "atngw100"

config SYS_VENDOR
	default "atmel"

config SYS_SOC
	default "at32ap700x"

config SYS_CONFIG_NAME
	default "atngw100"

endif
```

## board/atmel/atngw100mkii/Kconfig
```kconfig
if TARGET_ATNGW100MKII

config SYS_BOARD
	default "atngw100mkii"

config SYS_VENDOR
	default "atmel"

config SYS_SOC
	default "at32ap700x"

config SYS_CONFIG_NAME
	default "atngw100mkii"

endif
```

## board/atmel/atstk1000/Kconfig
```kconfig
if TARGET_ATSTK1002

config SYS_BOARD
	default "atstk1000"

config SYS_VENDOR
	default "atmel"

config SYS_SOC
	default "at32ap700x"

config SYS_CONFIG_NAME
	default "atstk1002"

endif
```

## board/atmel/sam9x75_curiosity/Kconfig
```kconfig
if TARGET_SAM9X75_CURIOSITY

config SYS_BOARD
	default "sam9x75_curiosity"

config SYS_VENDOR
	default "atmel"

config SYS_SOC
	default "at91"

config SYS_CONFIG_NAME
	default "sam9x75_curiosity"

endif
```

## board/atmel/sama5d3_xplained/Kconfig
```kconfig
if TARGET_SAMA5D3_XPLAINED

config SYS_BOARD
	default "sama5d3_xplained"

config SYS_VENDOR
	default "atmel"

config SYS_SOC
	default "at91"

config SYS_CONFIG_NAME
	default "sama5d3_xplained"

endif
```

## board/atmel/sama5d3xek/Kconfig
```kconfig
if TARGET_SAMA5D3XEK

config SYS_CPU
	string
	default "armv7"

config SYS_BOARD
	string
	default "sama5d3xek"

config SYS_VENDOR
	string
	default "atmel"

config SYS_SOC
	string
	default "at91"

config SYS_CONFIG_NAME
	string
	default "sama5d3xek"

endif
```

## board/atmel/sama5d4_xplained/Kconfig
```kconfig
if TARGET_SAMA5D4_XPLAINED

config SYS_BOARD
	default "sama5d4_xplained"

config SYS_VENDOR
	default "atmel"

config SYS_SOC
	default "at91"

config SYS_CONFIG_NAME
	default "sama5d4_xplained"

endif
```

## board/atmel/sama5d4ek/Kconfig
```kconfig
if TARGET_SAMA5D4EK

config SYS_BOARD
	default "sama5d4ek"

config SYS_VENDOR
	default "atmel"

config SYS_SOC
	default "at91"

config SYS_CONFIG_NAME
	default "sama5d4ek"

endif
```

## board/atmel/sama7d65_curiosity/Kconfig
```kconfig
if TARGET_SAMA7D65_CURIOSITY

config SYS_BOARD
	default "sama7d65_curiosity"

config SYS_VENDOR
	default "atmel"

config SYS_SOC
	default "at91"

config SYS_CONFIG_NAME
	default "sama7d65_curiosity"

endif
```

## board/atmel/sama7g54_curiosity/Kconfig
```kconfig
if TARGET_SAMA7G54_CURIOSITY

config SYS_BOARD
	default "sama7g54_curiosity"

config SYS_VENDOR
	default "atmel"

config SYS_SOC
	default "at91"

config SYS_CONFIG_NAME
	default "sama7g54_curiosity"

endif
```

## board/avionic-design/medcom-wide/Kconfig
```kconfig
if TARGET_MEDCOM_WIDE

config SYS_BOARD
	default "medcom-wide"

config SYS_VENDOR
	default "avionic-design"

config TEGRA_BOARD_STRING
	string "Default Tegra board name"
	default "Avionic Design Medcom-Wide"

endif
```

## board/avionic-design/plutux/Kconfig
```kconfig
if TARGET_PLUTUX

config SYS_BOARD
	default "plutux"

config SYS_VENDOR
	default "avionic-design"

config TEGRA_BOARD_STRING
	string "Default Tegra board name"
	default "Avionic Design Plutux"

endif
```

## board/avionic-design/tec-ng/Kconfig
```kconfig
if TARGET_TEC_NG

config SYS_BOARD
	default "tec-ng"

config SYS_VENDOR
	default "avionic-design"

config TEGRA_BOARD_STRING
	string "Default Tegra board name"
	default "Avionic Design Tamonten™ NG Evaluation Carrier"

endif
```

## board/avionic-design/tec/Kconfig
```kconfig
if TARGET_TEC

config SYS_BOARD
	default "tec"

config SYS_VENDOR
	default "avionic-design"

config TEGRA_BOARD_STRING
	string "Default Tegra board name"
	default "Avionic Design Tamonten Evaluation Carrier"

endif
```

## board/avnet/fx12mm/Kconfig
```kconfig
if TARGET_FX12MM

config SYS_BOARD
	default "fx12mm"

config SYS_VENDOR
	default "avnet"

config SYS_CONFIG_NAME
	default "fx12mm"

endif
```

## board/avnet/v5fx30teval/Kconfig
```kconfig
if TARGET_V5FX30TEVAL

config SYS_BOARD
	default "v5fx30teval"

config SYS_VENDOR
	default "avnet"

config SYS_CONFIG_NAME
	default "v5fx30teval"

endif
```
