## board/axiado/scm3005/Kconfig
```kconfig
if TARGET_SCM3005

config SYS_BOARD
	string
	default "scm3005"

config SYS_VENDOR
	string
	default "axiado"

config SYS_CONFIG_NAME
	string
	default "ax3005-scm3005"

endif
```

## board/bachmann/ot1200/Kconfig
```kconfig
if TARGET_OT1200

config SYS_BOARD
	default "ot1200"

config SYS_VENDOR
	default "bachmann"

config SYS_SOC
	default "mx6"

config SYS_CONFIG_NAME
	default "ot1200"

endif
```

## board/balloon3/Kconfig
```kconfig
if TARGET_BALLOON3

config SYS_CPU
	default "pxa"

config SYS_BOARD
	default "balloon3"

config SYS_CONFIG_NAME
	default "balloon3"

endif
```

## board/barco/titanium/Kconfig
```kconfig
if TARGET_TITANIUM

config SYS_BOARD
	default "titanium"

config SYS_VENDOR
	default "barco"

config SYS_SOC
	default "mx6"

config SYS_CONFIG_NAME
	default "titanium"

endif
```

## board/bc3450/Kconfig
```kconfig
if TARGET_BC3450

config SYS_BOARD
	default "bc3450"

config SYS_CONFIG_NAME
	default "BC3450"

endif
```

## board/bct-brettl2/Kconfig
```kconfig
if TARGET_BCT_BRETTL2

config SYS_BOARD
	default "bct-brettl2"

config SYS_CONFIG_NAME
	default "bct-brettl2"

endif
```

## board/beacon/beacon-rzg2m/Kconfig
```kconfig
if TARGET_BEACON_RZG2H || TARGET_BEACON_RZG2M || TARGET_BEACON_RZG2N

config SYS_SOC
	default "rmobile"

config SYS_BOARD
	default "beacon-rzg2m"

config SYS_VENDOR
	default "beacon"

config SYS_CONFIG_NAME
	default "beacon-rzg2m"

endif
```

## board/beacon/imx8mm/Kconfig
```kconfig
if TARGET_IMX8MM_BEACON

config SYS_BOARD
	default "imx8mm"

config SYS_VENDOR
	default "beacon"

config SYS_CONFIG_NAME
	default "imx8mm_beacon"

source "board/freescale/common/Kconfig"

endif
```

## board/beacon/imx8mn/Kconfig
```kconfig
if TARGET_IMX8MN_BEACON

config SYS_BOARD
	default "imx8mn"

config SYS_VENDOR
	default "beacon"

config SYS_CONFIG_NAME
	default "imx8mn_beacon"

config IMX8MN_FORCE_NOM_SOC
	bool "Force to use nominal mode for SOC and ARM"
	default n

config IMX8MN_BEACON_2GB_LPDDR
	bool "Enable 2GB LPDDR"
	default n

source "board/freescale/common/Kconfig"

endif
```

## board/beagle/beaglev_fire/Kconfig
```kconfig
if TARGET_BEAGLEBOARD_BEAGLEVFIRE

config SYS_BOARD
	default "beaglev_fire"

config SYS_VENDOR
	default "beagle"

config SYS_CPU
	default "mpfs"

config SYS_CONFIG_NAME
	default "beaglev_fire"

config TEXT_BASE
	default 0x80000000 if !RISCV_SMODE
	default 0x80200000 if RISCV_SMODE

config BOARD_SPECIFIC_OPTIONS # dummy
	def_bool y
	select MICROCHIP_MPFS
	select BOARD_EARLY_INIT_F
	select BOARD_LATE_INIT
	imply SMP
	imply CMD_DHCP
	imply CMD_EXT2
	imply CMD_EXT4
	imply CMD_FAT
	imply CMD_FS_GENERIC
	imply CMD_NET
	imply CMD_PING
	imply CMD_MMC
	imply DOS_PARTITION
	imply EFI_PARTITION
	imply IP_DYN
	imply ISO_PARTITION
	imply PHY_LIB
	imply PHY_VITESSE
endif
```

## board/beagle/beagley-ai/Kconfig
```kconfig
# SPDX-License-Identifier: GPL-2.0+
#
# Copyright (C) 2025 Texas Instruments Incorporated - https://www.ti.com/
#

if TARGET_J722S_R5_BEAGLEY_AI || TARGET_J722S_A53_BEAGLEY_AI

config SYS_BOARD
       default "beagley-ai"

config SYS_VENDOR
       default "beagle"

config SYS_CONFIG_NAME
       default "beagley_ai"

source "board/ti/common/Kconfig"

endif

if TARGET_J722S_R5_BEAGLEY_AI

config SPL_LDSCRIPT
	default "arch/arm/mach-omap2/u-boot-spl.lds"

endif
```

## board/beagle/pocketbeagle2/Kconfig
```kconfig
# SPDX-License-Identifier: GPL-2.0+
#
# Copyright (C) 2025 Texas Instruments Incorporated - https://www.ti.com/
#

choice
	prompt "BeagleBoard.org AM62X based PocketBeagle 2 board"
	optional

config TARGET_AM62X_A53_POCKETBEAGLE2
	bool "BeagleBoard.org AM62X PocketBeagle 2 running on A53"
	select ARM64
	select BINMAN
	select OF_SYSTEM_SETUP

config TARGET_AM62X_R5_POCKETBEAGLE2
	bool "BeagleBoard.org AM62X PocketBeagle 2 running on R5"
	select CPU_V7R
	select SYS_THUMB_BUILD
	select K3_LOAD_SYSFW
	select RAM
	select SPL_RAM
	select K3_DDRSS
	select BINMAN
	imply SYS_K3_SPL_ATF

endchoice

if TARGET_AM62X_A53_POCKETBEAGLE2

config SYS_BOARD
	default "pocketbeagle2"

config SYS_VENDOR
	default "beagle"

config SYS_CONFIG_NAME
	default "pocketbeagle2"

source "board/ti/common/Kconfig"

endif

if TARGET_AM62X_R5_POCKETBEAGLE2

config SYS_BOARD
	default "pocketbeagle2"

config SYS_VENDOR
	default "beagle"

config SYS_CONFIG_NAME
	default "pocketbeagle2"

config SPL_LDSCRIPT
	default "arch/arm/mach-omap2/u-boot-spl.lds"

source "board/ti/common/Kconfig"

endif
```

## board/bf506f-ezkit/Kconfig
```kconfig
if TARGET_BF506F_EZKIT

config SYS_BOARD
	default "bf506f-ezkit"

config SYS_CONFIG_NAME
	default "bf506f-ezkit"

endif
```

## board/bf518f-ezbrd/Kconfig
```kconfig
if TARGET_BF518F_EZBRD

config SYS_BOARD
	default "bf518f-ezbrd"

config SYS_CONFIG_NAME
	default "bf518f-ezbrd"

endif
```

## board/bf525-ucr2/Kconfig
```kconfig
if TARGET_BF525_UCR2

config SYS_BOARD
	default "bf525-ucr2"

config SYS_CONFIG_NAME
	default "bf525-ucr2"

endif
```

## board/bf526-ezbrd/Kconfig
```kconfig
if TARGET_BF526_EZBRD

config SYS_BOARD
	default "bf526-ezbrd"

config SYS_CONFIG_NAME
	default "bf526-ezbrd"

endif
```

## board/bf527-ad7160-eval/Kconfig
```kconfig
if TARGET_BF527_AD7160_EVAL

config SYS_BOARD
	default "bf527-ad7160-eval"

config SYS_CONFIG_NAME
	default "bf527-ad7160-eval"

endif
```

## board/bf527-ezkit/Kconfig
```kconfig
if TARGET_BF527_EZKIT

config SYS_BOARD
	default "bf527-ezkit"

config SYS_CONFIG_NAME
	default "bf527-ezkit"

endif
```

## board/bf527-sdp/Kconfig
```kconfig
if TARGET_BF527_SDP

config SYS_BOARD
	default "bf527-sdp"

config SYS_CONFIG_NAME
	default "bf527-sdp"

endif
```

## board/bf533-ezkit/Kconfig
```kconfig
if TARGET_BF533_EZKIT

config SYS_BOARD
	default "bf533-ezkit"

config SYS_CONFIG_NAME
	default "bf533-ezkit"

endif
```

## board/bf533-stamp/Kconfig
```kconfig
if TARGET_BF533_STAMP

config SYS_BOARD
	default "bf533-stamp"

config SYS_CONFIG_NAME
	default "bf533-stamp"

endif
```

## board/bf537-minotaur/Kconfig
```kconfig
if TARGET_BF537_MINOTAUR

config SYS_BOARD
	default "bf537-minotaur"

config SYS_CONFIG_NAME
	default "bf537-minotaur"

endif
```

## board/bf537-pnav/Kconfig
```kconfig
if TARGET_BF537_PNAV

config SYS_BOARD
	default "bf537-pnav"

config SYS_CONFIG_NAME
	default "bf537-pnav"

endif
```

## board/bf537-srv1/Kconfig
```kconfig
if TARGET_BF537_SRV1

config SYS_BOARD
	default "bf537-srv1"

config SYS_CONFIG_NAME
	default "bf537-srv1"

endif
```

## board/bf537-stamp/Kconfig
```kconfig
if TARGET_BF537_STAMP

config SYS_BOARD
	default "bf537-stamp"

config SYS_CONFIG_NAME
	default "bf537-stamp"

endif
```
