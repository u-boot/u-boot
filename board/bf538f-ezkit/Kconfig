## board/bf538f-ezkit/Kconfig
```kconfig
if TARGET_BF538F_EZKIT

config SYS_BOARD
	default "bf538f-ezkit"

config SYS_CONFIG_NAME
	default "bf538f-ezkit"

endif
```

## board/bf548-ezkit/Kconfig
```kconfig
if TARGET_BF548_EZKIT

config SYS_BOARD
	default "bf548-ezkit"

config SYS_CONFIG_NAME
	default "bf548-ezkit"

endif
```

## board/bf561-acvilon/Kconfig
```kconfig
if TARGET_BF561_ACVILON

config SYS_BOARD
	default "bf561-acvilon"

config SYS_CONFIG_NAME
	default "bf561-acvilon"

endif
```

## board/bf561-ezkit/Kconfig
```kconfig
if TARGET_BF561_EZKIT

config SYS_BOARD
	default "bf561-ezkit"

config SYS_CONFIG_NAME
	default "bf561-ezkit"

endif
```

## board/bf609-ezkit/Kconfig
```kconfig
if TARGET_BF609_EZKIT

config SYS_BOARD
	default "bf609-ezkit"

config SYS_CONFIG_NAME
	default "bf609-ezkit"

endif
```

## board/birdland/bav335x/Kconfig
```kconfig
if TARGET_BAV335X

config SYS_BOARD
	default "bav335x"

config SYS_VENDOR
	default "birdland"

config SYS_SOC
	default "am33xx"

config SYS_CONFIG_NAME
	default "bav335x"

config CONS_INDEX
	int "UART used for console"
	range 1 6
	default 1
	help
	  The AM335x SoC has a total of 6 UARTs (UART0 to UART5 as referenced
	  in documentation, etc) available to it.  Depending on your specific
	  board you may want something other than UART0 as for example the IDK
	  uses UART3 so enter 4 here.

config BAV_VERSION
	int "BAV335x Version (1=A, 2=B)"
	range 1 2
	help
	  The BAV335x has various version of the board. Rev.A (mostly obsolete)
	  used 10/100 Ethernet PHY while Rev.B uses a Gigabit Ethernet PHY.
	  Overwrite this if you have an older Rev.A and want ethernet support.

endif
```

## board/blackstamp/Kconfig
```kconfig
if TARGET_BLACKSTAMP

config SYS_BOARD
	default "blackstamp"

config SYS_CONFIG_NAME
	default "blackstamp"

endif
```

## board/blackvme/Kconfig
```kconfig
if TARGET_BLACKVME

config SYS_BOARD
	default "blackvme"

config SYS_CONFIG_NAME
	default "blackvme"

endif
```

## board/bluegiga/apx4devkit/Kconfig
```kconfig
if TARGET_APX4DEVKIT

config SYS_CPU
	string
	default "arm926ejs"

config SYS_BOARD
	string
	default "apx4devkit"

config SYS_VENDOR
	string
	default "bluegiga"

config SYS_SOC
	string
	default "mxs"

config SYS_CONFIG_NAME
	string
	default "apx4devkit"

endif
```

## board/bluewater/snapper9260/Kconfig
```kconfig
if TARGET_SNAPPER9260

config SYS_CPU
	string
	default "arm926ejs"

config SYS_BOARD
	string
	default "snapper9260"

config SYS_VENDOR
	string
	default "bluewater"

config SYS_SOC
	string
	default "at91"

config SYS_CONFIG_NAME
	string
	default "snapper9260"

endif
```

## board/boundary/nitrogen6x/Kconfig
```kconfig
if TARGET_NITROGEN6X

config SYS_CPU
	default "armv7"

config SYS_BOARD
	default "nitrogen6x"

config SYS_VENDOR
	default "boundary"

config SYS_SOC
	default "mx6"

config SYS_CONFIG_NAME
	default "nitrogen6x"

endif
```

## board/br4/Kconfig
```kconfig
if TARGET_BR4

config SYS_BOARD
	default "br4"

config SYS_CONFIG_NAME
	default "br4"

endif
```

## board/broadcom/bcm28155_ap/Kconfig
```kconfig
if TARGET_BCM28155_AP

config SYS_CPU
	string
	default "armv7"

config SYS_BOARD
	string
	default "bcm28155_ap"

config SYS_VENDOR
	string
	default "broadcom"

config SYS_SOC
	string
	default "bcm281xx"

config SYS_CONFIG_NAME
	string
	default "bcm28155_ap"

endif
```

## board/broadcom/bcm958300k/Kconfig
```kconfig
if TARGET_BCM958300K

config SYS_CPU
	default "armv7"

config SYS_BOARD
	default "bcm_ep"

config SYS_VENDOR
	default "broadcom"

config SYS_SOC
	default "bcmcygnus"

config SYS_CONFIG_NAME
	default "bcm_ep_board"

endif
```

## board/broadcom/bcm958622hr/Kconfig
```kconfig
if TARGET_BCM958622HR

config SYS_CPU
	default "armv7"

config SYS_BOARD
	default "bcm_ep"

config SYS_VENDOR
	default "broadcom"

config SYS_SOC
	default "bcmnsp"

config SYS_CONFIG_NAME
	default "bcm_ep_board"

endif
```

## board/broadcom/bcm96753ref/Kconfig
```kconfig
if TARGET_BCM96753REF

config SYS_VENDOR
	default "broadcom"

config SYS_BOARD
	default "bcm96753ref"

config SYS_CONFIG_NAME
	default "broadcom_bcm96753ref"

endif

config TARGET_BCM96753REF
	bool "Support Broadcom bcm96753ref"
	depends on ARCH_BCM6753
```

## board/broadcom/bcm968360bg/Kconfig
```kconfig
if ARCH_BCM68360

config SYS_VENDOR
	default "broadcom"

config SYS_BOARD
	default "bcm968360bg"

config SYS_CONFIG_NAME
	default "broadcom_bcm968360bg"

endif

config TARGET_BCM968360BG
	bool "Support Broadcom bcm968360bg"
	depends on ARCH_BCM68360
	select ARM64
```

## board/broadcom/bcmbca/Kconfig
```kconfig
# SPDX-License-Identifier: GPL-2.0+
#
# (C) Copyright 2022 Broadcom Ltd
#

config SYS_BOARD
	default "bcmbca"

config SYS_VENDOR
	default "broadcom"

if TARGET_BCM947622

config SYS_CONFIG_NAME
	default "bcm947622"

endif

if TARGET_BCM94908

config SYS_CONFIG_NAME
	default "bcm94908"

endif

if TARGET_BCM94912

config SYS_CONFIG_NAME
	default "bcm94912"

endif

if TARGET_BCM963138

config SYS_CONFIG_NAME
	default "bcm963138"

endif

if TARGET_BCM963146

config SYS_CONFIG_NAME
	default "bcm963146"

endif

if TARGET_BCM963148

config SYS_CONFIG_NAME
	default "bcm963148"

endif

if TARGET_BCM963158

config SYS_CONFIG_NAME
	default "bcm963158"

endif

if TARGET_BCM963178

config SYS_CONFIG_NAME
	default "bcm963178"

endif

if TARGET_BCM96756

config SYS_CONFIG_NAME
	default "bcm96756"

endif

if TARGET_BCM96813

config SYS_CONFIG_NAME
	default "bcm96813"

endif

if TARGET_BCM96846

config SYS_CONFIG_NAME
	default "bcm96846"

endif

if TARGET_BCM96855

config SYS_CONFIG_NAME
	default "bcm96855"

endif

if TARGET_BCM96856

config SYS_CONFIG_NAME
	default "bcm96856"

endif

if TARGET_BCM96858

config SYS_CONFIG_NAME
	default "bcm96858"

endif

if TARGET_BCM96878

config SYS_CONFIG_NAME
	default "bcm96878"

endif
```

## board/broadcom/bcmns3/Kconfig
```kconfig
if TARGET_BCMNS3

config SYS_BOARD
	default "bcmns3"

config SYS_VENDOR
	default "broadcom"

config SYS_SOC
	default "bcmns3"

config SYS_CONFIG_NAME
	default "bcm_ns3"

endif
```

## board/bsh/imx6ulz_smm_m2/Kconfig
```kconfig
if TARGET_MX6ULZ_SMM_M2

config SYS_BOARD
	default "imx6ulz_smm_m2"

config SYS_VENDOR
	default "bsh"

config SYS_CONFIG_NAME
	default "imx6ulz_smm_m2"

choice
	prompt "Memory Type (M2/M2B) board"
	default BSH_M2_MEMORY
	help
	  Memory type setup.
	  Please choose correct memory model here.

config BSH_M2_MEMORY
	bool "Enable for bsh m2 variant"
	help
	  If this option is enabled, U-Boot will be configured to support
	  imx6ulz bsh m2 revision memories.

config BSH_M2B_MEMORY
	bool "Enable for bsh m2b variant"
	help
	  If this option is enabled, U-Boot will be configured to support
	  imx6ulz bsh m2b revision memories.

endchoice

endif
```

## board/buffalo/lsxl/Kconfig
```kconfig
if TARGET_LSXL

config SYS_BOARD
	string
	default "lsxl"

config SYS_VENDOR
	string
	default "buffalo"

config SYS_CONFIG_NAME
	string
	default "lsxl"

endif
```

## board/calao/sbc35_a9g20/Kconfig
```kconfig
if TARGET_SBC35_A9G20

config SYS_BOARD
	default "sbc35_a9g20"

config SYS_VENDOR
	default "calao"

config SYS_SOC
	default "at91"

config SYS_CONFIG_NAME
	default "sbc35_a9g20"

endif
```

## board/calao/tny_a9260/Kconfig
```kconfig
if TARGET_TNY_A9260

config SYS_BOARD
	default "tny_a9260"

config SYS_VENDOR
	default "calao"

config SYS_CONFIG_NAME
	default "tny_a9260"

endif
```

## board/calao/usb_a9263/Kconfig
```kconfig
if TARGET_USB_A9263

config SYS_CPU
	string
	default "arm926ejs"

config SYS_BOARD
	string
	default "usb_a9263"

config SYS_VENDOR
	string
	default "calao"

config SYS_SOC
	string
	default "at91"

config SYS_CONFIG_NAME
	string
	default "usb_a9263"

endif
```

## board/canaan/k230_canmv/Kconfig
```kconfig
if TARGET_K230_CANMV

config SYS_BOARD
	default "k230_canmv"

config SYS_VENDOR
	default "canaan"

config SYS_CPU
	default "k230"

config TEXT_BASE
	default 0x0

config BOARD_SPECIFIC_OPTIONS
	def_bool y
	select CANAAN_K230

endif
```
