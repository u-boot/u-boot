## board/canmb/Kconfig
```kconfig
if TARGET_CANMB

config SYS_BOARD
	default "canmb"

config SYS_CONFIG_NAME
	default "canmb"

endif
```

## board/cavium/thunderx/Kconfig
```kconfig
if TARGET_THUNDERX_88XX

config SYS_CPU
	default "armv8"

config SYS_BOARD
	default "thunderx"

config SYS_VENDOR
	default "cavium"

config SYS_CONFIG_NAME
	default "thunderx_88xx"

config CMD_ATF
	bool "Enable ATF query commands"
	default y
	help
	  Enable vendor specific ATF query commands such as SPI and SD/MMC
	  devices access, low level environment query, boot device layout
	  and node count.

endif
```

## board/cei/cei-tk1-som/Kconfig
```kconfig
if TARGET_CEI_TK1_SOM

config SYS_BOARD
	default "cei-tk1-som"

config SYS_VENDOR
	default "cei"

config TEGRA_BOARD_STRING
	string "Default Tegra board name"
	default "CEI tk1-som"

endif
```

## board/chipspark/popmetal_rk3288/Kconfig
```kconfig
if TARGET_POPMETAL_RK3288

config SYS_BOARD
	default "popmetal_rk3288"

config SYS_VENDOR
	default "chipspark"

config SYS_CONFIG_NAME
	default "popmetal_rk3288"

endif
```

## board/chromebook-x86/coreboot/Kconfig
```kconfig
if TARGET_COREBOOT

config SYS_BOARD
	default "coreboot"

config SYS_VENDOR
	default "chromebook-x86"

config SYS_SOC
	default "coreboot"

config SYS_CONFIG_NAME
	default "coreboot"

endif
```

## board/cirrus/edb93xx/Kconfig
```kconfig
if TARGET_EDB93XX

config SYS_CPU
	string
	default "arm920t"

config SYS_BOARD
	string
	default "edb93xx"

config SYS_VENDOR
	string
	default "cirrus"

config SYS_SOC
	string
	default "ep93xx"

config SYS_CONFIG_NAME
	string
	default "edb93xx"

endif
```

## board/cloudengines/pogo_e02/Kconfig
```kconfig
if TARGET_POGO_E02

config SYS_BOARD
	string
	default "pogo_e02"

config SYS_VENDOR
	string
	default "cloudengines"

config SYS_CONFIG_NAME
	string
	default "pogo_e02"

endif
```

## board/cm-bf527/Kconfig
```kconfig
if TARGET_CM_BF527

config SYS_BOARD
	default "cm-bf527"

config SYS_CONFIG_NAME
	default "cm-bf527"

endif
```

## board/cm-bf533/Kconfig
```kconfig
if TARGET_CM_BF533

config SYS_BOARD
	default "cm-bf533"

config SYS_CONFIG_NAME
	default "cm-bf533"

endif
```

## board/cm-bf537e/Kconfig
```kconfig
if TARGET_CM_BF537E

config SYS_BOARD
	default "cm-bf537e"

config SYS_CONFIG_NAME
	default "cm-bf537e"

endif
```

## board/cm-bf537u/Kconfig
```kconfig
if TARGET_CM_BF537U

config SYS_BOARD
	default "cm-bf537u"

config SYS_CONFIG_NAME
	default "cm-bf537u"

endif
```

## board/cm-bf548/Kconfig
```kconfig
if TARGET_CM_BF548

config SYS_BOARD
	default "cm-bf548"

config SYS_CONFIG_NAME
	default "cm-bf548"

endif
```

## board/cm-bf561/Kconfig
```kconfig
if TARGET_CM_BF561

config SYS_BOARD
	default "cm-bf561"

config SYS_CONFIG_NAME
	default "cm-bf561"

endif
```

## board/cm4008/Kconfig
```kconfig
if TARGET_CM4008

config SYS_BOARD
	default "cm4008"

config SYS_SOC
	default "ks8695"

config SYS_CONFIG_NAME
	default "cm4008"

endif
```

## board/cm41xx/Kconfig
```kconfig
if TARGET_CM41XX

config SYS_CPU
	default "arm920t"

config SYS_BOARD
	default "cm41xx"

config SYS_SOC
	default "ks8695"

config SYS_CONFIG_NAME
	default "cm41xx"

endif
```

## board/cm5200/Kconfig
```kconfig
if TARGET_CM5200

config SYS_BOARD
	default "cm5200"

config SYS_CONFIG_NAME
	default "cm5200"

endif
```

## board/cmi/Kconfig
```kconfig
if TARGET_CMI_MPC5XX

config SYS_BOARD
	default "cmi"

config SYS_CONFIG_NAME
	default "cmi_mpc5xx"

endif
```

## board/cobra5272/Kconfig
```kconfig
if TARGET_COBRA5272

config SYS_CPU
	string
	default "mcf52x2"

config SYS_BOARD
	string
	default "cobra5272"

config SYS_CONFIG_NAME
	string
	default "cobra5272"

endif
```

## board/cogent/Kconfig
```kconfig
if TARGET_COGENT_MPC8260

config SYS_BOARD
	default "cogent"

config SYS_CONFIG_NAME
	default "cogent_mpc8260"

endif

if TARGET_COGENT_MPC8XX

config SYS_BOARD
	default "cogent"

config SYS_CONFIG_NAME
	default "cogent_mpc8xx"

endif
```

## board/comelit/dig297/Kconfig
```kconfig
if TARGET_DIG297

config SYS_BOARD
	default "dig297"

config SYS_VENDOR
	default "comelit"

config SYS_CONFIG_NAME
	default "dig297"

endif
```

## board/compal/paz00/Kconfig
```kconfig
if TARGET_PAZ00

config SYS_BOARD
	default "paz00"

config SYS_VENDOR
	default "compal"

config TEGRA_BOARD_STRING
	string "Default Tegra board name"
	default "Compal Paz00"

endif
```

## board/compulab/cl-som-am57x/Kconfig
```kconfig
if TARGET_CL_SOM_AM57X

config SYS_BOARD
	default "cl-som-am57x"

config SYS_VENDOR
	default "compulab"

config SYS_CONFIG_NAME
	default "cl-som-am57x"

endif
```

## board/compulab/cm_fx6/Kconfig
```kconfig
if TARGET_CM_FX6

config SYS_CPU
	string
	default "armv7"

config SYS_BOARD
	string
	default "cm_fx6"

config SYS_VENDOR
	string
	default "compulab"

config SYS_SOC
	string
	default "mx6"

config SYS_CONFIG_NAME
	string
	default "cm_fx6"

endif
```

## board/compulab/cm_t335/Kconfig
```kconfig
if TARGET_CM_T335

config SYS_CPU
	string
	default "armv7"

config SYS_BOARD
	string
	default "cm_t335"

config SYS_VENDOR
	string
	default "compulab"

config SYS_SOC
	string
	default "am33xx"

config SYS_CONFIG_NAME
	string
	default "cm_t335"

endif
```

## board/compulab/cm_t35/Kconfig
```kconfig
if TARGET_CM_T35

config SYS_BOARD
	string
	default "cm_t35"

config SYS_VENDOR
	string
	default "compulab"

config SYS_CONFIG_NAME
	string
	default "cm_t35"

endif
```
