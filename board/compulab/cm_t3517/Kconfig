## board/compulab/cm_t3517/Kconfig
```kconfig
if TARGET_CM_T3517

config SYS_BOARD
	default "cm_t3517"

config SYS_VENDOR
	default "compulab"

config SYS_CONFIG_NAME
	default "cm_t3517"

endif
```

## board/compulab/cm_t54/Kconfig
```kconfig
if TARGET_CM_T54

config SYS_BOARD
	string
	default "cm_t54"

config SYS_VENDOR
	string
	default "compulab"

config SYS_CONFIG_NAME
	string
	default "cm_t54"

endif
```

## board/compulab/imx8mm-cl-iot-gate/Kconfig
```kconfig
if TARGET_IMX8MM_CL_IOT_GATE

config SYS_BOARD
	default "imx8mm-cl-iot-gate"

config SYS_VENDOR
	default "compulab"

config SYS_CONFIG_NAME
	default "imx8mm-cl-iot-gate"

endif
```

## board/compulab/trimslice/Kconfig
```kconfig
if TARGET_TRIMSLICE

config SYS_BOARD
	default "trimslice"

config SYS_VENDOR
	default "compulab"

config TEGRA_BOARD_STRING
	string "Default Tegra board name"
	default "Compulab Trimslice"

endif
```

## board/comvetia/lxr2/Kconfig
```kconfig
if TARGET_LXR2

config SYS_BOARD
	default "lxr2"

config SYS_VENDOR
	default "comvetia"

config SYS_CONFIG_NAME
	default "lxr2"

endif
```

## board/congatec/cgtqmx6eval/Kconfig
```kconfig
if TARGET_CGTQMX6EVAL

config SYS_CPU
	default "armv7"

config SYS_BOARD
	default "cgtqmx6eval"

config SYS_VENDOR
	default "congatec"

config SYS_SOC
	default "mx6"

config SYS_CONFIG_NAME
	default "cgtqmx6eval"

endif
```

## board/congatec/cgtqmx8/Kconfig
```kconfig
if TARGET_CONGA_QMX8

config SYS_BOARD
	default "cgtqmx8"

config SYS_VENDOR
	default "congatec"

config SYS_CONFIG_NAME
	default "cgtqmx8"

source "board/congatec/common/Kconfig"

endif
```

## board/congatec/conga-qeval20-qa3-e3845/Kconfig
```kconfig
if TARGET_CONGA_QEVAL20_QA3_E3845

config SYS_BOARD
	default "conga-qeval20-qa3-e3845"

config SYS_VENDOR
	default "congatec"

config SYS_SOC
	default "baytrail"

config SYS_CONFIG_NAME
	default "conga-qeval20-qa3-e3845"

config SYS_TEXT_BASE
	default 0xfff00000 if !EFI_STUB
	default 0x01110000 if EFI_STUB

config BOARD_SPECIFIC_OPTIONS # dummy
	def_bool y
	select X86_RESET_VECTOR if !EFI_STUB
	select INTEL_BAYTRAIL
	select BOARD_ROMSIZE_KB_8192

config PCIE_ECAM_BASE
	default 0xe0000000

endif
```

## board/coolpi/genbook_cm5_rk3588/Kconfig
```kconfig
if TARGET_GENBOOK_CM5_RK3588

config SYS_BOARD
	default "genbook_cm5_rk3588"

config SYS_VENDOR
	default "coolpi"

config SYS_CONFIG_NAME
	default "genbook-cm5-rk3588"

endif
```

## board/coreboot/coreboot/Kconfig
```kconfig
if TARGET_COREBOOT

config SYS_BOARD
	default "coreboot"

config SYS_VENDOR
	default "coreboot"

config SYS_SOC
	default "coreboot"

config SYS_TEXT_BASE
	default 0x01110000

config BOARD_SPECIFIC_OPTIONS # dummy
	def_bool y
	imply SPI_FLASH_ATMEL
	imply SPI_FLASH_EON
	imply SPI_FLASH_GIGADEVICE
	imply SPI_FLASH_MACRONIX
	imply SPI_FLASH_SPANSION
	imply SPI_FLASH_STMICRO
	imply SPI_FLASH_SST
	imply SPI_FLASH_WINBOND

comment "coreboot-specific options"

config SYS_CONFIG_NAME
	string "Board configuration file"
	default "qemu-x86"
	help
	  This option selects the board configuration file in include/configs/
	  directory to be used to build U-Boot for coreboot.

config DEFAULT_DEVICE_TREE
	string "Board Device Tree Source (dts) file"
	default "qemu-x86_i440fx"
	help
	  This option selects the board Device Tree Source (dts) file in
	  arch/x86/dts/ directory to be used to build U-Boot for coreboot.

config SYS_CAR_ADDR
	hex "Board specific Cache-As-RAM (CAR) address"
	default 0x01920000
	help
	  This option specifies the board specific Cache-As-RAM (CAR) address.

config SYS_CAR_SIZE
	hex "Board specific Cache-As-RAM (CAR) size"
	default 0x4000
	help
	  This option specifies the board specific Cache-As-RAM (CAR) size.

endif
```

## board/corscience/tricorder/Kconfig
```kconfig
if TARGET_TRICORDER

config SYS_BOARD
	string
	default "tricorder"

config SYS_VENDOR
	string
	default "corscience"

config SYS_CONFIG_NAME
	string
	default "tricorder"

endif
```

## board/cpc45/Kconfig
```kconfig
if TARGET_CPC45

config SYS_BOARD
	default "cpc45"

config SYS_CONFIG_NAME
	default "CPC45"

endif
```

## board/cpu86/Kconfig
```kconfig
if TARGET_CPU86

config SYS_BOARD
	default "cpu86"

config SYS_CONFIG_NAME
	default "CPU86"

endif
```

## board/cpu87/Kconfig
```kconfig
if TARGET_CPU87

config SYS_BOARD
	default "cpu87"

config SYS_CONFIG_NAME
	default "CPU87"

endif
```

## board/cray/L1/Kconfig
```kconfig
if TARGET_CRAYL1

config SYS_BOARD
	default "L1"

config SYS_VENDOR
	default "cray"

config SYS_CONFIG_NAME
	default "CRAYL1"

endif
```

## board/creative/xfi3/Kconfig
```kconfig
if TARGET_XFI3

config SYS_CPU
	default "arm926ejs"

config SYS_BOARD
	default "xfi3"

config SYS_VENDOR
	default "creative"

config SYS_SOC
	default "mxs"

config SYS_CONFIG_NAME
	default "xfi3"

endif
```

## board/csb272/Kconfig
```kconfig
if TARGET_CSB272

config SYS_BOARD
	default "csb272"

config SYS_CONFIG_NAME
	default "csb272"

endif
```

## board/csb472/Kconfig
```kconfig
if TARGET_CSB472

config SYS_BOARD
	default "csb472"

config SYS_CONFIG_NAME
	default "csb472"

endif
```

## board/cu824/Kconfig
```kconfig
if TARGET_CU824

config SYS_BOARD
	default "cu824"

config SYS_CONFIG_NAME
	default "CU824"

endif
```

## board/d-link/dns325/Kconfig
```kconfig
if TARGET_DNS325

config SYS_BOARD
	string
	default "dns325"

config SYS_VENDOR
	string
	default "d-link"

config SYS_CONFIG_NAME
	string
	default "dns325"

endif
```

## board/dave/PPChameleonEVB/Kconfig
```kconfig
if TARGET_CATCENTER

config SYS_BOARD
	default "PPChameleonEVB"

config SYS_VENDOR
	default "dave"

config SYS_CONFIG_NAME
	default "CATcenter"

endif

if TARGET_PPCHAMELEONEVB

config SYS_BOARD
	default "PPChameleonEVB"

config SYS_VENDOR
	default "dave"

config SYS_CONFIG_NAME
	default "PPChameleonEVB"

endif
```

## board/davedenx/aria/Kconfig
```kconfig
if TARGET_ARIA

config SYS_BOARD
	default "aria"

config SYS_VENDOR
	default "davedenx"

config SYS_CONFIG_NAME
	default "aria"

endif
```

## board/davedenx/qong/Kconfig
```kconfig
if TARGET_QONG

config SYS_BOARD
	default "qong"

config SYS_VENDOR
	default "davedenx"

config SYS_SOC
	default "mx31"

config SYS_CONFIG_NAME
	default "qong"

endif
```

## board/davinci/dm355evm/Kconfig
```kconfig
if TARGET_DAVINCI_DM355EVM

config SYS_BOARD
	default "dm355evm"

config SYS_VENDOR
	default "davinci"

config SYS_CONFIG_NAME
	default "davinci_dm355evm"

endif
```

## board/davinci/dm355leopard/Kconfig
```kconfig
if TARGET_DAVINCI_DM355LEOPARD

config SYS_BOARD
	default "dm355leopard"

config SYS_VENDOR
	default "davinci"

config SYS_CONFIG_NAME
	default "davinci_dm355leopard"

endif
```
