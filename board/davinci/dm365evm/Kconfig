## board/davinci/dm365evm/Kconfig
```kconfig
if TARGET_DAVINCI_DM365EVM

config SYS_BOARD
	default "dm365evm"

config SYS_VENDOR
	default "davinci"

config SYS_CONFIG_NAME
	default "davinci_dm365evm"

endif
```

## board/davinci/dm6467evm/Kconfig
```kconfig
if TARGET_DAVINCI_DM6467EVM

config SYS_BOARD
	default "dm6467evm"

config SYS_VENDOR
	default "davinci"

config SYS_CONFIG_NAME
	default "davinci_dm6467evm"

endif
```

## board/davinci/dvevm/Kconfig
```kconfig
if TARGET_DAVINCI_DVEVM

config SYS_BOARD
	default "dvevm"

config SYS_VENDOR
	default "davinci"

config SYS_CONFIG_NAME
	default "davinci_dvevm"

endif
```

## board/davinci/ea20/Kconfig
```kconfig
if TARGET_EA20

config SYS_BOARD
	default "ea20"

config SYS_VENDOR
	default "davinci"

config SYS_CONFIG_NAME
	default "ea20"

endif
```

## board/davinci/schmoogie/Kconfig
```kconfig
if TARGET_DAVINCI_SCHMOOGIE

config SYS_BOARD
	default "schmoogie"

config SYS_VENDOR
	default "davinci"

config SYS_CONFIG_NAME
	default "davinci_schmoogie"

endif
```

## board/davinci/sffsdr/Kconfig
```kconfig
if TARGET_DAVINCI_SFFSDR

config SYS_BOARD
	default "sffsdr"

config SYS_VENDOR
	default "davinci"

config SYS_CONFIG_NAME
	default "davinci_sffsdr"

endif
```

## board/davinci/sonata/Kconfig
```kconfig
if TARGET_DAVINCI_SONATA

config SYS_BOARD
	default "sonata"

config SYS_VENDOR
	default "davinci"

config SYS_CONFIG_NAME
	default "davinci_sonata"

endif
```

## board/dbau1x00/Kconfig
```kconfig
if TARGET_DBAU1X00

config SYS_BOARD
	default "dbau1x00"

config SYS_SOC
	default "au1x00"

config SYS_CONFIG_NAME
	default "dbau1x00"

config SYS_TEXT_BASE
	default 0xbfc00000

config SYS_DCACHE_SIZE
	default 16384

config SYS_DCACHE_LINE_SIZE
	default 32

config SYS_ICACHE_SIZE
	default 16384

config SYS_ICACHE_LINE_SIZE
	default 32

menu "dbau1x00 board options"

choice
	prompt "Select au1x00 SoC type"
	optional

config DBAU1100
	bool "Select AU1100"

config DBAU1500
	bool "Select AU1500"

config DBAU1550
	bool "Select AU1550"

endchoice

endmenu

endif
```

## board/denx/m28evk/Kconfig
```kconfig
if TARGET_M28EVK

config SYS_CPU
	default "arm926ejs"

config SYS_BOARD
	default "m28evk"

config SYS_VENDOR
	default "denx"

config SYS_SOC
	default "mxs"

config SYS_CONFIG_NAME
	default "m28evk"

endif
```

## board/denx/m53evk/Kconfig
```kconfig
if TARGET_M53EVK

config SYS_CPU
	default "armv7"

config SYS_BOARD
	default "m53evk"

config SYS_VENDOR
	default "denx"

config SYS_SOC
	default "mx5"

config SYS_CONFIG_NAME
	default "m53evk"

endif
```

## board/denx/ma5d4evk/Kconfig
```kconfig
if TARGET_MA5D4EVK

config SYS_BOARD
	default "ma5d4evk"

config SYS_VENDOR
	default "denx"

config SYS_CONFIG_NAME
	default "ma5d4evk"

endif
```

## board/dfi/dfi-bt700/Kconfig
```kconfig
if TARGET_DFI_BT700

config SYS_BOARD
	default "dfi-bt700"

config SYS_VENDOR
	default "dfi"

config SYS_SOC
	default "baytrail"

config SYS_CONFIG_NAME
	default "dfi-bt700"

config SYS_TEXT_BASE
	default 0xfff00000 if !EFI_STUB
	default 0x01110000 if EFI_STUB

config BOARD_SPECIFIC_OPTIONS # dummy
	def_bool y
	select X86_RESET_VECTOR if !EFI_STUB
	select INTEL_BAYTRAIL
	select BOARD_ROMSIZE_KB_8192

config PCIE_ECAM_BASE
	default 0xe0000000

endif
```

## board/dhelectronics/dh_stm32mp1/u-boot-dhcom.its
```
/dts-v1/;

/ {
	description = "U-Boot mainline";
	#address-cells = <1>;

	images {
		uboot {
			description = "U-Boot (32-bit)";
			data = /incbin/("u-boot-nodtb.bin");
			type = "standalone";
			os = "U-Boot";
			arch = "arm";
			compression = "none";
			load = <0xc0100000>;
			entry = <0xc0100000>;
		};

		fdt-1 {
			description = ".dtb";
			data = /incbin/("dts/upstream/src/arm/st/stm32mp157c-dhcom-pdk2.dtb");
			type = "flat_dt";
			arch = "arm";
			compression = "none";
		};

		fdt-2 {
			description = ".dtb";
			data = /incbin/("dts/upstream/src/arm/st/stm32mp153c-dhcom-drc02.dtb");
			type = "flat_dt";
			arch = "arm";
			compression = "none";
		};

		fdt-3 {
			description = ".dtb";
			data = /incbin/("dts/upstream/src/arm/st/stm32mp157c-dhcom-picoitx.dtb");
			type = "flat_dt";
			arch = "arm";
			compression = "none";
		};
	};

	configurations {
		default = "config-1";

		config-1 {
			/* DT+SoM+board model */
			description = "dh,stm32mp157c-dhcom-pdk2_somrev0_boardrev0";
			firmware = "uboot";
			fdt = "fdt-1";
		};

		config-2 {
			/* DT+SoM+board model */
			description = "dh,stm32mp157c-dhcom-pdk2_somrev1_boardrev0";
			firmware = "uboot";
			fdt = "fdt-1";
		};

		config-3 {
			/* DT+SoM+board model */
			description = "dh,stm32mp153c-dhcom-drc02_somrev0_boardrev0";
			firmware = "uboot";
			fdt = "fdt-2";
		};

		config-4 {
			/* DT+SoM+board model */
			description = "dh,stm32mp153c-dhcom-drc02_somrev1_boardrev0";
			firmware = "uboot";
			fdt = "fdt-2";
		};

		config-5 {
			/* DT+SoM+board model */
			description = "dh,stm32mp157c-dhcom-picoitx_somrev0_boardrev0";
			loadables = "uboot";
			fdt = "fdt-3";
		};

		config-6 {
			/* DT+SoM+board model */
			description = "dh,stm32mp157c-dhcom-picoitx_somrev1_boardrev0";
			loadables = "uboot";
			fdt = "fdt-3";
		};

		/* Add 587-100..587-400 with fdt-2..fdt-4 here */
	};
};
```

## board/dhelectronics/dh_stm32mp1/u-boot-dhcor.its
```
/dts-v1/;

/ {
	description = "U-Boot mainline";
	#address-cells = <1>;

	images {
		uboot {
			description = "U-Boot (32-bit)";
			data = /incbin/("u-boot-nodtb.bin");
			type = "standalone";
			os = "U-Boot";
			arch = "arm";
			compression = "none";
			load = <0xc0100000>;
			entry = <0xc0100000>;
		};

		fdt-1 {
			description = ".dtb";
			data = /incbin/("dts/upstream/src/arm/st/stm32mp151a-dhcor-testbench.dtb");
			type = "flat_dt";
			arch = "arm";
			compression = "none";
		};

		fdt-2 {
			description = ".dtb";
			data = /incbin/("dts/upstream/src/arm/st/stm32mp157a-dhcor-avenger96.dtb");
			type = "flat_dt";
			arch = "arm";
			compression = "none";
		};

		fdt-3 {
			description = ".dtb";
			data = /incbin/("dts/upstream/src/arm/st/stm32mp153c-dhcor-drc-compact.dtb");
			type = "flat_dt";
			arch = "arm";
			compression = "none";
		};
	};

	configurations {
		default = "config-1";

		config-1 {
			/* DT+SoM+board model */
			description = "dh,stm32mp151a-dhcor-testbench_somrev0_boardrev1";
			firmware = "uboot";
			fdt = "fdt-1";
		};

		config-2 {
			/* DT+SoM+board model */
			description = "arrow,stm32mp157a-avenger96_somrev0_boardrev1";
			firmware = "uboot";
			fdt = "fdt-2";
		};

		config-3 {
			/* DT+SoM+board model */
			description = "dh,stm32mp153c-dhcor-drc-compact_somrev0_boardrev0";
			firmware = "uboot";
			fdt = "fdt-3";
		};

		/* Add 586-200..586-400 with fdt-2..fdt-4 here */
	};
};
```

## board/dnp5370/Kconfig
```kconfig
if TARGET_DNP5370

config SYS_BOARD
	default "dnp5370"

config SYS_CONFIG_NAME
	default "dnp5370"

endif
```

## board/eXalion/Kconfig
```kconfig
if TARGET_EXALION

config SYS_BOARD
	default "eXalion"

config SYS_CONFIG_NAME
	default "eXalion"

endif
```

## board/ea/mx7ulp_com/Kconfig
```kconfig
if TARGET_MX7ULP_COM

config SYS_BOARD
	default "mx7ulp_com"

config SYS_VENDOR
	default "ea"

config SYS_CONFIG_NAME
	default "mx7ulp_com"

endif
```

## board/earthlcd/favr-32-ezkit/Kconfig
```kconfig
if TARGET_FAVR_32_EZKIT

config SYS_BOARD
	default "favr-32-ezkit"

config SYS_VENDOR
	default "earthlcd"

config SYS_SOC
	default "at32ap700x"

config SYS_CONFIG_NAME
	default "favr-32-ezkit"

endif
```

## board/eets/pdu001/Kconfig
```kconfig
# Copyright (C) 2018 EETS GmbH - http://www.eets.ch/
#
# SPDX-License-Identifier: GPL-2.0+
#

if TARGET_PDU001

config SYS_BOARD
	default "pdu001"

config SYS_VENDOR
	default "eets"

config SYS_SOC
	default "am33xx"

config SYS_CONFIG_NAME
	default "pdu001"

config CONS_INDEX
	int "UART used for console"
	range 1 6
	default 4
	help
	  The AM335x SoC has a total of 6 UARTs (UART0 to UART5 as referenced
	  in documentation, etc) available to it.  The best choice for the
	  PDU001 is UART3 as it is wired to the header K2; enter 4 here to
	  use UART3. UART0 is connected to the EIA-485 transceiver. If you
	  really need to use it, you are advised to remove the transceiver U14
	  from the board. UART1 is wired to the backplane and therefore
	  accessible from there or by the backplane connector K1 of the PDU.
	  Any other UART then UART3 (enter 4 here), UART1 (enter 2 here) or
	  UART0 (enter 1 here) are not sensible since they are not wired to
	  any connector and therefore difficult to access.

choice
	prompt "State of Run LED"
	default PDU001_RUN_LED_RED
	help
	  The PDU001 has a bi-color (red/green) LED labeled 'Run' which
	  can be used to indicate the operating state of the board. By
	  default it will be lit red by U-Boot. Later in the start-up
	  process it can be changed to green (or heartbeat or anything else)
	  by the kernel or some other software.

config RUN_LED_RED
	bool
	prompt "Red"
	help
	  Lit Run LED red.

config RUN_LED_GREEN
	bool
	prompt "Green"
	help
	  Lit Run LED green.

config RUN_LED_OFF
	bool
	prompt "Off"
	help
	  Do not lit Run LED.

endchoice

endif
```

## board/efi/Kconfig
```kconfig
if VENDOR_EFI

choice
	prompt "Mainboard model"
	optional

config TARGET_EFI
	bool "efi"
	help
	  This target is used for running U-Boot on top of EFI. In
	  this case EFI does the early initialisation, and U-Boot
	  takes over once the RAM, video and CPU are fully running.
	  U-Boot is loaded as an application from EFI.

endchoice

source "board/efi/efi-x86/Kconfig"

endif
```

## board/efi/efi-x86/Kconfig
```kconfig
if TARGET_EFI

config SYS_BOARD
	default "efi-x86"

config SYS_VENDOR
	default "efi"

config SYS_SOC
	default "efi"

config SYS_CONFIG_NAME
	default "efi-x86"

endif
```

## board/efi/efi-x86_app/Kconfig
```kconfig
if EFI_APP

config SYS_BOARD
	default "efi-x86_app"

config SYS_VENDOR
	default "efi"

config SYS_SOC
	default "efi"

config BOARD_SPECIFIC_OPTIONS # dummy
	def_bool y
	imply VIDEO_EFI

endif
```

## board/egnite/ethernut5/Kconfig
```kconfig
if TARGET_ETHERNUT5

config SYS_CPU
	default "arm926ejs"

config SYS_BOARD
	default "ethernut5"

config SYS_VENDOR
	default "egnite"

config SYS_SOC
	default "at91"

config SYS_CONFIG_NAME
	default "ethernut5"

endif
```

## board/elgin/elgin_rv1108/Kconfig
```kconfig
if TARGET_ELGIN_RV1108

config SYS_BOARD
	default "elgin_rv1108"

config SYS_VENDOR
	default "elgin"

config SYS_CONFIG_NAME
	default "elgin_rv1108"

endif
```

## board/eltec/elppc/Kconfig
```kconfig
if TARGET_ELPPC

config SYS_BOARD
	default "elppc"

config SYS_VENDOR
	default "eltec"

config SYS_CONFIG_NAME
	default "ELPPC"

endif
```
