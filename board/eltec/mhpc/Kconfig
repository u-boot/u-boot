## board/eltec/mhpc/Kconfig
```kconfig
if TARGET_MHPC

config SYS_BOARD
	default "mhpc"

config SYS_VENDOR
	default "eltec"

config SYS_CONFIG_NAME
	default "MHPC"

endif
```

## board/embest/mx6boards/Kconfig
```kconfig
if TARGET_EMBESTMX6BOARDS

config SYS_CPU
	string
	default "armv7"

config SYS_BOARD
	string
	default "mx6boards"

config SYS_VENDOR
	string
	default "embest"

config SYS_SOC
	string
	default "mx6"

config SYS_CONFIG_NAME
	string
	default "embestmx6boards"

endif
```

## board/emcraft/imx8mp_navqp/Kconfig
```kconfig
if TARGET_IMX8MP_NAVQP

config SYS_BOARD
	default "imx8mp_navqp"

config SYS_VENDOR
	default "emcraft"

config SYS_CONFIG_NAME
	default "imx8mp_navqp"

config IMX_CONFIG
	default "board/emcraft/imx8mp_navqp/imximage-8mp-lpddr4.cfg"

endif
```

## board/emk/top5200/Kconfig
```kconfig
if TARGET_TOP5200

config SYS_BOARD
	default "top5200"

config SYS_VENDOR
	default "emk"

config SYS_CONFIG_NAME
	default "TOP5200"

endif
```

## board/emk/top860/Kconfig
```kconfig
if TARGET_TOP860

config SYS_BOARD
	default "top860"

config SYS_VENDOR
	default "emk"

config SYS_CONFIG_NAME
	default "TOP860"

endif
```

## board/emk/top9000/Kconfig
```kconfig
if TARGET_TOP9000

config SYS_CPU
	default "arm926ejs"

config SYS_BOARD
	default "top9000"

config SYS_VENDOR
	default "emk"

config SYS_SOC
	default "at91"

config SYS_CONFIG_NAME
	default "top9000"

endif
```

## board/emulation/Kconfig
```kconfig
#
# Copyright (C) 2015, Bin Meng <bmeng.cn@gmail.com>
#
# SPDX-License-Identifier:	GPL-2.0+
#

if VENDOR_EMULATION

choice
	prompt "Mainboard model"

config TARGET_QEMU_X86
	bool "QEMU x86"
	help
	  This is the QEMU emulated x86 board. U-Boot supports running
	  as a coreboot payload as well as bare boot without coreboot.
	  There are two types of x86 boards supported by QEMU which are
	  supported by U-Boot. They are via QEMU '-M pc', an i440FX/PIIX
	  chipset platform and '-M q35', a Q35/ICH9 chipset platform.

endchoice

source "board/emulation/qemu-x86/Kconfig"

endif
```

## board/emulation/qemu-arm/Kconfig
```kconfig
if TARGET_QEMU_ARM_32BIT || TARGET_QEMU_ARM_64BIT

config TEXT_BASE
	default 0x00000000

config BOARD_SPECIFIC_OPTIONS # dummy
	def_bool y
	select CMD_QFW
	select QFW_MMIO
	imply VIRTIO_MMIO
	imply VIRTIO_PCI
	imply VIRTIO_NET
	imply VIRTIO_BLK

endif

if TARGET_QEMU_ARM_64BIT && !TFABOOT
config BOARD_SPECIFIC_OPTIONS
	imply SYS_MTDPARTS_RUNTIME
	imply SET_DFU_ALT_INFO

source "board/emulation/common/Kconfig"
endif
```

## board/emulation/qemu-loongarch/Kconfig
```kconfig
if TARGET_QEMU_LOONGARCH_VIRT

config SYS_BOARD
	default "qemu-loongarch"

config SYS_VENDOR
	default "emulation"

config SYS_CPU
	default "generic"

config SYS_CONFIG_NAME
	default "qemu-loongarch"

config TEXT_BASE
	default 0x1c000000

config BOARD_SPECIFIC_OPTIONS # dummy
	def_bool y
	select GENERIC_LOONGARCH
	imply AHCI
	imply BOARD_LATE_INIT
	imply PCI_INIT_R
	imply CMD_PCI
	imply CMD_POWEROFF
	imply CMD_SCSI
	imply CMD_PING
	imply CMD_EXT2
	imply CMD_EXT4
	imply CMD_FAT
	imply CMD_FS_GENERIC
	imply DOS_PARTITION
	imply ISO_PARTITION
	imply EFI_PARTITION
	imply SCSI_AHCI
	imply AHCI_PCI
	imply E1000
	imply PCI
	imply NVME_PCI
	imply PCIE_ECAM_GENERIC
	imply DM_RNG
	imply DM_RTC
	imply QFW
	imply QFW_MMIO
	imply SCSI
	imply SYS_NS16550
	imply SYSRESET
	imply SYSRESET_CMD_POWEROFF
	imply SYSRESET_SYSCON
	imply VIRTIO_MMIO
	imply VIRTIO_PCI
	imply VIRTIO_NET
	imply VIRTIO_BLK
	imply MTD_NOR_FLASH
	imply CFI_FLASH
	imply OF_HAS_PRIOR_STAGE
	imply VIDEO
	imply VIDEO_BOCHS
	imply SYS_WHITE_ON_BLACK
	imply USB
	imply USB_XHCI_HCD
	imply USB_XHCI_PCI
	imply USB_KEYBOARD
	imply CMD_USB
	imply UFS
	imply UFS_PCI

endif
```

## board/emulation/qemu-m68k/Kconfig
```kconfig
if TARGET_QEMU_M68K

config SYS_BOARD
	default "qemu-m68k"

config SYS_VENDOR
	default "emulation"

config SYS_CONFIG_NAME
	default "qemu-m68k"

endif
```

## board/emulation/qemu-riscv/Kconfig
```kconfig
if TARGET_QEMU_VIRT

config SYS_BOARD
	default "qemu-riscv"

config SYS_VENDOR
	default "emulation"

config SYS_CPU
	default "generic"

config SYS_CONFIG_NAME
	default "qemu-riscv"

config TEXT_BASE
	default 0x81200000 if SPL
	default 0x80000000 if !RISCV_SMODE
	default 0x80200000 if RISCV_SMODE && ARCH_RV64I
	default 0x80400000 if RISCV_SMODE && ARCH_RV32I

config SPL_TEXT_BASE
	default 0x80000000

config SPL_OPENSBI_LOAD_ADDR
	hex
	default 0x80100000

config BOARD_SPECIFIC_OPTIONS # dummy
	def_bool y
	select GENERIC_RISCV
	select SUPPORT_SPL
	imply AHCI
	imply SMP
	imply BOARD_LATE_INIT
	imply PCI_INIT_R
	imply SPL_RAM_SUPPORT
	imply SPL_RAM_DEVICE
	imply CMD_PCI
	imply CMD_POWEROFF
	imply CMD_SBI
	imply CMD_SCSI
	imply CMD_PING
	imply CMD_EXT2
	imply CMD_EXT4
	imply CMD_FAT
	imply CMD_FS_GENERIC
	imply DOS_PARTITION
	imply ISO_PARTITION
	imply EFI_PARTITION
	imply SCSI_AHCI
	imply AHCI_PCI
	imply E1000
	imply NVME
	imply PCI
	imply PCIE_ECAM_GENERIC
	imply SCSI
	imply DM_SCSI
	imply SYS_NS16550
	imply SIFIVE_SERIAL
	imply HTIF_CONSOLE if 64BIT
	imply SYSRESET
	imply SYSRESET_CMD_POWEROFF
	imply SYSRESET_SYSCON
	imply VIRTIO_MMIO
	imply VIRTIO_PCI
	imply VIRTIO_NET
	imply VIRTIO_BLK
	imply MTD_NOR_FLASH
	imply CFI_FLASH
	imply OF_HAS_PRIOR_STAGE

endif
```

## board/emulation/qemu-sbsa/Kconfig
```kconfig
if TARGET_QEMU_ARM_SBSA

config SYS_SOC
	default "qemu-sbsa"

config TEXT_BASE
	default 0x10000100000

config SYS_LOAD_ADDR
	default 0x10000100000

config PRE_CON_BUF_ADDR
	default 0x100000FF000

config DEFAULT_DEVICE_TREE
	default "qemu-sbsa"

config BOARD_SPECIFIC_OPTIONS # dummy
	def_bool y
	select AHCI
	select ACPIGEN
	select ACPI
	select BLOBLIST
	select CPU
	select CPU_ARMV8
	select DM
	select DM_USB
	select DM_MTD
	select GENERATE_ACPI_TABLE
	select HAS_ROM
	select MTD
	select OF_LIBFDT_OVERLAY
	select PCI
	select PCIE_ECAM_GENERIC
	select SYS_PCI_64BIT
	select USB
	select GIC_V3
	select GIC_V3_ITS
	select SYS_FLASH_CFI_WIDTH_16BIT
	imply AHCI_GENERIC
	imply USB_XHCI_HCD
	imply USB_XHCI_GENERIC
	imply USB_STORAGE
	imply E1000
	imply E1000_NO_NVM
	imply NET_RANDOM_ETHADDR
	imply VIDEO_BOCHS
	imply CFI_FLASH
	imply SYS_MTDPARTS_RUNTIME
	imply SET_DFU_ALT_INFO
	imply PCI_INIT_R

if DEBUG_UART

config DEBUG_UART_BASE
	default 0x60000000
endif

source "board/emulation/common/Kconfig"
endif
```

## board/emulation/qemu-x86/Kconfig
```kconfig
if TARGET_QEMU_X86 || TARGET_QEMU_X86_64

config SYS_BOARD
	default "qemu-x86"

config SYS_VENDOR
	default "emulation"

config SYS_SOC
	default "qemu"

config TEXT_BASE
	default 0xfff00000 if !SUPPORT_SPL
	default 0x01110000 if SUPPORT_SPL

config BOARD_SPECIFIC_OPTIONS # dummy
	def_bool y
	select X86_RESET_VECTOR
	select QEMU
	select QFW_PIO if CMD_QFW
	select BOARD_ROMSIZE_KB_1024 if TARGET_QEMU_X86
	select BOARD_ROMSIZE_KB_2048 if TARGET_QEMU_X86_64
	imply VIRTIO_PCI
	imply VIRTIO_NET
	imply VIRTIO_BLK
	imply CMD_SMBIOS

endif
```

## board/emulation/qemu-xtensa/Kconfig
```kconfig
if TARGET_QEMU_XTENSA

config SYS_BOARD
	default "qemu-xtensa"

config SYS_VENDOR
	default "emulation"

config SYS_CONFIG_NAME
	default "qemu-xtensa"

config TEXT_BASE
	default 0x50000000 if (SYS_CPU = de212)
	default 0xfe000000

config BOARD_SPECIFIC_OPTIONS # dummy
	def_bool y
	select BOARD_EARLY_INIT_F
	select DM
	select CPU
	select CPU_XTENSA
	select CLK
	select DM_SERIAL
	select XTENSA_SEMIHOSTING
	select XTENSA_SEMIHOSTING_SERIAL
	imply BLK
	imply VIRTIO
	imply VIRTIO_PCI
	imply VIRTIO_NET
	imply VIRTIO_BLK
	imply E1000
	imply PCI
	imply PCI_INIT_R
	imply NVME_PCI
	imply PCIE_ECAM_GENERIC
	imply SCSI
	imply REMAKE_ELF
	select OF_CONTROL
	select OF_UPSTREAM
	imply CMD_DM
	imply CMD_PCI

endif
```

## board/enbw/enbw_cmc/Kconfig
```kconfig
if TARGET_ENBW_CMC

config SYS_BOARD
	default "enbw_cmc"

config SYS_VENDOR
	default "enbw"

config SYS_CONFIG_NAME
	default "enbw_cmc"

endif
```

## board/engicam/geam6ul/Kconfig
```kconfig
if TARGET_MX6UL_GEAM

config SYS_BOARD
	default "geam6ul"

config SYS_VENDOR
	default "engicam"

config SYS_CONFIG_NAME
	default "imx6-engicam"

endif
```

## board/engicam/icorem6/Kconfig
```kconfig
if TARGET_MX6Q_ICORE

config SYS_BOARD
	default "icorem6"

config SYS_VENDOR
	default "engicam"

config SYS_CONFIG_NAME
	default "imx6qdl_icore"

endif
```

## board/engicam/icorem6_rqs/Kconfig
```kconfig
if TARGET_MX6Q_ICORE_RQS

config SYS_BOARD
	default "icorem6_rqs"

config SYS_VENDOR
	default "engicam"

config SYS_CONFIG_NAME
	default "imx6qdl_icore_rqs"

endif
```

## board/engicam/imx8mm/Kconfig
```kconfig
if TARGET_IMX8MM_ICORE_MX8MM

config SYS_BOARD
	default "imx8mm"

config SYS_VENDOR
	default "engicam"

config SYS_CONFIG_NAME
	default "imx8mm_icore_mx8mm"

source "board/freescale/common/Kconfig"

endif
```

## board/engicam/isiotmx6ul/Kconfig
```kconfig
if TARGET_MX6UL_ISIOT

config SYS_BOARD
	default "isiotmx6ul"

config SYS_VENDOR
	default "engicam"

config SYS_CONFIG_NAME
	default "imx6ul_isiot"

endif
```

## board/ep8260/Kconfig
```kconfig
if TARGET_EP8260

config SYS_BOARD
	default "ep8260"

config SYS_CONFIG_NAME
	default "ep8260"

endif
```

## board/ep82xxm/Kconfig
```kconfig
if TARGET_EP82XXM

config SYS_BOARD
	default "ep82xxm"

config SYS_CONFIG_NAME
	default "ep82xxm"

endif
```

## board/esd/apc405/Kconfig
```kconfig
if TARGET_APC405

config SYS_BOARD
	default "apc405"

config SYS_VENDOR
	default "esd"

config SYS_CONFIG_NAME
	default "APC405"

endif
```

## board/esd/ar405/Kconfig
```kconfig
if TARGET_AR405

config SYS_BOARD
	default "ar405"

config SYS_VENDOR
	default "esd"

config SYS_CONFIG_NAME
	default "AR405"

endif
```

## board/esd/ash405/Kconfig
```kconfig
if TARGET_ASH405

config SYS_BOARD
	default "ash405"

config SYS_VENDOR
	default "esd"

config SYS_CONFIG_NAME
	default "ASH405"

endif
```
