## board/esd/cms700/Kconfig
```kconfig
if TARGET_CMS700

config SYS_BOARD
	default "cms700"

config SYS_VENDOR
	default "esd"

config SYS_CONFIG_NAME
	default "CMS700"

endif
```

## board/esd/cpci2dp/Kconfig
```kconfig
if TARGET_CPCI2DP

config SYS_BOARD
	default "cpci2dp"

config SYS_VENDOR
	default "esd"

config SYS_CONFIG_NAME
	default "CPCI2DP"

endif
```

## board/esd/cpci405/Kconfig
```kconfig
if TARGET_CPCI4052

config SYS_BOARD
	default "cpci405"

config SYS_VENDOR
	default "esd"

config SYS_CONFIG_NAME
	default "CPCI4052"

endif
```

## board/esd/cpci5200/Kconfig
```kconfig
if TARGET_CPCI5200

config SYS_BOARD
	default "cpci5200"

config SYS_VENDOR
	default "esd"

config SYS_CONFIG_NAME
	default "cpci5200"

endif
```

## board/esd/cpci750/Kconfig
```kconfig
if TARGET_CPCI750

config SYS_BOARD
	default "cpci750"

config SYS_VENDOR
	default "esd"

config SYS_CONFIG_NAME
	default "CPCI750"

endif
```

## board/esd/cpciiser4/Kconfig
```kconfig
if TARGET_CPCIISER4

config SYS_BOARD
	default "cpciiser4"

config SYS_VENDOR
	default "esd"

config SYS_CONFIG_NAME
	default "CPCIISER4"

endif
```

## board/esd/dp405/Kconfig
```kconfig
if TARGET_DP405

config SYS_BOARD
	default "dp405"

config SYS_VENDOR
	default "esd"

config SYS_CONFIG_NAME
	default "DP405"

endif
```

## board/esd/du405/Kconfig
```kconfig
if TARGET_DU405

config SYS_BOARD
	default "du405"

config SYS_VENDOR
	default "esd"

config SYS_CONFIG_NAME
	default "DU405"

endif
```

## board/esd/du440/Kconfig
```kconfig
if TARGET_DU440

config SYS_BOARD
	default "du440"

config SYS_VENDOR
	default "esd"

config SYS_CONFIG_NAME
	default "DU440"

endif
```

## board/esd/hh405/Kconfig
```kconfig
if TARGET_HH405

config SYS_BOARD
	default "hh405"

config SYS_VENDOR
	default "esd"

config SYS_CONFIG_NAME
	default "HH405"

endif
```

## board/esd/hub405/Kconfig
```kconfig
if TARGET_HUB405

config SYS_BOARD
	default "hub405"

config SYS_VENDOR
	default "esd"

config SYS_CONFIG_NAME
	default "HUB405"

endif
```

## board/esd/mecp5123/Kconfig
```kconfig
if TARGET_MECP5123

config SYS_BOARD
	default "mecp5123"

config SYS_VENDOR
	default "esd"

config SYS_CONFIG_NAME
	default "mecp5123"

endif
```

## board/esd/mecp5200/Kconfig
```kconfig
if TARGET_MECP5200

config SYS_BOARD
	default "mecp5200"

config SYS_VENDOR
	default "esd"

config SYS_CONFIG_NAME
	default "mecp5200"

endif
```

## board/esd/meesc/Kconfig
```kconfig
if TARGET_MEESC

config SYS_CPU
	string
	default "arm926ejs"

config SYS_BOARD
	string
	default "meesc"

config SYS_VENDOR
	string
	default "esd"

config SYS_SOC
	string
	default "at91"

config SYS_CONFIG_NAME
	string
	default "meesc"

endif
```

## board/esd/ocrtc/Kconfig
```kconfig
if TARGET_OCRTC

config SYS_BOARD
	default "ocrtc"

config SYS_VENDOR
	default "esd"

config SYS_CONFIG_NAME
	default "OCRTC"

endif
```

## board/esd/otc570/Kconfig
```kconfig
if TARGET_OTC570

config SYS_BOARD
	default "otc570"

config SYS_VENDOR
	default "esd"

config SYS_CONFIG_NAME
	default "otc570"

endif
```

## board/esd/pci405/Kconfig
```kconfig
if TARGET_PCI405

config SYS_BOARD
	default "pci405"

config SYS_VENDOR
	default "esd"

config SYS_CONFIG_NAME
	default "PCI405"

endif
```

## board/esd/pf5200/Kconfig
```kconfig
if TARGET_PF5200

config SYS_BOARD
	default "pf5200"

config SYS_VENDOR
	default "esd"

config SYS_CONFIG_NAME
	default "pf5200"

endif
```

## board/esd/plu405/Kconfig
```kconfig
if TARGET_PLU405

config SYS_BOARD
	default "plu405"

config SYS_VENDOR
	default "esd"

config SYS_CONFIG_NAME
	default "PLU405"

endif
```

## board/esd/pmc405/Kconfig
```kconfig
if TARGET_PMC405

config SYS_BOARD
	default "pmc405"

config SYS_VENDOR
	default "esd"

config SYS_CONFIG_NAME
	default "PMC405"

endif
```

## board/esd/pmc405de/Kconfig
```kconfig
if TARGET_PMC405DE

config SYS_BOARD
	default "pmc405de"

config SYS_VENDOR
	default "esd"

config SYS_CONFIG_NAME
	default "PMC405DE"

endif
```

## board/esd/pmc440/Kconfig
```kconfig
if TARGET_PMC440

config SYS_BOARD
	default "pmc440"

config SYS_VENDOR
	default "esd"

config SYS_CONFIG_NAME
	default "PMC440"

endif
```

## board/esd/tasreg/Kconfig
```kconfig
if TARGET_TASREG

config SYS_CPU
	default "mcf52x2"

config SYS_BOARD
	default "tasreg"

config SYS_VENDOR
	default "esd"

config SYS_CONFIG_NAME
	default "TASREG"

endif
```

## board/esd/vme8349/Kconfig
```kconfig
if TARGET_VME8349

config SYS_BOARD
	string
	default "vme8349"

config SYS_VENDOR
	string
	default "esd"

config SYS_CONFIG_NAME
	string
	default "vme8349"

endif
```

## board/esd/voh405/Kconfig
```kconfig
if TARGET_VOH405

config SYS_BOARD
	default "voh405"

config SYS_VENDOR
	default "esd"

config SYS_CONFIG_NAME
	default "VOH405"

endif
```
