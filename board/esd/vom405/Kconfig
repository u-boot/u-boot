## board/esd/vom405/Kconfig
```kconfig
if TARGET_VOM405

config SYS_BOARD
	default "vom405"

config SYS_VENDOR
	default "esd"

config SYS_CONFIG_NAME
	default "VOM405"

endif
```

## board/esd/wuh405/Kconfig
```kconfig
if TARGET_WUH405

config SYS_BOARD
	default "wuh405"

config SYS_VENDOR
	default "esd"

config SYS_CONFIG_NAME
	default "WUH405"

endif
```

## board/esg/ima3-mx53/Kconfig
```kconfig
if TARGET_IMA3_MX53

config SYS_BOARD
	default "ima3-mx53"

config SYS_VENDOR
	default "esg"

config SYS_SOC
	default "mx5"

config SYS_CONFIG_NAME
	default "ima3-mx53"

endif
```

## board/espt/Kconfig
```kconfig
if TARGET_ESPT

config SYS_BOARD
	default "espt"

config SYS_CONFIG_NAME
	default "espt"

endif
```

## board/esteem192e/Kconfig
```kconfig
if TARGET_ESTEEM192E

config SYS_BOARD
	default "esteem192e"

config SYS_CONFIG_NAME
	default "ESTEEM192E"

endif
```

## board/eukrea/cpu9260/Kconfig
```kconfig
if TARGET_CPU9260

config SYS_BOARD
	default "cpu9260"

config SYS_VENDOR
	default "eukrea"

config SYS_CONFIG_NAME
	default "cpu9260"

endif
```

## board/eukrea/cpuat91/Kconfig
```kconfig
if TARGET_CPUAT91

config SYS_CPU
	default "arm920t"

config SYS_BOARD
	default "cpuat91"

config SYS_VENDOR
	default "eukrea"

config SYS_SOC
	default "at91"

config SYS_CONFIG_NAME
	default "cpuat91"

endif
```

## board/evb64260/Kconfig
```kconfig
if TARGET_P3G4

config SYS_BOARD
	default "evb64260"

config SYS_CONFIG_NAME
	default "P3G4"

endif

if TARGET_ZUMA

config SYS_BOARD
	default "evb64260"

config SYS_CONFIG_NAME
	default "ZUMA"

endif
```

## board/exmeritus/hww1u1a/Kconfig
```kconfig
if TARGET_HWW1U1A

config SYS_BOARD
	default "hww1u1a"

config SYS_VENDOR
	default "exmeritus"

config SYS_CONFIG_NAME
	default "HWW1U1A"

endif
```

## board/faraday/a320evb/Kconfig
```kconfig
if TARGET_A320EVB

config SYS_BOARD
	default "a320evb"

config SYS_VENDOR
	default "faraday"

config SYS_SOC
	default "a320"

config SYS_CONFIG_NAME
	default "a320evb"

endif
```

## board/firefly/firefly-rk3288/Kconfig
```kconfig
if TARGET_FIREFLY_RK3288

config SYS_BOARD
	default "firefly-rk3288"

config SYS_VENDOR
	default "firefly"

config SYS_CONFIG_NAME
	default "firefly-rk3288"

endif
```

## board/firefly/roc-pc-rk3576/Kconfig
```kconfig
if TARGET_ROC_PC_RK3576

config SYS_BOARD
	default "roc-pc-rk3576"

config SYS_VENDOR
	default "firefly"

config SYS_CONFIG_NAME
	default "roc-pc-rk3576"

endif
```

## board/flagadm/Kconfig
```kconfig
if TARGET_FLAGADM

config SYS_BOARD
	string
	default "flagadm"

config SYS_CONFIG_NAME
	string
	default "FLAGADM"

endif
```

## board/freebox/nbx10g/Kconfig
```kconfig
if TARGET_NBX10G

config SYS_BOARD
	default "nbx10g"

config SYS_VENDOR
	default "freebox"

config SYS_CONFIG_NAME
	default "nbx10g"

config CMD_NBX_EMMCBOOT
	bool "emmcboot command"
	depends on MMC_SDHCI_XENON
	help
	  Enable the emmcboot command for dual-bank boot from eMMC.
	  This is a legacy boot format used on this board for many years.
	  It implements a boot system with two image banks and automatic
	  fallback on boot failures. The boot order depends on a reboot
	  tracking counter (nrboot):
	  - If healthy: try Bank1 (newer) first, then Bank0 (stable)
	  - If degraded (>= 4 failures): try Bank0 first, then Bank1

	  Requires image_addr and fdt_addr environment variables to be set.

if CMD_NBX_EMMCBOOT

config NBX_MMC_PART_NRBOOT_OFFSET
	hex "NRBoot counter offset in eMMC"
	default 0x802000
	help
	  Byte offset in eMMC where the reboot tracking counter is stored.
	  Default: 0x802000 (8MB + 8KB)

config NBX_MMC_PART_BANK0_OFFSET
	hex "Bank0 image offset in eMMC"
	default 0x804000
	help
	  Byte offset in eMMC where the stable (Bank0) boot image starts.
	  Default: 0x804000 (8MB + 16KB)

config NBX_MMC_PART_BANK0_SIZE
	hex "Bank0 image maximum size"
	default 0x10000000
	help
	  Maximum size of the Bank0 boot image.
	  Default: 0x10000000 (256MB)

config NBX_MMC_PART_BANK1_OFFSET
	hex "Bank1 image offset in eMMC"
	default 0x10804000
	help
	  Byte offset in eMMC where the newer (Bank1) boot image starts.
	  Default: 0x10804000 (264MB + 16KB)

config NBX_MMC_PART_BANK1_SIZE
	hex "Bank1 image maximum size"
	default 0x10000000
	help
	  Maximum size of the Bank1 boot image.
	  Default: 0x10000000 (256MB)

endif

config CMD_NBX_FBXSERIAL
	bool "fbxserial command"
	depends on MMC_SDHCI_XENON
	help
	  Enable the fbxserial command to read and display device
	  serial information from eMMC. This includes:
	  - Device serial number (type, version, manufacturer, date, number)
	  - MAC address (used to set ethaddr environment variables)
	  - Bundle information (if present)

	  The serial info is stored at a fixed offset in the eMMC user area.

	  Subcommands:
	  - fbxserial show: display serial info (default)
	  - fbxserial init: initialize ethaddr from serial info

	  Use CONFIG_PREBOOT="fbxserial init" to auto-initialize at boot.

if CMD_NBX_FBXSERIAL

config NBX_MMC_PART_SERIAL_OFFSET
	hex "Serial info offset in eMMC"
	default 0x800000
	help
	  Byte offset in eMMC where the serial info structure is stored.
	  Default: 0x800000 (8MB)

endif

endif
```

## board/freescale/b4860qds/Kconfig
```kconfig
if TARGET_B4860QDS

config SYS_BOARD
	string
	default "b4860qds"

config SYS_VENDOR
	string
	default "freescale"

config SYS_CONFIG_NAME
	string
	default "B4860QDS"

endif
```

## board/freescale/bsc9131rdb/Kconfig
```kconfig
if TARGET_BSC9131RDB

config SYS_BOARD
	string
	default "bsc9131rdb"

config SYS_VENDOR
	string
	default "freescale"

config SYS_CONFIG_NAME
	string
	default "BSC9131RDB"

endif
```

## board/freescale/bsc9132qds/Kconfig
```kconfig
if TARGET_BSC9132QDS

config SYS_BOARD
	string
	default "bsc9132qds"

config SYS_VENDOR
	string
	default "freescale"

config SYS_CONFIG_NAME
	string
	default "BSC9132QDS"

endif
```

## board/freescale/c29xpcie/Kconfig
```kconfig
if TARGET_C29XPCIE

config SYS_BOARD
	string
	default "c29xpcie"

config SYS_VENDOR
	string
	default "freescale"

config SYS_CONFIG_NAME
	string
	default "C29XPCIE"

endif
```

## board/freescale/common/Kconfig
```kconfig
config CHAIN_OF_TRUST
	depends on !FIT_SIGNATURE && NXP_ESBC
	imply CMD_BLOB
	imply CMD_HASH if ARM
	select FSL_CAAM
	select ARCH_MISC_INIT
	select SPL_BOARD_INIT if (ARM && SPL)
	select SPL_HASH if (ARM && SPL)
	select SHA_HW_ACCEL
	select SHA_PROG_HW_ACCEL
	select ENV_IS_NOWHERE
	select CMD_EXT4 if ARM
	select CMD_EXT4_WRITE if ARM
	bool
	default y

config CMD_ESBC_VALIDATE
	bool "Enable the 'esbc_validate' and 'esbc_halt' commands"
	default y if CHAIN_OF_TRUST
	help
	  This option enables two commands used for secure booting:

	    esbc_validate - validate signature using RSA verification
	    esbc_halt - put the core in spin loop (Secure Boot Only)

config DEEP_SLEEP
	bool "Enable SoC deep sleep feature"
	default y if ARCH_T1024 || ARCH_T1040 || ARCH_T1042 || ARCH_LS1021A
	help
	  Indicates this SoC supports deep sleep feature. If deep sleep is
	  supported, core will start to execute uboot when wakes up.

config FSL_USE_PCA9547_MUX
	bool "Enable PCA9547 I2C Mux on Freescale boards"
	help
	 This option enables the PCA9547 I2C mux on Freescale boards.

config VID
	bool "Enable Freescale VID"
	depends on I2C || DM_I2C
	help
	 This option enables setting core voltage based on individual
	 values saved in SoC fuses.

config SPL_VID
	bool "Enable Freescale VID in SPL"
	depends on I2C || DM_I2C
	help
	 This option enables setting core voltage based on individual
	 values saved in SoC fuses, in SPL.

if VID || SPL_VID

config VID_FLS_ENV
	string "Environment variable for overriding VDD"
	help
	  This option allows for specifying the environment variable
	  to check to override VDD information.

config VOL_MONITOR_INA220
	bool "Enable the INA220 voltage monitor read"
	help
	  This option enables INA220 voltage monitor read
	  functionality. It is used by the common VID driver.

config VOL_MONITOR_IR36021_READ
	bool "Enable the IR36021 voltage monitor read"
	help
	 This option enables IR36021 voltage monitor read
	 functionality. It is used by the common VID driver.

config VOL_MONITOR_IR36021_SET
	bool "Enable the IR36021 voltage monitor set"
	help
	 This option enables IR36021 voltage monitor set
	 functionality. It is used by the common VID driver.

config VOL_MONITOR_LTC3882_READ
	bool "Enable the LTC3882 voltage monitor read"
	help
	 This option enables LTC3882 voltage monitor read
	 functionality. It is used by the common VID driver.

config VOL_MONITOR_LTC3882_SET
	bool "Enable the LTC3882 voltage monitor set"
	help
	 This option enables LTC3882 voltage monitor set
	 functionality. It is used by the common VID driver.

config VOL_MONITOR_ISL68233_READ
	bool "Enable the ISL68233 voltage monitor read"
	help
	 This option enables ISL68233 voltage monitor read
	 functionality. It is used by the common VID driver.

config VOL_MONITOR_ISL68233_SET
	bool "Enable the ISL68233 voltage monitor set"
	help
	 This option enables ISL68233 voltage monitor set
	 functionality. It is used by the common VID driver.

endif

config FSL_QIXIS
	bool "Enable QIXIS support"

config QIXIS_I2C_ACCESS
	bool "Access to QIXIS is over i2c"
	depends on FSL_QIXIS
	default y
```

## board/freescale/corenet_ds/Kconfig
```kconfig
if TARGET_P3041DS

config SYS_BOARD
	string
	default "corenet_ds"

config SYS_VENDOR
	string
	default "freescale"

config SYS_CONFIG_NAME
	string
	default "P3041DS"

endif

if TARGET_P4080DS

config SYS_BOARD
	string
	default "corenet_ds"

config SYS_VENDOR
	string
	default "freescale"

config SYS_CONFIG_NAME
	string
	default "P4080DS"

endif

if TARGET_P5020DS

config SYS_BOARD
	string
	default "corenet_ds"

config SYS_VENDOR
	string
	default "freescale"

config SYS_CONFIG_NAME
	string
	default "P5020DS"

endif

if TARGET_P5040DS

config SYS_BOARD
	string
	default "corenet_ds"

config SYS_VENDOR
	string
	default "freescale"

config SYS_CONFIG_NAME
	string
	default "P5040DS"

endif
```

## board/freescale/imx8mm_evk/Kconfig
```kconfig
if TARGET_IMX8MM_EVK

config SYS_BOARD
	default "imx8mm_evk"

config SYS_VENDOR
	default "freescale"

config SYS_CONFIG_NAME
	default "imx8mm_evk"

endif
```

## board/freescale/imx8mn_evk/Kconfig
```kconfig
if TARGET_IMX8MN_EVK || TARGET_IMX8MN_DDR4_EVK

config SYS_BOARD
	default "imx8mn_evk"

config SYS_VENDOR
	default "freescale"

config SYS_CONFIG_NAME
	default "imx8mn_evk"

config IMX8MN_LOW_DRIVE_MODE
	bool "Enable the low drive mode of iMX8MN on EVK board"
	default n

source "board/freescale/common/Kconfig"

endif
```

## board/freescale/imx8mp_evk/Kconfig
```kconfig
if TARGET_IMX8MP_EVK

config SYS_BOARD
	default "imx8mp_evk"

config SYS_VENDOR
	default "freescale"

config SYS_CONFIG_NAME
	default "imx8mp_evk"

source "board/freescale/common/Kconfig"

endif
```

## board/freescale/imx8mq_evk/Kconfig
```kconfig
if TARGET_IMX8MQ_EVK

config SYS_BOARD
	default "imx8mq_evk"

config SYS_VENDOR
	default "freescale"

config SYS_CONFIG_NAME
	default "imx8mq_evk"

config IMX_CONFIG
	default "board/freescale/imx8mq_evk/imximage.cfg"

endif
```

## board/freescale/imx91_evk/Kconfig
```kconfig
if TARGET_IMX91_11X11_EVK

config SYS_BOARD
	default "imx91_evk"

config SYS_VENDOR
	default "freescale"

config SYS_CONFIG_NAME
	default "imx91_evk"

config IMX91_EVK_LPDDR4
	bool "Using LPDDR4 Timing and PMIC voltage"
	default y
	select IMX9_LPDDR4X
	help
	  Select the LPDDR4 timing and 1.1V VDDQ

endif
```
