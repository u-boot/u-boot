## board/freescale/imx91_frdm/Kconfig
```kconfig
if TARGET_IMX91_11X11_FRDM

config SYS_BOARD
	default "imx91_frdm"

config SYS_VENDOR
	default "freescale"

config SYS_CONFIG_NAME
	default "imx91_frdm"

endif
```

## board/freescale/imx93_frdm/Kconfig
```kconfig
if TARGET_IMX93_FRDM

config SYS_BOARD
	default "imx93_frdm"

config SYS_VENDOR
	default "freescale"

config SYS_CONFIG_NAME
	default "imx93_frdm"

endif
```

## board/freescale/imx93_qsb/Kconfig
```kconfig
if TARGET_IMX93_9X9_QSB

config SYS_BOARD
	default "imx93_qsb"

config SYS_VENDOR
	default "freescale"

config SYS_CONFIG_NAME
	default "imx93_qsb"

endif
```

## board/freescale/imx94_evk/Kconfig
```kconfig
if TARGET_IMX943_EVK

config SYS_BOARD
	default "imx94_evk"

config SYS_VENDOR
	default "freescale"

config SYS_CONFIG_NAME
	default "imx94_evk"

endif
```

## board/freescale/imx95_evk/Kconfig
```kconfig
if TARGET_IMX95_19X19_EVK || TARGET_IMX95_15X15_EVK

config SYS_BOARD
	default "imx95_evk"

config SYS_VENDOR
	default "freescale"

config SYS_CONFIG_NAME
	default "imx95_evk"

endif
```

## board/freescale/imxrt1020-evk/Kconfig
```kconfig
if TARGET_IMXRT1020_EVK

config SYS_BOARD
	default "imxrt1020-evk"

config SYS_VENDOR
	default "freescale"

config SYS_SOC
	default "imxrt1020"

config SYS_CONFIG_NAME
	default "imxrt1020-evk"

config IMX_CONFIG
	default "board/freescale/imxrt1020-evk/imximage.cfg"

endif
```

## board/freescale/imxrt1050-evk/Kconfig
```kconfig
if TARGET_IMXRT1050_EVK

config SYS_BOARD
	default "imxrt1050-evk"

config SYS_VENDOR
	default "freescale"

config SYS_SOC
	default "imxrt1050"

config SYS_CONFIG_NAME
	default "imxrt1050-evk"

config IMX_CONFIG
	default "board/freescale/imxrt1050-evk/imximage.cfg"

endif
```

## board/freescale/imxrt1170-evk/Kconfig
```kconfig
if TARGET_IMXRT1170_EVK

config SYS_BOARD
	default "imxrt1170-evk"

config SYS_VENDOR
	default "freescale"

config SYS_SOC
	default "imxrt1170"

config SYS_CONFIG_NAME
	default "imxrt1170-evk"

config IMX_CONFIG
	default "board/freescale/imxrt1170-evk/imximage.cfg"

endif
```

## board/freescale/ls1012afrdm/Kconfig
```kconfig
if TARGET_LS1012AFRDM

config SYS_BOARD
	default "ls1012afrdm"

config SYS_VENDOR
	default "freescale"

config SYS_SOC
	default "fsl-layerscape"

config SYS_CONFIG_NAME
	default "ls1012afrdm"

endif
```

## board/freescale/ls1012aqds/Kconfig
```kconfig
if TARGET_LS1012AQDS

config SYS_BOARD
	default "ls1012aqds"

config SYS_VENDOR
	default "freescale"

config SYS_SOC
	default "fsl-layerscape"

config SYS_CONFIG_NAME
	default "ls1012aqds"

source "board/freescale/common/Kconfig"

endif
```

## board/freescale/ls1012ardb/Kconfig
```kconfig
if TARGET_LS1012ARDB

config SYS_BOARD
	default "ls1012ardb"

config SYS_VENDOR
	default "freescale"

config SYS_SOC
	default "fsl-layerscape"

config SYS_CONFIG_NAME
	default "ls1012ardb"

source "board/freescale/common/Kconfig"

endif
```

## board/freescale/ls1021aqds/Kconfig
```kconfig
if TARGET_LS1021AQDS

config SYS_CPU
	string
	default "armv7"

config SYS_BOARD
	string
	default "ls1021aqds"

config SYS_VENDOR
	string
	default "freescale"

config SYS_SOC
	string
	default "ls102xa"

config SYS_CONFIG_NAME
	string
	default "ls1021aqds"

endif
```

## board/freescale/ls1021atwr/Kconfig
```kconfig
if TARGET_LS1021ATWR

config SYS_CPU
	string
	default "armv7"

config SYS_BOARD
	string
	default "ls1021atwr"

config SYS_VENDOR
	string
	default "freescale"

config SYS_SOC
	string
	default "ls102xa"

config SYS_CONFIG_NAME
	string
	default "ls1021atwr"

endif
```

## board/freescale/ls1043ardb/Kconfig
```kconfig
if TARGET_LS1043ARDB

config SYS_BOARD
	default "ls1043ardb"

config SYS_VENDOR
	default "freescale"

config SYS_SOC
	default "fsl-layerscape"

config SYS_CONFIG_NAME
	default "ls1043ardb"

config SYS_HAS_ARMV8_SECURE_BASE
	bool "Enable secure address for PSCI image"
	depends on ARMV8_PSCI
	default n
	help
	  PSCI image can be re-located to secure RAM.
	  If enabled, please also define the value for ARMV8_SECURE_BASE,
	  for LS1043ARDB, it could be some address in OCRAM.

source "board/freescale/common/Kconfig"

endif
```

## board/freescale/ls1088a/Kconfig
```kconfig
if TARGET_LS1088AQDS

config SYS_BOARD
	default "ls1088a"

config SYS_VENDOR
	default "freescale"

config SYS_SOC
	default "fsl-layerscape"

config SYS_CONFIG_NAME
	default "ls1088aqds"

source "board/freescale/common/Kconfig"
endif

if TARGET_LS1088ARDB

config SYS_BOARD
	default "ls1088a"

config SYS_VENDOR
	default "freescale"

config SYS_SOC
	default "fsl-layerscape"

config SYS_CONFIG_NAME
	default "ls1088ardb"

source "board/freescale/common/Kconfig"
endif
```

## board/freescale/ls2085a/Kconfig
```kconfig
if TARGET_LS2085A_EMU

config SYS_BOARD
	default "ls2085a"

config SYS_VENDOR
	default "freescale"

config SYS_SOC
	default "fsl-lsch3"

config SYS_CONFIG_NAME
	default "ls2085a_emu"

endif

if TARGET_LS2085A_SIMU

config SYS_BOARD
	default "ls2085a"

config SYS_VENDOR
	default "freescale"

config SYS_SOC
	default "fsl-lsch3"

config SYS_CONFIG_NAME
	default "ls2085a_simu"

endif
```

## board/freescale/ls2085aqds/Kconfig
```kconfig
if TARGET_LS2085AQDS

config SYS_BOARD
	default "ls2085aqds"

config SYS_VENDOR
	default "freescale"

config SYS_SOC
	default "fsl-layerscape"

config SYS_CONFIG_NAME
	default "ls2085aqds"

endif
```

## board/freescale/lx2160a/Kconfig
```kconfig
if TARGET_LX2160ARDB

config SYS_BOARD
	default "lx2160a"

config SYS_VENDOR
	default "freescale"

config SYS_SOC
	default "fsl-layerscape"

config SYS_CONFIG_NAME
	default "lx2160ardb"

config QSFP_EEPROM
        bool "Support for reading QSFP+ transceiver eeprom"
        default y if PHY_CORTINA
        help
         This option enables the functionality for reading
         QSFP+ cable eeprom. It can be used when PHYs are
         requiring different initialization based on cable
         type.

endif

if TARGET_LX2160AQDS

config SYS_BOARD
	default "lx2160a"

config SYS_VENDOR
	default "freescale"

config SYS_SOC
	default "fsl-layerscape"

config SYS_CONFIG_NAME
	default "lx2160aqds"

endif

if TARGET_LX2162AQDS

config SYS_BOARD
	default "lx2160a"

config SYS_VENDOR
	default "freescale"

config SYS_SOC
	default "fsl-layerscape"

config SYS_CONFIG_NAME
	default "lx2162aqds"

endif
```

## board/freescale/m5208evbe/Kconfig
```kconfig
if TARGET_M5208EVBE

config SYS_CPU
	string
	default "mcf52x2"

config SYS_BOARD
	string
	default "m5208evbe"

config SYS_VENDOR
	string
	default "freescale"

config SYS_CONFIG_NAME
	string
	default "M5208EVBE"

endif
```

## board/freescale/m52277evb/Kconfig
```kconfig
if TARGET_M52277EVB

config SYS_CPU
	string
	default "mcf5227x"

config SYS_BOARD
	string
	default "m52277evb"

config SYS_VENDOR
	string
	default "freescale"

config SYS_CONFIG_NAME
	string
	default "M52277EVB"

endif
```

## board/freescale/m5235evb/Kconfig
```kconfig
if TARGET_M5235EVB

config SYS_CPU
	string
	default "mcf523x"

config SYS_BOARD
	string
	default "m5235evb"

config SYS_VENDOR
	string
	default "freescale"

config SYS_CONFIG_NAME
	string
	default "M5235EVB"

endif
```

## board/freescale/m5249evb/Kconfig
```kconfig
if TARGET_M5249EVB

config SYS_CPU
	string
	default "mcf52x2"

config SYS_BOARD
	string
	default "m5249evb"

config SYS_VENDOR
	string
	default "freescale"

config SYS_CONFIG_NAME
	string
	default "M5249EVB"

endif
```

## board/freescale/m5253demo/Kconfig
```kconfig
if TARGET_M5253DEMO

config SYS_CPU
	string
	default "mcf52x2"

config SYS_BOARD
	string
	default "m5253demo"

config SYS_VENDOR
	string
	default "freescale"

config SYS_CONFIG_NAME
	string
	default "M5253DEMO"

endif
```

## board/freescale/m5253evbe/Kconfig
```kconfig
if TARGET_M5253EVBE

config SYS_CPU
	default "mcf52x2"

config SYS_BOARD
	default "m5253evbe"

config SYS_VENDOR
	default "freescale"

config SYS_CONFIG_NAME
	default "M5253EVBE"

endif
```

## board/freescale/m5272c3/Kconfig
```kconfig
if TARGET_M5272C3

config SYS_CPU
	string
	default "mcf52x2"

config SYS_BOARD
	string
	default "m5272c3"

config SYS_VENDOR
	string
	default "freescale"

config SYS_CONFIG_NAME
	string
	default "M5272C3"

endif
```
