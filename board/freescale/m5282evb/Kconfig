## board/freescale/m5282evb/Kconfig
```kconfig
if TARGET_M5282EVB

config SYS_CPU
	string
	default "mcf52x2"

config SYS_BOARD
	string
	default "m5282evb"

config SYS_VENDOR
	string
	default "freescale"

config SYS_CONFIG_NAME
	string
	default "M5282EVB"

endif
```

## board/freescale/m53017evb/Kconfig
```kconfig
if TARGET_M53017EVB

config SYS_CPU
	string
	default "mcf532x"

config SYS_BOARD
	string
	default "m53017evb"

config SYS_VENDOR
	string
	default "freescale"

config SYS_CONFIG_NAME
	string
	default "M53017EVB"

endif
```

## board/freescale/m5329evb/Kconfig
```kconfig
if TARGET_M5329EVB

config SYS_CPU
	string
	default "mcf532x"

config SYS_BOARD
	string
	default "m5329evb"

config SYS_VENDOR
	string
	default "freescale"

config SYS_CONFIG_NAME
	string
	default "M5329EVB"

endif
```

## board/freescale/m5373evb/Kconfig
```kconfig
if TARGET_M5373EVB

config SYS_CPU
	string
	default "mcf532x"

config SYS_BOARD
	string
	default "m5373evb"

config SYS_VENDOR
	string
	default "freescale"

config SYS_CONFIG_NAME
	string
	default "M5373EVB"

endif
```

## board/freescale/m54418twr/Kconfig
```kconfig
if TARGET_M54418TWR

config SYS_CPU
	string
	default "mcf5445x"

config SYS_BOARD
	string
	default "m54418twr"

config SYS_VENDOR
	string
	default "freescale"

config SYS_CONFIG_NAME
	string
	default "M54418TWR"

endif
```

## board/freescale/m54451evb/Kconfig
```kconfig
if TARGET_M54451EVB

config SYS_CPU
	string
	default "mcf5445x"

config SYS_BOARD
	string
	default "m54451evb"

config SYS_VENDOR
	string
	default "freescale"

config SYS_CONFIG_NAME
	string
	default "M54451EVB"

endif
```

## board/freescale/m54455evb/Kconfig
```kconfig
if TARGET_M54455EVB

config SYS_CPU
	string
	default "mcf5445x"

config SYS_BOARD
	string
	default "m54455evb"

config SYS_VENDOR
	string
	default "freescale"

config SYS_CONFIG_NAME
	string
	default "M54455EVB"

endif
```

## board/freescale/m547xevb/Kconfig
```kconfig
if TARGET_M5475EVB

config SYS_CPU
	string
	default "mcf547x_8x"

config SYS_BOARD
	string
	default "m547xevb"

config SYS_VENDOR
	string
	default "freescale"

config SYS_CONFIG_NAME
	string
	default "M5475EVB"

endif
```

## board/freescale/m548xevb/Kconfig
```kconfig
if TARGET_M5485EVB

config SYS_CPU
	string
	default "mcf547x_8x"

config SYS_BOARD
	string
	default "m548xevb"

config SYS_VENDOR
	string
	default "freescale"

config SYS_CONFIG_NAME
	string
	default "M5485EVB"

endif
```

## board/freescale/mpc5121ads/Kconfig
```kconfig
if TARGET_MPC5121ADS

config SYS_BOARD
	default "mpc5121ads"

config SYS_VENDOR
	default "freescale"

config SYS_CONFIG_NAME
	default "mpc5121ads"

endif
```

## board/freescale/mpc7448hpc2/Kconfig
```kconfig
if TARGET_MPC7448HPC2

config SYS_BOARD
	default "mpc7448hpc2"

config SYS_VENDOR
	default "freescale"

config SYS_CONFIG_NAME
	default "mpc7448hpc2"

endif
```

## board/freescale/mpc8266ads/Kconfig
```kconfig
if TARGET_MPC8266ADS

config SYS_BOARD
	default "mpc8266ads"

config SYS_VENDOR
	default "freescale"

config SYS_CONFIG_NAME
	default "MPC8266ADS"

endif
```

## board/freescale/mpc8308rdb/Kconfig
```kconfig
if TARGET_MPC8308RDB

config SYS_BOARD
	string
	default "mpc8308rdb"

config SYS_VENDOR
	string
	default "freescale"

config SYS_CONFIG_NAME
	string
	default "MPC8308RDB"

endif
```

## board/freescale/mpc8313erdb/Kconfig
```kconfig
if TARGET_MPC8313ERDB

config SYS_BOARD
	default "mpc8313erdb"

config SYS_VENDOR
	default "freescale"

config SYS_CONFIG_NAME
	default "MPC8313ERDB"

endif
```

## board/freescale/mpc8315erdb/Kconfig
```kconfig
if TARGET_MPC8315ERDB

config SYS_BOARD
	string
	default "mpc8315erdb"

config SYS_VENDOR
	string
	default "freescale"

config SYS_CONFIG_NAME
	string
	default "MPC8315ERDB"

endif
```

## board/freescale/mpc8323erdb/Kconfig
```kconfig
if TARGET_MPC8323ERDB

config SYS_BOARD
	string
	default "mpc8323erdb"

config SYS_VENDOR
	string
	default "freescale"

config SYS_CONFIG_NAME
	string
	default "MPC8323ERDB"

endif
```

## board/freescale/mpc832xemds/Kconfig
```kconfig
if TARGET_MPC832XEMDS

config SYS_BOARD
	string
	default "mpc832xemds"

config SYS_VENDOR
	string
	default "freescale"

config SYS_CONFIG_NAME
	string
	default "MPC832XEMDS"

endif
```

## board/freescale/mpc8349emds/Kconfig
```kconfig
if TARGET_MPC8349EMDS

config SYS_BOARD
	default "mpc8349emds"

config SYS_VENDOR
	default "freescale"

config SYS_CONFIG_NAME
	default "MPC8349EMDS"

endif
```

## board/freescale/mpc8349itx/Kconfig
```kconfig
if TARGET_MPC8349ITX

config SYS_BOARD
	string
	default "mpc8349itx"

config SYS_VENDOR
	string
	default "freescale"

config SYS_CONFIG_NAME
	string
	default "MPC8349ITX"

endif
```

## board/freescale/mpc8360emds/Kconfig
```kconfig
if TARGET_MPC8360EMDS

config SYS_BOARD
	default "mpc8360emds"

config SYS_VENDOR
	default "freescale"

config SYS_CONFIG_NAME
	default "MPC8360EMDS"

endif
```

## board/freescale/mpc8360erdk/Kconfig
```kconfig
if TARGET_MPC8360ERDK

config SYS_BOARD
	default "mpc8360erdk"

config SYS_VENDOR
	default "freescale"

config SYS_CONFIG_NAME
	default "MPC8360ERDK"

endif
```

## board/freescale/mpc837xemds/Kconfig
```kconfig
if TARGET_MPC837XEMDS

config SYS_BOARD
	string
	default "mpc837xemds"

config SYS_VENDOR
	string
	default "freescale"

config SYS_CONFIG_NAME
	string
	default "MPC837XEMDS"

endif
```

## board/freescale/mpc837xerdb/Kconfig
```kconfig
if TARGET_MPC837XERDB

config SYS_BOARD
	string
	default "mpc837xerdb"

config SYS_VENDOR
	string
	default "freescale"

config SYS_CONFIG_NAME
	string
	default "MPC837XERDB"

endif
```

## board/freescale/mpc8540ads/Kconfig
```kconfig
if TARGET_MPC8540ADS

config SYS_BOARD
	default "mpc8540ads"

config SYS_VENDOR
	default "freescale"

config SYS_CONFIG_NAME
	default "MPC8540ADS"

endif
```

## board/freescale/mpc8541cds/Kconfig
```kconfig
if TARGET_MPC8541CDS

config SYS_BOARD
	string
	default "mpc8541cds"

config SYS_VENDOR
	string
	default "freescale"

config SYS_CONFIG_NAME
	string
	default "MPC8541CDS"

endif
```
