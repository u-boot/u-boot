## board/freescale/mpc8544ds/Kconfig
```kconfig
if TARGET_MPC8544DS

config SYS_BOARD
	string
	default "mpc8544ds"

config SYS_VENDOR
	string
	default "freescale"

config SYS_CONFIG_NAME
	string
	default "MPC8544DS"

endif
```

## board/freescale/mpc8548cds/Kconfig
```kconfig
if TARGET_MPC8548CDS

config SYS_BOARD
	string
	default "mpc8548cds"

config SYS_VENDOR
	string
	default "freescale"

config SYS_CONFIG_NAME
	string
	default "MPC8548CDS"

endif
```

## board/freescale/mpc8555cds/Kconfig
```kconfig
if TARGET_MPC8555CDS

config SYS_BOARD
	string
	default "mpc8555cds"

config SYS_VENDOR
	string
	default "freescale"

config SYS_CONFIG_NAME
	string
	default "MPC8555CDS"

endif
```

## board/freescale/mpc8560ads/Kconfig
```kconfig
if TARGET_MPC8560ADS

config SYS_BOARD
	default "mpc8560ads"

config SYS_VENDOR
	default "freescale"

config SYS_CONFIG_NAME
	default "MPC8560ADS"

endif
```

## board/freescale/mpc8568mds/Kconfig
```kconfig
if TARGET_MPC8568MDS

config SYS_BOARD
	string
	default "mpc8568mds"

config SYS_VENDOR
	string
	default "freescale"

config SYS_CONFIG_NAME
	string
	default "MPC8568MDS"

endif
```

## board/freescale/mpc8569mds/Kconfig
```kconfig
if TARGET_MPC8569MDS

config SYS_BOARD
	string
	default "mpc8569mds"

config SYS_VENDOR
	string
	default "freescale"

config SYS_CONFIG_NAME
	string
	default "MPC8569MDS"

endif
```

## board/freescale/mpc8572ds/Kconfig
```kconfig
if TARGET_MPC8572DS

config SYS_BOARD
	string
	default "mpc8572ds"

config SYS_VENDOR
	string
	default "freescale"

config SYS_CONFIG_NAME
	string
	default "MPC8572DS"

endif
```

## board/freescale/mpc8610hpcd/Kconfig
```kconfig
if TARGET_MPC8610HPCD

config SYS_BOARD
	string
	default "mpc8610hpcd"

config SYS_VENDOR
	string
	default "freescale"

config SYS_CONFIG_NAME
	string
	default "MPC8610HPCD"

endif
```

## board/freescale/mx23evk/Kconfig
```kconfig
if TARGET_MX23EVK

config SYS_CPU
	string
	default "arm926ejs"

config SYS_BOARD
	string
	default "mx23evk"

config SYS_VENDOR
	string
	default "freescale"

config SYS_SOC
	string
	default "mxs"

config SYS_CONFIG_NAME
	string
	default "mx23evk"

endif
```

## board/freescale/mx25pdk/Kconfig
```kconfig
if TARGET_MX25PDK

config SYS_CPU
	string
	default "arm926ejs"

config SYS_BOARD
	string
	default "mx25pdk"

config SYS_VENDOR
	string
	default "freescale"

config SYS_SOC
	string
	default "mx25"

config SYS_CONFIG_NAME
	string
	default "mx25pdk"

endif
```

## board/freescale/mx28evk/Kconfig
```kconfig
if TARGET_MX28EVK

config SYS_CPU
	string
	default "arm926ejs"

config SYS_BOARD
	string
	default "mx28evk"

config SYS_VENDOR
	string
	default "freescale"

config SYS_SOC
	string
	default "mxs"

config SYS_CONFIG_NAME
	string
	default "mx28evk"

endif
```

## board/freescale/mx31ads/Kconfig
```kconfig
if TARGET_MX31ADS

config SYS_BOARD
	default "mx31ads"

config SYS_VENDOR
	default "freescale"

config SYS_SOC
	default "mx31"

config SYS_CONFIG_NAME
	default "mx31ads"

endif
```

## board/freescale/mx31pdk/Kconfig
```kconfig
if TARGET_MX31PDK

config SYS_BOARD
	default "mx31pdk"

config SYS_VENDOR
	default "freescale"

config SYS_SOC
	default "mx31"

config SYS_CONFIG_NAME
	default "mx31pdk"

endif
```

## board/freescale/mx35pdk/Kconfig
```kconfig
if TARGET_MX35PDK

config SYS_CPU
	string
	default "arm1136"

config SYS_BOARD
	string
	default "mx35pdk"

config SYS_VENDOR
	string
	default "freescale"

config SYS_SOC
	string
	default "mx35"

config SYS_CONFIG_NAME
	string
	default "mx35pdk"

endif
```

## board/freescale/mx51evk/Kconfig
```kconfig
if TARGET_MX51EVK

config SYS_CPU
	string
	default "armv7"

config SYS_BOARD
	string
	default "mx51evk"

config SYS_VENDOR
	string
	default "freescale"

config SYS_SOC
	string
	default "mx5"

config SYS_CONFIG_NAME
	string
	default "mx51evk"

endif
```

## board/freescale/mx53ard/Kconfig
```kconfig
if TARGET_MX53ARD

config SYS_CPU
	default "armv7"

config SYS_BOARD
	default "mx53ard"

config SYS_VENDOR
	default "freescale"

config SYS_SOC
	default "mx5"

config SYS_CONFIG_NAME
	default "mx53ard"

endif
```

## board/freescale/mx53loco/Kconfig
```kconfig
if TARGET_MX53LOCO

config SYS_CPU
	string
	default "armv7"

config SYS_BOARD
	string
	default "mx53loco"

config SYS_VENDOR
	string
	default "freescale"

config SYS_SOC
	string
	default "mx5"

config SYS_CONFIG_NAME
	string
	default "mx53loco"

endif
```

## board/freescale/mx53smd/Kconfig
```kconfig
if TARGET_MX53SMD

config SYS_CPU
	string
	default "armv7"

config SYS_BOARD
	string
	default "mx53smd"

config SYS_VENDOR
	string
	default "freescale"

config SYS_SOC
	string
	default "mx5"

config SYS_CONFIG_NAME
	string
	default "mx53smd"

endif
```

## board/freescale/mx6qarm2/Kconfig
```kconfig
if TARGET_MX6QARM2

config SYS_CPU
	default "armv7"

config SYS_BOARD
	default "mx6qarm2"

config SYS_VENDOR
	default "freescale"

config SYS_SOC
	default "mx6"

config SYS_CONFIG_NAME
	default "mx6qarm2"

endif
```

## board/freescale/mx6qsabreauto/Kconfig
```kconfig
if TARGET_MX6QSABREAUTO

config SYS_BOARD
	default "mx6qsabreauto"

config SYS_VENDOR
	default "freescale"

config SYS_CONFIG_NAME
	default "mx6qsabreauto"

endif
```

## board/freescale/mx6sabresd/Kconfig
```kconfig
if TARGET_MX6SABRESD

config SYS_BOARD
	default "mx6sabresd"

config SYS_VENDOR
	default "freescale"

config SYS_SOC
	default "mx6"

config SYS_CONFIG_NAME
	default "mx6sabresd"

endif
```

## board/freescale/mx6slevk/Kconfig
```kconfig
if TARGET_MX6SLEVK

config SYS_CPU
	string
	default "armv7"

config SYS_BOARD
	string
	default "mx6slevk"

config SYS_VENDOR
	string
	default "freescale"

config SYS_SOC
	string
	default "mx6"

config SYS_CONFIG_NAME
	string
	default "mx6slevk"

endif
```

## board/freescale/mx6sxsabresd/Kconfig
```kconfig
if TARGET_MX6SXSABRESD

config SYS_BOARD
	default "mx6sxsabresd"

config SYS_VENDOR
	default "freescale"

config SYS_SOC
	default "mx6"

config SYS_CONFIG_NAME
	default "mx6sxsabresd"

endif
```

## board/freescale/mx6ul_14x14_evk/Kconfig
```kconfig
if TARGET_MX6UL_14X14_EVK

config SYS_BOARD
	default "mx6ul_14x14_evk"

config SYS_VENDOR
	default "freescale"

config SYS_SOC
	default "mx6"

config SYS_CONFIG_NAME
	default "mx6ul_14x14_evk"

endif
```

## board/freescale/my_mx6ullevk/Kconfig
```kconfig
if TARGET_MY_MX6ULL_14X14_EVK

config SYS_BOARD
	default "my_mx6ullevk"

config SYS_VENDOR
	default "freescale"

config SYS_CONFIG_NAME
	default "my_mx6ullevk"

config IMX_CONFIG
	default "board/freescale/my_mx6ullevk/imximage.cfg"

endif
```
