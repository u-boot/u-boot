## board/freescale/p1010rdb/Kconfig
```kconfig
if TARGET_P1010RDB

config SYS_BOARD
	default "p1010rdb"

config SYS_VENDOR
	default "freescale"

config SYS_CONFIG_NAME
	default "P1010RDB"

endif
```

## board/freescale/p1022ds/Kconfig
```kconfig
if TARGET_P1022DS

config SYS_BOARD
	string
	default "p1022ds"

config SYS_VENDOR
	string
	default "freescale"

config SYS_CONFIG_NAME
	string
	default "P1022DS"

endif
```

## board/freescale/p1023rdb/Kconfig
```kconfig
if TARGET_P1023RDB

config SYS_BOARD
	string
	default "p1023rdb"

config SYS_VENDOR
	string
	default "freescale"

config SYS_CONFIG_NAME
	string
	default "P1023RDB"

endif
```

## board/freescale/p1_p2_rdb/Kconfig
```kconfig
if TARGET_P1_P2_RDB

config SYS_BOARD
	default "p1_p2_rdb"

config SYS_VENDOR
	default "freescale"

config SYS_CONFIG_NAME
	default "P1_P2_RDB"

endif
```

## board/freescale/p1_p2_rdb_pc/Kconfig
```kconfig
if TARGET_P1_P2_RDB_PC		|| \
	TARGET_P1020MBG		|| \
	TARGET_P1020RDB_PC	|| \
	TARGET_P1020RDB_PD

config SYS_BOARD
	default "p1_p2_rdb_pc"

config SYS_VENDOR
	default "freescale"

config SYS_CONFIG_NAME
	default "p1_p2_rdb_pc"

endif
```

## board/freescale/p1_twr/Kconfig
```kconfig
if TARGET_P1_TWR

config SYS_BOARD
	string
	default "p1_twr"

config SYS_VENDOR
	string
	default "freescale"

config SYS_CONFIG_NAME
	string
	default "p1_twr"

endif
```

## board/freescale/p2020come/Kconfig
```kconfig
if TARGET_P2020COME

config SYS_BOARD
	default "p2020come"

config SYS_VENDOR
	default "freescale"

config SYS_CONFIG_NAME
	default "P2020COME"

endif
```

## board/freescale/p2020ds/Kconfig
```kconfig
if TARGET_P2020DS

config SYS_BOARD
	default "p2020ds"

config SYS_VENDOR
	default "freescale"

config SYS_CONFIG_NAME
	default "P2020DS"

endif
```

## board/freescale/p2041rdb/Kconfig
```kconfig
if TARGET_P2041RDB

config SYS_BOARD
	string
	default "p2041rdb"

config SYS_VENDOR
	string
	default "freescale"

config SYS_CONFIG_NAME
	string
	default "P2041RDB"

endif
```

## board/freescale/qemu-ppce500/Kconfig
```kconfig
if TARGET_QEMU_PPCE500

config SYS_BOARD
	string
	default "qemu-ppce500"

config SYS_VENDOR
	string
	default "freescale"

config SYS_CONFIG_NAME
	string
	default "qemu-ppce500"

endif
```

## board/freescale/t102xqds/Kconfig
```kconfig
if TARGET_T102XQDS

config SYS_BOARD
	default "t102xqds"

config SYS_VENDOR
	default "freescale"

config SYS_CONFIG_NAME
	default "T102xQDS"

endif
```

## board/freescale/t102xrdb/Kconfig
```kconfig
if TARGET_T102XRDB

config SYS_BOARD
	default "t102xrdb"

config SYS_VENDOR
	default "freescale"

config SYS_CONFIG_NAME
	default "T102xRDB"

endif
```

## board/freescale/t1040qds/Kconfig
```kconfig
if TARGET_T1040QDS

config SYS_BOARD
	string
	default "t1040qds"

config SYS_VENDOR
	string
	default "freescale"

config SYS_CONFIG_NAME
	string
	default "T1040QDS"

endif
```

## board/freescale/t104xrdb/Kconfig
```kconfig
if TARGET_T1040RDB || TARGET_T1042RDB

config SYS_BOARD
	default "t104xrdb"

config SYS_VENDOR
	default "freescale"

config SYS_CONFIG_NAME
	default "T104xRDB"

endif
```

## board/freescale/t208xqds/Kconfig
```kconfig
if TARGET_T2080QDS

config SYS_BOARD
	default "t208xqds"

config SYS_VENDOR
	default "freescale"

config SYS_CONFIG_NAME
	default "T208xQDS"

source "board/freescale/common/Kconfig"

endif
```

## board/freescale/t208xrdb/Kconfig
```kconfig
if TARGET_T208XRDB

config SYS_BOARD
	default "t208xrdb"

config SYS_VENDOR
	default "freescale"

config SYS_CONFIG_NAME
	default "T208xRDB"

endif
```

## board/freescale/t4qds/Kconfig
```kconfig
if TARGET_T4240QDS

config SYS_BOARD
	default "t4qds"

config SYS_VENDOR
	default "freescale"

config SYS_CONFIG_NAME
	default "T4240QDS"

endif
```

## board/freescale/t4rdb/Kconfig
```kconfig
if TARGET_T4240RDB

config SYS_BOARD
	string
	default "t4rdb"

config SYS_VENDOR
	string
	default "freescale"

config SYS_CONFIG_NAME
	string
	default "T4240RDB"

endif
```

## board/freescale/up3d/Kconfig
```kconfig
if TARGET_MX6ULL_14X14_EVK

config SYS_BOARD
	default "up3d"

config SYS_VENDOR
	default "freescale"

config SYS_CONFIG_NAME
	default "up3d"

config IMX_CONFIG
	default "board/freescale/up3d/imximage.cfg"

endif
```

## board/freescale/vf610twr/Kconfig
```kconfig
if TARGET_VF610TWR

config SYS_CPU
	string
	default "armv7"

config SYS_BOARD
	string
	default "vf610twr"

config SYS_VENDOR
	string
	default "freescale"

config SYS_SOC
	string
	default "vf610"

config SYS_CONFIG_NAME
	string
	default "vf610twr"

endif
```

## board/friendlyarm/nanopi-neo2/fit_spl_atf.its
```
/dts-v1/;

/ {
    description = "Configuration to load ATF before U-Boot";
    #address-cells = <1>;

    images {
        uboot {
            description = "U-Boot (64-bit)";
            data = /incbin/("u-boot-nodtb.bin");
            type = "standalone";
            arch = "arm64";
            compression = "none";
            load = <0x4a000000>;
        };
        atf {
            description = "ARM Trusted Firmware";
            data = /incbin/("bl31.bin");
            type = "firmware";
            arch = "arm64";
            compression = "none";
            load = <0x44000>;
            entry = <0x44000>;
        };
        fdt_1 {
            description = "sun50i-h5-nanopi-neo2";
            data = /incbin/("arch/arm/dts/sun50i-h5-nanopi-neo2.dtb");
            type = "flat_dt";
            compression = "none";
        };
    };
    configurations {
        default = "config_1";

        config_1 {
            description = "sun50i-h5-nanopi-neo2";
            firmware = "uboot";
            loadables = "atf";
            fdt = "fdt_1";
        };
    };
};
```

## board/friendlyelec/cm3588-nas-rk3588/Kconfig
```kconfig
if TARGET_CM3588_NAS_RK3588

config SYS_BOARD
	default "cm3588-nas-rk3588"

config SYS_VENDOR
	default "friendlyelec"

config SYS_CONFIG_NAME
	default "nanopc-t6-rk3588"

endif
```

## board/friendlyelec/nanopi-r6c-rk3588s/Kconfig
```kconfig
if TARGET_NANOPI_R6C_RK3588S

config SYS_BOARD
	default "nanopi-r6c-rk3588s"

config SYS_VENDOR
	default "friendlyelec"

config SYS_CONFIG_NAME
	default "nanopi-r6c-rk3588s"

endif
```

## board/friendlyelec/nanopi-r6s-rk3588s/Kconfig
```kconfig
if TARGET_NANOPI_R6S_RK3588S

config SYS_BOARD
	default "nanopi-r6s-rk3588s"

config SYS_VENDOR
	default "friendlyelec"

config SYS_CONFIG_NAME
	default "nanopi-r6s-rk3588s"

endif
```

## board/funkwerk/vovpn-gw/Kconfig
```kconfig
if TARGET_VOVPN_GW

config SYS_BOARD
	default "vovpn-gw"

config SYS_VENDOR
	default "funkwerk"

config SYS_CONFIG_NAME
	default "VoVPN-GW"

endif
```
