## board/friendlyelec/nanopi-rk3528/Kconfig
```kconfig
if TARGET_NANOPI_RK3528

config SYS_BOARD
	default "nanopi-rk3528"

config SYS_VENDOR
	default "friendlyelec"

config BOARD_SPECIFIC_OPTIONS # dummy
	def_bool y
	select ADC
	select SPL_ADC

endif
```

## board/tq/common/Kconfig
```kconfig
# SPDX-License-Identifier: GPL-2.0-or-later
#
# Copyright (c) 2023-2026 TQ-Systems GmbH <u-boot@ew.tq-group.com>,
# D-82229 Seefeld, Germany.
# Author: Markus Niebel, Max Merchel
#

config TQ_COMMON_BB
	bool
	default y

config TQ_COMMON_SDMMC
	bool

config TQ_COMMON_SOM
	bool

config TQ_COMMON_SYSINFO
	bool
	select SYSINFO
	imply SYSINFO_TQ_EEPROM

if TQ_COMMON_SYSINFO

config TQ_COMMON_SYSINFO_MACADDR_OFFSET
	int "TQ EEPROM MAC address offset"
	default 0
	help
	  Set ethXaddr variables based on EEPROM contents
	  starting with this offset

config TQ_COMMON_SYSINFO_MACADDR_NUM
	int "TQ EEPROM MAC address number"
	default 1
	help
	  Number of ethXaddr variables to set
	  based on EEPROM contents

endif
```

## configs/tqma6q_mba6_spi_defconfig
```kconfig
#include <configs/tqma6_mba6_common.config>
#include <configs/tqma6_mba6_spi.config>

CONFIG_MX6Q=y
CONFIG_DEFAULT_DEVICE_TREE="nxp/imx/imx6q-mba6b"
```

## configs/tqma6qp_mba6_defconfig
```kconfig
#include <configs/tqma6_mba6_common.config>

CONFIG_MX6Q=y
CONFIG_TQMA6QP=y
CONFIG_DEFAULT_DEVICE_TREE="nxp/imx/imx6qp-mba6b"
```

## configs/tqma6s_mba6_mmc_defconfig
```kconfig
#include <configs/tqma6_mba6_common.config>
#include <configs/tqma6_mba6_mmc.config>

CONFIG_MX6S=y
CONFIG_DEFAULT_DEVICE_TREE="nxp/imx/imx6dl-mba6b"
CONFIG_OF_LIST="nxp/imx/imx6dl-mba6a nxp/imx/imx6dl-mba6b"
CONFIG_MULTI_DTB_FIT=y
```
