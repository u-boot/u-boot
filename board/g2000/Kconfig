## board/g2000/Kconfig
```kconfig
if TARGET_G2000

config SYS_BOARD
	default "g2000"

config SYS_CONFIG_NAME
	default "G2000"

endif
```

## board/gaisler/gr_cpci_ax2000/Kconfig
```kconfig
if TARGET_GR_CPCI_AX2000

config SYS_BOARD
	default "gr_cpci_ax2000"

config SYS_CONFIG_NAME
	default "gr_cpci_ax2000"

endif
```

## board/gaisler/gr_ep2s60/Kconfig
```kconfig
if TARGET_GR_EP2S60

config SYS_BOARD
	default "gr_ep2s60"

config SYS_CONFIG_NAME
	default "gr_ep2s60"

endif
```

## board/gaisler/gr_xc3s_1500/Kconfig
```kconfig
if TARGET_GR_XC3S_1500

config SYS_BOARD
	default "gr_xc3s_1500"

config SYS_CONFIG_NAME
	default "gr_xc3s_1500"

endif
```

## board/gaisler/grsim/Kconfig
```kconfig
if TARGET_GRSIM

config SYS_BOARD
	default "grsim"

config SYS_CONFIG_NAME
	default "grsim"

endif
```

## board/gaisler/grsim_leon2/Kconfig
```kconfig
if TARGET_GRSIM_LEON2

config SYS_BOARD
	default "grsim_leon2"

config SYS_CONFIG_NAME
	default "grsim_leon2"

endif
```

## board/galaxy5200/Kconfig
```kconfig
if TARGET_GALAXY5200

config SYS_BOARD
	default "galaxy5200"

config SYS_CONFIG_NAME
	default "galaxy5200"

endif
```

## board/gameforce/ace-rk3588s/Kconfig
```kconfig
if TARGET_GAMEFORCE_ACE_RK3588S

config SYS_BOARD
	default "gameforce-ace-rk3588s"

config SYS_VENDOR
	default "GameForce"

endif
```

## board/gateworks/gw_ventana/Kconfig
```kconfig
if TARGET_GW_VENTANA

config SYS_BOARD
	default "gw_ventana"

config SYS_VENDOR
	default "gateworks"

config SYS_CONFIG_NAME
	default "gw_ventana"

endif
```

## board/gateworks/venice/Kconfig
```kconfig
if TARGET_IMX8MM_VENICE

config SYS_BOARD
	default "venice"

config SYS_VENDOR
	default "gateworks"

config SYS_CONFIG_NAME
	default "imx8mm_venice"

config IMX_CONFIG
	default "board/gateworks/venice/imximage-8mm-lpddr4.cfg"
endif
```

## board/gdsys/405ep/Kconfig
```kconfig
if TARGET_DLVISION_10G

config SYS_BOARD
	default "405ep"

config SYS_VENDOR
	default "gdsys"

config SYS_CONFIG_NAME
	default "dlvision-10g"

endif

if TARGET_IO

config SYS_BOARD
	default "405ep"

config SYS_VENDOR
	default "gdsys"

config SYS_CONFIG_NAME
	default "io"

endif

if TARGET_IOCON

config SYS_BOARD
	default "405ep"

config SYS_VENDOR
	default "gdsys"

config SYS_CONFIG_NAME
	default "iocon"

endif

if TARGET_NEO

config SYS_BOARD
	default "405ep"

config SYS_VENDOR
	default "gdsys"

config SYS_CONFIG_NAME
	default "neo"

endif
```

## board/gdsys/405ex/Kconfig
```kconfig
if TARGET_IO64

config SYS_BOARD
	default "405ex"

config SYS_VENDOR
	default "gdsys"

config SYS_CONFIG_NAME
	default "io64"

endif
```

## board/gdsys/a38x/Kconfig
```kconfig
if TARGET_CONTROLCENTERDC

menu "Controlcenter DC board options"

choice
	prompt "Select boot method"

config SPL_BOOT_DEVICE_SPI
	bool "SPI"

config SPL_BOOT_DEVICE_MMC
	bool "MMC"
	select SPL_LIBDISK_SUPPORT

endchoice

#config SPL_BOOT_DEVICE
#	int
#	default 1 if SPL_BOOT_DEVICE_SPI
#	default 2 if SPL_BOOT_DEVICE_MMC

endmenu

endif
```

## board/gdsys/dlvision/Kconfig
```kconfig
if TARGET_DLVISION

config SYS_BOARD
	default "dlvision"

config SYS_VENDOR
	default "gdsys"

config SYS_CONFIG_NAME
	default "dlvision"

endif
```

## board/gdsys/gdppc440etx/Kconfig
```kconfig
if TARGET_GDPPC440ETX

config SYS_BOARD
	default "gdppc440etx"

config SYS_VENDOR
	default "gdsys"

config SYS_CONFIG_NAME
	default "gdppc440etx"

endif
```

## board/gdsys/intip/Kconfig
```kconfig
if TARGET_INTIP

config SYS_BOARD
	default "intip"

config SYS_VENDOR
	default "gdsys"

config SYS_CONFIG_NAME
	default "intip"

endif
```

## board/gdsys/mpc8308/Kconfig
```kconfig
config GDSYS_LEGACY_OSD_CMDS
	bool
	help
	  Use the 'osdw', 'osdp', and 'osdsize' legacy commands required by
	  gdsys devices.

config SYS_FPGA0_BASE
	hex
	default E0600000
	help
	  The base address of the first FPGA's register map.

config SYS_FPGA0_SIZE
	hex
	default 1
	help
	  The base address of the first FPGA's register map.

config SYS_FPGA1_BASE
	hex
	help
	  The base address of the second FPGA's register map.

config SYS_FPGA1_SIZE
	hex
	help
	  The base address of the second FPGA's register map.

if TARGET_HRCON

config SYS_BOARD
	default "mpc8308"

config SYS_VENDOR
	default "gdsys"

config SYS_CONFIG_NAME
	default "hrcon"

config GDSYS_LEGACY_OSD_CMDS
	default y

endif

if TARGET_STRIDER

config SYS_BOARD
	default "mpc8308"

config SYS_VENDOR
	default "gdsys"

config SYS_CONFIG_NAME
	default "strider"

config GDSYS_LEGACY_OSD_CMDS
	default y
endif

config CMD_IOLOOP
	bool "Enable 'ioloop' and 'ioreflect' commands"
	help
	  These commands provide FPGA tests.
```

## board/gdsys/p1022/Kconfig
```kconfig
if TARGET_CONTROLCENTERD

config SYS_BOARD
	default "p1022"

config SYS_VENDOR
	default "gdsys"

config SYS_CONFIG_NAME
	default "controlcenterd"

endif
```

## board/ge/bx50v3/Kconfig
```kconfig
if TARGET_GE_B450V3 || TARGET_GE_B650V3 || TARGET_GE_B850V3

config IMX_CONFIG
	default "board/ge/bx50v3/bx50v3.cfg"

config SYS_BOARD
	default "bx50v3"

config SYS_VENDOR
	default "ge"

config SYS_SOC
	default "mx6"

config SYS_CONFIG_NAME
	default "ge_bx50v3"

endif
```

## board/geekbuying/geekbox/Kconfig
```kconfig
if TARGET_GEEKBOX

config SYS_BOARD
	default "geekbox"

config SYS_VENDOR
	default "geekbuying"

config SYS_CONFIG_NAME
	default "geekbox"

endif
```

## board/gen860t/Kconfig
```kconfig
if TARGET_GEN860T

config SYS_BOARD
	string
	default "gen860t"

config SYS_CONFIG_NAME
	string
	default "GEN860T"

endif
```

## board/genesi/mx51_efikamx/Kconfig
```kconfig
if TARGET_MX51_EFIKAMX

config SYS_BOARD
	default "mx51_efikamx"

config SYS_VENDOR
	default "genesi"

config SYS_SOC
	default "mx5"

config SYS_CONFIG_NAME
	default "mx51_efikamx"

endif
```

## board/google/Kconfig
```kconfig
#
# Copyright (C) 2015, Bin Meng <bmeng.cn@gmail.com>
#
# SPDX-License-Identifier:	GPL-2.0+
#

if VENDOR_GOOGLE

choice
	prompt "Mainboard model"
	optional

config TARGET_CHROMEBOOK_LINK
	bool "Chromebook link"
	help
	  This is the Chromebook Pixel released in 2013. It uses an Intel
	  i5 Ivybridge which is a die-shrink of Sandybridge, with 4GB of
	  SDRAM. It has a Panther Point platform controller hub, PCIe
	  WiFi and Bluetooth. It also includes a 720p webcam, USB SD
	  reader, microphone and speakers, display port and 32GB SATA
	  solid state drive. There is a Chrome OS EC connected on LPC,
	  and it provides a 2560x1700 high resolution touch-enabled LCD
	  display.

config TARGET_CHROMEBOX_PANTHER
	bool "Chromebox panther (not available)"
	select n
	help
	  Note: At present this must be used with coreboot. See README.x86
	  for instructions.

	  This is the Asus Chromebox CN60 released in 2014. It uses an Intel
	  Haswell Celeron 2955U Dual Core CPU with 2GB of SDRAM. It has a
	  Lynx Point platform controller hub, PCIe WiFi and Bluetooth. It also
	  includes a USB SD reader, four USB3 ports, display port and HDMI
	  video output and a 16GB SATA solid state drive. There is no Chrome
	  OS EC on this model.

config TARGET_CHROMEBOOK_SAMUS
	bool "Chromebook samus"
	help
	  This is the Chromebook Pixel released in 2015. It uses an Intel
	  Broadwell U Core i5 or Core i7 CPU with either 8GB or 16GB of
	  LPDDR3 SDRAM. It has PCIe WiFi and Bluetooth. It also includes a
	  720p webcam, USB SD reader, microphone and speakers, 2 USB 3 Type
	  C ports which can support charging and up to a 4K external display.
	  There is a solid state drive, either 32GB or 64GB. There is a
	  Chrome OS EC connected on LPC, and it provides a 2560x1700 high
	  resolution touch-enabled LCD display.

endchoice

source "board/google/chromebook_link/Kconfig"
source "board/google/chromebox_panther/Kconfig"
source "board/google/chromebook_samus/Kconfig"

endif
```

## board/google/chromebook_jerry/Kconfig
```kconfig
if TARGET_CHROMEBOOK_JERRY

config SYS_BOARD
	default "chromebook_jerry"

config SYS_VENDOR
	default "google"

config SYS_CONFIG_NAME
	default "chromebook_jerry"

config BOARD_SPECIFIC_OPTIONS # dummy
	def_bool y

endif
```

## board/google/chromebook_link/Kconfig
```kconfig
if TARGET_CHROMEBOOK_LINK

config SYS_BOARD
	default "chromebook_link"

config SYS_VENDOR
	default "google"

config SYS_SOC
	default "ivybridge"

config SYS_CONFIG_NAME
	default "chromebook_link"

config SYS_TEXT_BASE
	default 0xfff00000

config BOARD_SPECIFIC_OPTIONS # dummy
	def_bool y
	select X86_RESET_VECTOR
	select CPU_INTEL_SOCKET_RPGA989
	select NORTHBRIDGE_INTEL_IVYBRIDGE
	select SOUTHBRIDGE_INTEL_C216
	select HAVE_ACPI_RESUME
	select BOARD_ROMSIZE_KB_8192

config PCIE_ECAM_BASE
	default 0xf0000000

config EARLY_POST_CROS_EC
	bool "Enable early post to Chrome OS EC"
	default y

config SYS_CAR_ADDR
	hex
	default 0xff7e0000

config SYS_CAR_SIZE
	hex
	default 0x20000

endif
```
