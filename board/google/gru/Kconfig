## board/google/gru/Kconfig
```kconfig
if TARGET_CHROMEBOOK_BOB

config SYS_BOARD
	default "gru"

config SYS_VENDOR
	default "google"

config SYS_CONFIG_NAME
	default "gru"

endif

if TARGET_CHROMEBOOK_KEVIN

config SYS_BOARD
	default "gru"

config SYS_VENDOR
	default "google"

config SYS_CONFIG_NAME
	default "gru"

endif
```

## board/google/imx8mq_phanbell/Kconfig
```kconfig
if TARGET_IMX8MQ_PHANBELL

config SYS_BOARD
	default "imx8mq_phanbell"

config SYS_VENDOR
	default "google"

config SYS_CONFIG_NAME
	default "imx8mq_phanbell"

config IMX_CONFIG
	default "board/google/imx8mq_phanbell/imximage.cfg"

endif
```

## board/google/veyron/Kconfig
```kconfig
if TARGET_CHROMEBOOK_JERRY

config SYS_BOARD
	default "veyron"

config SYS_VENDOR
	default "google"

config SYS_CONFIG_NAME
	default "veyron"

endif

if TARGET_CHROMEBIT_MICKEY

config SYS_BOARD
	default "veyron"

config SYS_VENDOR
	default "google"

config SYS_CONFIG_NAME
	default "veyron"

endif

if TARGET_CHROMEBOOK_MINNIE

config SYS_BOARD
	default "veyron"

config SYS_VENDOR
	default "google"

config SYS_CONFIG_NAME
	default "veyron"

endif

if TARGET_CHROMEBOOK_SPEEDY

config SYS_BOARD
	default "veyron"

config SYS_VENDOR
	default "google"

config SYS_CONFIG_NAME
	default "veyron"

endif
```

## board/gumstix/duovero/Kconfig
```kconfig
if TARGET_DUOVERO

config SYS_BOARD
	string
	default "duovero"

config SYS_VENDOR
	string
	default "gumstix"

config SYS_CONFIG_NAME
	string
	default "duovero"

endif
```

## board/gumstix/pepper/Kconfig
```kconfig
if TARGET_PEPPER

config SYS_BOARD
	default "pepper"

config SYS_VENDOR
	default "gumstix"

config SYS_SOC
	default "am33xx"

config SYS_CONFIG_NAME
	default "pepper"

config DM
	default y

config DM_GPIO
	default y

config DM_SERIAL
	default y

endif
```

## board/gw8260/Kconfig
```kconfig
if TARGET_GW8260

config SYS_BOARD
	default "gw8260"

config SYS_CONFIG_NAME
	default "gw8260"

endif
```

## board/h2200/Kconfig
```kconfig
if TARGET_H2200

config SYS_CPU
	default "pxa"

config SYS_BOARD
	default "h2200"

config SYS_CONFIG_NAME
	default "h2200"

endif
```

## board/hale/tt01/Kconfig
```kconfig
if TARGET_TT01

config SYS_CPU
	default "arm1136"

config SYS_BOARD
	default "tt01"

config SYS_VENDOR
	default "hale"

config SYS_SOC
	default "mx31"

config SYS_CONFIG_NAME
	default "tt01"

endif
```

## board/hardkernel/odroid-c2/Kconfig
```kconfig
if TARGET_ODROID_C2

config SYS_BOARD
	default "odroid-c2"

config SYS_VENDOR
	default "hardkernel"

config SYS_CONFIG_NAME
	default "odroid-c2"

endif
```

## board/hardkernel/odroid_go2/Kconfig
```kconfig
if TARGET_ODROID_GO2

config SYS_BOARD
	default "odroid_go2"

config SYS_VENDOR
	default "hardkernel"

config SYS_CONFIG_NAME
	default "odroid_go2"

config BOARD_SPECIFIC_OPTIONS # dummy
	def_bool y
	select ADC
	select BOARD_TYPES
	select ENV_IS_NOWHERE
	select SPL_ADC

endif
```

## board/hardkernel/odroid_m1s/Kconfig
```kconfig
if TARGET_ODROID_M1S_RK3566

config SYS_BOARD
	default "odroid_m1s"

config SYS_VENDOR
	default "hardkernel"

config SYS_CONFIG_NAME
	default "odroid_m1"

endif
```

## board/hardkernel/odroid_m2/Kconfig
```kconfig
if TARGET_ODROID_M2_RK3588S

config SYS_BOARD
	default "odroid_m2"

config SYS_VENDOR
	default "hardkernel"

config SYS_CONFIG_NAME
	default "odroid_m2"

endif
```

## board/hermes/Kconfig
```kconfig
if TARGET_HERMES

config SYS_BOARD
	default "hermes"

config SYS_CONFIG_NAME
	default "hermes"

endif
```

## board/highbank/Kconfig
```kconfig
if TARGET_HIGHBANK

config SYS_CPU
	string
	default "armv7"

config SYS_BOARD
	string
	default "highbank"

config SYS_SOC
	string
	default "highbank"

config SYS_CONFIG_NAME
	string
	default "highbank"

endif
```

## board/hisilicon/hikey/Kconfig
```kconfig
if TARGET_HIKEY

config SYS_BOARD
	default "hikey"

config SYS_VENDOR
	default "hisilicon"

config SYS_SOC
	default "hi6220"

config SYS_CONFIG_NAME
	default "hikey"

config CONS_INDEX
	int "UART used for console"
	range 1 4
	default 4
	help
	  The hi6220 SoC has 5 UARTs. For example to use UART0 enter 1 here.

endif
```

## board/htc/endeavoru/Kconfig
```kconfig
if TARGET_ENDEAVORU

config SYS_BOARD
	default "endeavoru"

config SYS_VENDOR
	default "htc"

config TEGRA_BOARD_STRING
	string "Default Tegra board name"
	default "HTC One X"

endif
```

## board/htkw/mcx/Kconfig
```kconfig
if TARGET_MCX

config SYS_BOARD
	default "mcx"

config SYS_VENDOR
	default "htkw"

config SYS_CONFIG_NAME
	default "mcx"

endif
```

## board/hymod/Kconfig
```kconfig
if TARGET_HYMOD

config SYS_BOARD
	default "hymod"

config SYS_CONFIG_NAME
	default "hymod"

endif
```

## board/ibf-dsp561/Kconfig
```kconfig
if TARGET_IBF_DSP561

config SYS_BOARD
	default "ibf-dsp561"

config SYS_CONFIG_NAME
	default "ibf-dsp561"

endif
```

## board/icecube/Kconfig
```kconfig
if TARGET_ICECUBE

config SYS_BOARD
	default "icecube"

config SYS_CONFIG_NAME
	default "IceCube"

endif
```

## board/icpdas/lp8x4x/Kconfig
```kconfig
if TARGET_LP8X4X

config SYS_BOARD
	default "lp8x4x"

config SYS_VENDOR
	default "icpdas"

config SYS_CONFIG_NAME
	default "lp8x4x"

endif
```

## board/icu862/Kconfig
```kconfig
if TARGET_ICU862

config SYS_BOARD
	default "icu862"

config SYS_CONFIG_NAME
	default "ICU862"

endif
```

## board/ids/ids8247/Kconfig
```kconfig
if TARGET_IDS8247

config SYS_BOARD
	default "ids8247"

config SYS_VENDOR
	default "ids"

config SYS_CONFIG_NAME
	default "IDS8247"

endif
```

## board/ids/ids8313/Kconfig
```kconfig
if TARGET_IDS8313

config SYS_BOARD
	string
	default "ids8313"

config SYS_VENDOR
	string
	default "ids"

config SYS_CONFIG_NAME
	string
	default "ids8313"

endif
```

## board/ifm/ac14xx/Kconfig
```kconfig
if TARGET_AC14XX

config SYS_BOARD
	default "ac14xx"

config SYS_VENDOR
	default "ifm"

config SYS_CONFIG_NAME
	default "ac14xx"

endif
```
