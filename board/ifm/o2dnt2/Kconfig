## board/ifm/o2dnt2/Kconfig
```kconfig
if TARGET_O2D

config SYS_BOARD
	default "o2dnt2"

config SYS_VENDOR
	default "ifm"

config SYS_CONFIG_NAME
	default "o2d"

endif

if TARGET_O2D300

config SYS_BOARD
	default "o2dnt2"

config SYS_VENDOR
	default "ifm"

config SYS_CONFIG_NAME
	default "o2d300"

endif

if TARGET_O2DNT2

config SYS_BOARD
	default "o2dnt2"

config SYS_VENDOR
	default "ifm"

config SYS_CONFIG_NAME
	default "o2dnt2"

endif

if TARGET_O2I

config SYS_BOARD
	default "o2dnt2"

config SYS_VENDOR
	default "ifm"

config SYS_CONFIG_NAME
	default "o2i"

endif

if TARGET_O2MNT

config SYS_BOARD
	default "o2dnt2"

config SYS_VENDOR
	default "ifm"

config SYS_CONFIG_NAME
	default "o2mnt"

endif

if TARGET_O3DNT

config SYS_BOARD
	default "o2dnt2"

config SYS_VENDOR
	default "ifm"

config SYS_CONFIG_NAME
	default "o3dnt"

endif
```

## board/imgtec/malta/Kconfig
```kconfig
if TARGET_MALTA

config SYS_BOARD
	default "malta"

config SYS_VENDOR
	default "imgtec"

config SYS_CONFIG_NAME
	default "malta"

endif
```

## board/imx31_phycore/Kconfig
```kconfig
if TARGET_IMX31_PHYCORE || TARGET_IMX31_PHYCORE_EET

config SYS_BOARD
	default "imx31_phycore"

config SYS_SOC
	default "mx31"

config SYS_CONFIG_NAME
	default "imx31_phycore"

endif
```

## board/in-circuit/grasshopper/Kconfig
```kconfig
if TARGET_GRASSHOPPER

config SYS_BOARD
	default "grasshopper"

config SYS_VENDOR
	default "in-circuit"

config SYS_SOC
	default "at32ap700x"

config SYS_CONFIG_NAME
	default "grasshopper"

endif
```

## board/indiedroid/nova/Kconfig
```kconfig
if TARGET_NOVA_RK3588

config SYS_BOARD
	default "nova-rk3588s"

config SYS_VENDOR
	default "indiedroid"

config SYS_CONFIG_NAME
	default "nova-rk3588s"

endif
```

## board/inka4x0/Kconfig
```kconfig
if TARGET_INKA4X0

config SYS_BOARD
	default "inka4x0"

config SYS_CONFIG_NAME
	default "inka4x0"

endif
```

## board/intel/crownbay/Kconfig
```kconfig
if TARGET_CROWNBAY

config SYS_BOARD
	default "crownbay"

config SYS_VENDOR
	default "intel"

config SYS_SOC
	default "queensbay"

config SYS_CONFIG_NAME
	default "crownbay"

config BOARD_SPECIFIC_OPTIONS # dummy
	def_bool y
	select INTEL_QUEENSBAY
	select BOARD_ROMSIZE_KB_1024

endif
```

## board/intel/edison/Kconfig
```kconfig
if TARGET_EDISON

config SYS_BOARD
	default "edison"

config SYS_VENDOR
	default "intel"

config SYS_SOC
	default "tangier"

config SYS_CONFIG_NAME
	default "edison"

config SYS_TEXT_BASE
	default 0x01101000

config BOARD_SPECIFIC_OPTIONS # dummy
	def_bool y
	select X86_LOAD_FROM_32_BIT
	select INTEL_MID
	select INTEL_TANGIER
	select BOARD_LATE_INIT
	select MD5

endif
```

## board/intercontrol/digsy_mtc/Kconfig
```kconfig
if TARGET_DIGSY_MTC

config SYS_BOARD
	default "digsy_mtc"

config SYS_VENDOR
	default "intercontrol"

config SYS_CONFIG_NAME
	default "digsy_mtc"

endif
```

## board/iomega/iconnect/Kconfig
```kconfig
if TARGET_ICONNECT

config SYS_BOARD
	string
	default "iconnect"

config SYS_VENDOR
	string
	default "iomega"

config SYS_CONFIG_NAME
	string
	default "iconnect"

endif
```

## board/ip04/Kconfig
```kconfig
if TARGET_IP04

config SYS_BOARD
	default "ip04"

config SYS_CONFIG_NAME
	default "ip04"

endif
```

## board/ip860/Kconfig
```kconfig
if TARGET_IP860

config SYS_BOARD
	default "ip860"

config SYS_CONFIG_NAME
	default "IP860"

endif
```

## board/ipek01/Kconfig
```kconfig
if TARGET_IPEK01

config SYS_BOARD
	default "ipek01"

config SYS_CONFIG_NAME
	default "ipek01"

endif
```

## board/iphase4539/Kconfig
```kconfig
if TARGET_IPHASE4539

config SYS_BOARD
	default "iphase4539"

config SYS_CONFIG_NAME
	default "IPHASE4539"

endif
```

## board/isee/igep0033/Kconfig
```kconfig
if TARGET_AM335X_IGEP0033

config SYS_BOARD
	default "igep0033"

config SYS_VENDOR
	default "isee"

config SYS_SOC
	default "am33xx"

config SYS_CONFIG_NAME
	default "am335x_igep0033"

config DM
	default y

config DM_GPIO
	default y

config DM_SERIAL
	default y

endif
```

## board/isee/igep00x0/Kconfig
```kconfig
if TARGET_OMAP3_IGEP00X0

config SYS_BOARD
	string
	default "igep00x0"

config SYS_VENDOR
	string
	default "isee"

config SYS_CONFIG_NAME
	string
	default "omap3_igep00x0"

endif
```

## board/ivm/Kconfig
```kconfig
if TARGET_IVML24

config SYS_BOARD
	default "ivm"

config SYS_CONFIG_NAME
	default "IVML24"

endif

if TARGET_IVMS8

config SYS_BOARD
	default "ivm"

config SYS_CONFIG_NAME
	default "IVMS8"

endif
```

## board/jornada/Kconfig
```kconfig
if TARGET_JORNADA

config SYS_BOARD
	default "jornada"

config SYS_CONFIG_NAME
	default "jornada"

endif
```

## board/jse/Kconfig
```kconfig
if TARGET_JSE

config SYS_BOARD
	default "jse"

config SYS_CONFIG_NAME
	default "JSE"

endif
```

## board/jupiter/Kconfig
```kconfig
if TARGET_JUPITER

config SYS_BOARD
	default "jupiter"

config SYS_CONFIG_NAME
	default "jupiter"

endif
```

## board/karo/tk71/Kconfig
```kconfig
if TARGET_TK71

config SYS_BOARD
	default "tk71"

config SYS_VENDOR
	default "karo"

config SYS_CONFIG_NAME
	default "tk71"

endif
```

## board/karo/tx25/Kconfig
```kconfig
if TARGET_TX25

config SYS_BOARD
	default "tx25"

config SYS_VENDOR
	default "karo"

config SYS_SOC
	default "mx25"

config SYS_CONFIG_NAME
	default "tx25"

endif
```

## board/keymile/Kconfig
```kconfig
# SPDX-License-Identifier: GPL-2.0+
#
# Copyright (C) 2019, Pascal Linder <pascal.linder@edu.hefr.ch>

config VENDOR_KM
	bool
	help
	  Selected by any KM board to have additional configurations.

if VENDOR_KM

menu "KM Board Setup"

config KM_PNVRAM
	hex "Pseudo RAM"
	default 0x80000
	depends on !ARCH_SOCFPGA
	help
	  Start address of the pseudo non-volatile RAM for application.

config KM_PHRAM
	hex "Physical RAM"
	default 0x17F000 if ARM && !ARCH_LS1021A
	default 0x100000 if PPC || ARCH_LS1021A
	depends on !ARCH_SOCFPGA
	help
	  Start address of the physical RAM, which is the mounted /var folder.

config KM_RESERVED_PRAM
	hex "Reserved RAM"
	default 0x801000 if ARCH_KIRKWOOD
	default 0x0 if MPC83xx
	default 0x1000 if MPC85xx || ARCH_LS1021A
	depends on !ARCH_SOCFPGA
	help
	  Reserved physical RAM area at the end of memory for special purposes.

config KM_CRAMFS_ADDR
	hex "CRAMFS Address"
	default 0x83000000 if ARCH_LS1021A
	default 0x3000000
	depends on !ARCH_SOCFPGA
	help
	  Start address of the CRAMFS containing the Linux kernel.

config KM_KERNEL_ADDR
	hex "Kernel Load Address"
	default 0x82000000 if ARCH_LS1021A
	default 0x2000000
	help
	  Address where to load Linux kernel in RAM.

config KM_FDT_ADDR
	hex "FDT Load Address"
	default 0x82FC0000 if ARCH_LS1021A
	default 0x2FC0000
	help
	  Address where to load flattened device tree in RAM.

config SYS_PAX_BASE
	hex "PAX IFC Base Address"
	default 0x78000000
	depends on ARCH_LS1021A
	help
	  IFC Base Address for PAXx FPGA.

config SYS_CLIPS_BASE
	hex "CLIPS IFC Base Address"
	default 0x78000000
	depends on ARCH_LS1021A
	help
	  IFC Base Address for CLIPS FPGA.

config KM_CONSOLE_TTY
	string "KM Console"
	default "ttyS0"
	help
	  TTY console to use on board.

config KM_DEF_NETDEV
	string "Default Netdevice"
	default "eth0"
	help
	  Default netdevice for debug interface

config KM_COMMON_ETH_INIT
	bool "Common Ethernet Initialization"
	default y if ARCH_KIRKWOOD || MPC83xx
	default n if MPC85xx || ARCH_SOCFPGA || ARCH_LS1021A
	help
	  Use the Ethernet initialization implemented in common code that
	  detects if a Piggy board is present.

config PIGGY_MAC_ADDRESS_OFFSET
	int "Piggy Address Offset"
	default 0
	help
	  MAC address offset for the Piggy board.

config KM_MVEXTSW_ADDR
	hex "Marvell Switch Address"
	depends on MV88E6352_SWITCH
	default 0x10
	help
	  Address of external Marvell switch.

config KM_IVM_BUS
	int "IVM I2C Bus"
	default 0 if ARCH_SOCFPGA
	default 1 if ARCH_KIRKWOOD || MPC85xx || ARCH_LS1021A
	default 2 if MPC83xx
	help
	  Identifier number of I2C bus, where the inventory EEPROM is connected to.

config SYS_IVM_EEPROM_ADR
	hex "IVM I2C Address"
	default 0x50
	help
	  I2C address of the EEPROM containing the inventory.

config SYS_IVM_EEPROM_MAX_LEN
	hex "IVM Length"
	default 0x400
	help
	  Maximum length of inventory in EEPROM.

config SYS_IVM_EEPROM_PAGE_LEN
	hex "IVM Page Size"
	default 0x100
	help
	  Page size of inventory in EEPROM.

source "board/keymile/km83xx/Kconfig"
source "board/keymile/kmcent2/Kconfig"
source "board/keymile/km_arm/Kconfig"
source "board/keymile/pg-wcom-ls102xa/Kconfig"

endmenu

endif
```

## board/keymile/km82xx/Kconfig
```kconfig
if TARGET_KM82XX

config SYS_BOARD
	default "km82xx"

config SYS_VENDOR
	default "keymile"

config SYS_CONFIG_NAME
	default "km82xx"

endif
```

## board/keymile/km83xx/Kconfig
```kconfig
if TARGET_KMETER1

config SYS_BOARD
	default "km83xx"

config SYS_VENDOR
	default "keymile"

config SYS_CONFIG_NAME
	default "kmeter1"

config BOARD_SPECIFIC_OPTIONS # dummy
	def_bool y
	select ARCH_MPC8360
	imply CMD_CRAMFS
	imply CMD_DIAG
	imply FS_CRAMFS

endif

if TARGET_KMCOGE5NE

config SYS_BOARD
	default "km83xx"

config SYS_VENDOR
	default "keymile"

config SYS_CONFIG_NAME
	default "kmcoge5ne"

config BOARD_SPECIFIC_OPTIONS # dummy
	def_bool y
	select ARCH_MPC8360
	imply CMD_CRAMFS
	imply CMD_DIAG
	imply FS_CRAMFS

endif

if TARGET_KMVECT1

config SYS_BOARD
	default "km83xx"

config SYS_VENDOR
	default "keymile"

config SYS_CONFIG_NAME
	default "kmvect1"

config BOARD_SPECIFIC_OPTIONS # dummy
	def_bool y
	select ARCH_MPC8309
	imply CMD_CRAMFS
	imply FS_CRAMFS

endif

if TARGET_KMTEGR1

config SYS_BOARD
	default "km83xx"

config SYS_VENDOR
	default "keymile"

config SYS_CONFIG_NAME
	default "kmtegr1"

config BOARD_SPECIFIC_OPTIONS # dummy
	def_bool y
	select ARCH_MPC8309
	imply CMD_CRAMFS
	imply FS_CRAMFS

endif

if TARGET_SUVD3

config SYS_BOARD
	default "km83xx"

config SYS_VENDOR
	default "keymile"

config SYS_CONFIG_NAME
	default "suvd3"

config BOARD_SPECIFIC_OPTIONS # dummy
	def_bool y
	select ARCH_MPC832X
	imply CMD_CRAMFS
	imply FS_CRAMFS

endif

if TARGET_TUXX1

config SYS_BOARD
	default "km83xx"

config SYS_VENDOR
	default "keymile"

config SYS_CONFIG_NAME
	default "tuxx1"

config BOARD_SPECIFIC_OPTIONS # dummy
	def_bool y
	select ARCH_MPC832X
	imply CMD_CRAMFS
	imply FS_CRAMFS

endif

if TARGET_KMSUPX5

config SYS_BOARD
	default "km83xx"

config SYS_VENDOR
	default "keymile"

config SYS_CONFIG_NAME
	default "kmsupx5"

config BOARD_SPECIFIC_OPTIONS # dummy
	def_bool y
	select ARCH_MPC832X
	imply CMD_CRAMFS
	imply FS_CRAMFS

endif

if TARGET_TUGE1

config SYS_BOARD
	default "km83xx"

config SYS_VENDOR
	default "keymile"

config SYS_CONFIG_NAME
	default "tuge1"

config BOARD_SPECIFIC_OPTIONS # dummy
	def_bool y
	select ARCH_MPC832X
	imply CMD_CRAMFS
	imply FS_CRAMFS

endif

if TARGET_KMOPTI2

config SYS_BOARD
	default "km83xx"

config SYS_VENDOR
	default "keymile"

config SYS_CONFIG_NAME
	default "kmopti2"

config BOARD_SPECIFIC_OPTIONS # dummy
	def_bool y
	select ARCH_MPC832X
	imply CMD_CRAMFS
	imply FS_CRAMFS

endif

if TARGET_KMTEPR2

config SYS_BOARD
	default "km83xx"

config SYS_VENDOR
	default "keymile"

config SYS_CONFIG_NAME
	default "kmtepr2"

config BOARD_SPECIFIC_OPTIONS # dummy
	def_bool y
	select ARCH_MPC832X
	imply CMD_CRAMFS
	imply FS_CRAMFS

endif
```
