## board/keymile/km_arm/Kconfig
```kconfig
menu "KM ARM Options"
	depends on ARM

config KM_FPGA_CONFIG
	bool "FPGA Configuration"
	help
	  Include capability to change FPGA configuration.

config KM_FPGA_FORCE_CONFIG
	bool "FPGA reconfiguration"
	help
	  If yes we force to reconfigure the FPGA always

config KM_FPGA_NO_RESET
	bool "FPGA skip reset"
	help
	  If yes we skip triggering a reset of the FPGA

config KM_ENV_IS_IN_SPI_NOR
	bool "Environment in SPI NOR"
	help
	  Put the U-Boot environment in the SPI NOR flash.

config KM_PIGGY4_88E6061
	bool "Piggy via Switch 88E6061"
	help
	  The Piggy4 board is connected via a Marvell 88E6061 switch.

config KM_PIGGY4_88E6352
	bool "Piggy via Switch 88E6352"
	help
	  The Piggy4 board is connected via a Marvell 88E6352 switch.

endmenu

if TARGET_KM_KIRKWOOD

config SYS_BOARD
	default "km_arm"

config SYS_VENDOR
	default "keymile"

config SYS_CONFIG_NAME
	default "km_kirkwood"

config BOARD_SPECIFIC_OPTIONS # dummy
	def_bool y
	select BOARD_LATE_INIT
	select DM
	select DM_ETH
	select DM_SERIAL
	select DM_SPI
	select DM_SPI_FLASH
	select USB
	select USB_EHCI_HCD
	select USB_EHCI_MARVELL
	imply CMD_CRAMFS
	imply CMD_DIAG
	imply FS_CRAMFS
	imply CMD_USB

choice
	prompt "Board model"

config KM_COGE5UN
	bool "Hitachi Power Grids COGE5UN"

config KM_KIRKWOOD_128M16
	bool "Hitachi Power Grids Kirkwood 128M16"

config KM_KIRKWOOD
	bool "Hitachi Power Grids Kirkwood"

config KM_KIRKWOOD_PCI
	bool "Hitachi Power Grids Kirkwood PCI"

config KM_NUSA
	bool "Hitachi Power Grids Kirkwood (NUSA)"

config KM_SUSE2
	bool "Hitachi Power Grids Kirkwood (SUSE2)"

endchoice

endif
```

## board/keymile/kmp204x/Kconfig
```kconfig
if TARGET_KMP204X

config SYS_BOARD
	default "kmp204x"

config SYS_VENDOR
	default "keymile"

config SYS_CONFIG_NAME
	default "kmp204x"

config BOARD_SPECIFIC_OPTIONS # dummy
	def_bool y
	select ARCH_P2041
	select FSL_DDR_INTERACTIVE
	select PHYS_64BIT
	imply CMD_CRAMFS
	imply FS_CRAMFS

endif
```

## board/khadas/khadas-edge2-rk3588s/Kconfig
```kconfig
if TARGET_KHADAS_EDGE2_RK3588

config SYS_BOARD
	default "khadas-edge2-rk3588s"

config SYS_VENDOR
	default "khadas"

config SYS_CONFIG_NAME
	default "khadas-edge2-rk3588s"

endif
```

## board/kmc/kzm9g/Kconfig
```kconfig
if TARGET_KZM9G

config SYS_BOARD
	string
	default "kzm9g"

config SYS_VENDOR
	string
	default "kmc"

config SYS_CONFIG_NAME
	string
	default "kzm9g"

endif
```

## board/kontron/common/Kconfig
```kconfig
menuconfig KONTRON_HW_UID
	bool "Enable reading Kontron HW UID from OTP fuses"
	help
	  Enable support for reading Kontron hardware UIDs from OTP fuse registers.
	  The UIDs are factory-programmed for SoMs and boards and are printed to the
	  console and used as serial numbers if this option is enabled.

menuconfig KONTRON_HW_UID_USE_SOC_FALLBACK
	bool "Use the unique ID of the SoC as fallback serial number"
	depends on KONTRON_HW_UID
	default n
	help
	  Enable the fallback to the UID of the SoC programmed by the SoC
	  manufacturer if no Kontron UID is found in the OTP fuses.
```

## board/kontron/osm-s-mx8mp/Kconfig
```kconfig
if TARGET_KONTRON_MX8MP

config SYS_BOARD
	string
	default "osm-s-mx8mp"

config SYS_VENDOR
	string
	default "kontron"

config SYS_CONFIG_NAME
	string
	default "kontron-osm-s-mx8mp"

source "board/kontron/common/Kconfig"

endif
```

## board/kontron/osm-s-mx93/Kconfig
```kconfig
if TARGET_KONTRON_MX93

config SYS_BOARD
	string
	default "osm-s-mx93"

config SYS_VENDOR
	string
	default "kontron"

config SYS_CONFIG_NAME
	string
	default "kontron-osm-s-mx93"

source "board/kontron/common/Kconfig"

endif
```

## board/kontron/sl-mx6ul/Kconfig
```kconfig
if TARGET_KONTRON_MX6UL

config SYS_BOARD
	default "sl-mx6ul"

config SYS_VENDOR
	default "kontron"

config SYS_CONFIG_NAME
	default "kontron-sl-mx6ul"

endif
```

## board/kontron/sl-mx8mm/Kconfig
```kconfig
if TARGET_KONTRON_MX8MM

config SYS_BOARD
	default "sl-mx8mm"

config SYS_VENDOR
	default "kontron"

config SYS_CONFIG_NAME
	default "kontron-sl-mx8mm"

endif
```

## board/kontron/sl28/Kconfig
```kconfig
if TARGET_SL28

config SYS_BOARD
	default "sl28"

config SYS_VENDOR
	default "kontron"

config SYS_SOC
	default "fsl-layerscape"

config SYS_CONFIG_NAME
	default "kontron_sl28"

config SYS_TEXT_BASE
	default 0x96000000

config SL28_SPL_LOADS_ATF_BL31
	bool "SPL loads BL31 of the ARM Trusted Firmware"
	select SPL_ATF
	select SPL_ATF_LOAD_IMAGE_V2
	select ARMV8_SEC_FIRMWARE_SUPPORT
	select SEC_FIRMWARE_ARMV8_PSCI
	help
	  Enable this to load a BL31 image by the SPL. You have to
	  provde a bl31.bin in u-boot's root directory.

endif
```

## board/korat/Kconfig
```kconfig
if TARGET_KORAT

config SYS_BOARD
	default "korat"

config SYS_CONFIG_NAME
	default "korat"

endif
```

## board/kosagi/novena/Kconfig
```kconfig
if TARGET_KOSAGI_NOVENA

config SYS_BOARD
	default "novena"

config SYS_VENDOR
	default "kosagi"

config SYS_SOC
	default "mx6"

config SYS_CONFIG_NAME
	default "novena"

endif
```

## board/kup/kup4k/Kconfig
```kconfig
if TARGET_KUP4K

config SYS_BOARD
	default "kup4k"

config SYS_VENDOR
	default "kup"

config SYS_CONFIG_NAME
	default "KUP4K"

endif
```

## board/kup/kup4x/Kconfig
```kconfig
if TARGET_KUP4X

config SYS_BOARD
	default "kup4x"

config SYS_VENDOR
	default "kup"

config SYS_CONFIG_NAME
	default "KUP4X"

endif
```

## board/lenovo/ideapad-yoga-11/Kconfig
```kconfig
if TARGET_IDEAPAD_YOGA_11

config SYS_BOARD
	default "ideapad-yoga-11"

config SYS_VENDOR
	default "lenovo"

config TEGRA_BOARD_STRING
	string "Default Tegra board name"
	default "Lenovo Ideapad Yoga 11"

endif
```

## board/lg/star/Kconfig
```kconfig
if TARGET_STAR

config SYS_BOARD
	default "star"

config SYS_VENDOR
	default "lg"

config TEGRA_BOARD_STRING
	string "Default Tegra board name"
	default "LG Star"

endif
```

## board/lg/x3-t30/Kconfig
```kconfig
if TARGET_X3_T30

config SYS_BOARD
	default "x3-t30"

config SYS_VENDOR
	default "lg"

config TEGRA_BOARD_STRING
	string "Default Tegra board name"
	default "LG X3 Board"

endif
```

## board/lge/sniper/Kconfig
```kconfig
if TARGET_SNIPER

config SYS_BOARD
	default "sniper"

config SYS_VENDOR
	default "lge"

config SYS_CONFIG_NAME
	default "sniper"

endif
```

## board/liebherr/btt/Kconfig
```kconfig
if TARGET_BTT

config SYS_BOARD
	default "btt"

config SYS_VENDOR
	default "liebherr"

config SYS_SOC
	default "mxs"

config SYS_CONFIG_NAME
	default "btt"

config ENV_SIZE
	default 0x2000

config ENV_SECT_SIZE
	default 0x10000 if ENV_IS_IN_SPI_FLASH

config ENV_OFFSET
	default 0x80000 if ENV_IS_IN_SPI_FLASH

endif
```

## board/liebherr/lwmon5/Kconfig
```kconfig
if TARGET_LWMON5

config SYS_BOARD
	default "lwmon5"

config SYS_VENDOR
	default "liebherr"

config SYS_CONFIG_NAME
	default "lwmon5"

config DISPLAY_BOARDINFO
	bool
	default y

endif
```

## board/logicpd/am3517evm/Kconfig
```kconfig
if TARGET_AM3517_EVM

config SYS_BOARD
	string
	default "am3517evm"

config SYS_VENDOR
	string
	default "logicpd"

config SYS_CONFIG_NAME
	string
	default "am3517_evm"

endif
```

## board/logicpd/imx27lite/Kconfig
```kconfig
if TARGET_IMX27LITE

config SYS_BOARD
	default "imx27lite"

config SYS_VENDOR
	default "logicpd"

config SYS_SOC
	default "mx27"

config SYS_CONFIG_NAME
	default "imx27lite"

endif

if TARGET_MAGNESIUM

config SYS_BOARD
	default "imx27lite"

config SYS_VENDOR
	default "logicpd"

config SYS_SOC
	default "mx27"

config SYS_CONFIG_NAME
	default "magnesium"

endif
```

## board/logicpd/imx31_litekit/Kconfig
```kconfig
if TARGET_IMX31_LITEKIT

config SYS_BOARD
	default "imx31_litekit"

config SYS_VENDOR
	default "logicpd"

config SYS_SOC
	default "mx31"

config SYS_CONFIG_NAME
	default "imx31_litekit"

endif
```

## board/logicpd/omap3som/Kconfig
```kconfig
if TARGET_OMAP3_LOGIC

config SYS_BOARD
	string
	default "omap3som"

config SYS_VENDOR
	string
	default "logicpd"

config SYS_CONFIG_NAME
	string
	default "omap3_logic"

endif
```

## board/logicpd/zoom1/Kconfig
```kconfig
if TARGET_OMAP3_ZOOM1

config SYS_BOARD
	string
	default "zoom1"

config SYS_VENDOR
	string
	default "logicpd"

config SYS_CONFIG_NAME
	string
	default "omap3_zoom1"

endif
```
