## board/lwmon/Kconfig
```kconfig
if TARGET_LWMON

config SYS_BOARD
	default "lwmon"

config SYS_CONFIG_NAME
	default "lwmon"

endif
```

## board/lwmon5/Kconfig
```kconfig
if TARGET_LWMON5

config SYS_BOARD
	default "lwmon5"

config SYS_CONFIG_NAME
	default "lwmon5"

endif
```

## board/manroland/hmi1001/Kconfig
```kconfig
if TARGET_HMI1001

config SYS_BOARD
	default "hmi1001"

config SYS_VENDOR
	default "manroland"

config SYS_CONFIG_NAME
	default "hmi1001"

endif
```

## board/manroland/mucmc52/Kconfig
```kconfig
if TARGET_MUCMC52

config SYS_BOARD
	default "mucmc52"

config SYS_VENDOR
	default "manroland"

config SYS_CONFIG_NAME
	default "mucmc52"

endif
```

## board/manroland/uc100/Kconfig
```kconfig
if TARGET_UC100

config SYS_BOARD
	default "uc100"

config SYS_VENDOR
	default "manroland"

config SYS_CONFIG_NAME
	default "uc100"

endif
```

## board/manroland/uc101/Kconfig
```kconfig
if TARGET_UC101

config SYS_BOARD
	default "uc101"

config SYS_VENDOR
	default "manroland"

config SYS_CONFIG_NAME
	default "uc101"

endif
```

## board/matrix_vision/mergerbox/Kconfig
```kconfig
if TARGET_MERGERBOX

config SYS_BOARD
	default "mergerbox"

config SYS_VENDOR
	default "matrix_vision"

config SYS_CONFIG_NAME
	default "MERGERBOX"

endif
```

## board/matrix_vision/mvbc_p/Kconfig
```kconfig
if TARGET_MVBC_P

config SYS_BOARD
	default "mvbc_p"

config SYS_VENDOR
	default "matrix_vision"

config SYS_CONFIG_NAME
	default "MVBC_P"

endif
```

## board/matrix_vision/mvblm7/Kconfig
```kconfig
if TARGET_MVBLM7

config SYS_BOARD
	default "mvblm7"

config SYS_VENDOR
	default "matrix_vision"

config SYS_CONFIG_NAME
	default "MVBLM7"

endif
```

## board/matrix_vision/mvblx/Kconfig
```kconfig
if TARGET_OMAP3_MVBLX

config SYS_BOARD
	default "mvblx"

config SYS_VENDOR
	default "matrix_vision"

config SYS_CONFIG_NAME
	default "omap3_mvblx"

endif
```

## board/matrix_vision/mvsmr/Kconfig
```kconfig
if TARGET_MVSMR

config SYS_BOARD
	default "mvsmr"

config SYS_VENDOR
	default "matrix_vision"

config SYS_CONFIG_NAME
	default "MVSMR"

endif
```

## board/maxbcm/Kconfig
```kconfig
if TARGET_MAXBCM

config SYS_BOARD
	default "maxbcm"

config SYS_CONFIG_NAME
	default "maxbcm"

endif
```

## board/mcc200/Kconfig
```kconfig
if TARGET_MCC200

config SYS_BOARD
	default "mcc200"

config SYS_CONFIG_NAME
	default "mcc200"

endif
```

## board/mediatek/mt7620/Kconfig
```kconfig
if BOARD_MT7620_RFB || BOARD_MT7620_MT7530_RFB

config SYS_BOARD
	default "mt7620"

config SYS_VENDOR
	default "mediatek"

config SYS_CONFIG_NAME
	default "mt7620"

endif
```

## board/mediatek/mt7622/Kconfig
```kconfig
if TARGET_MT7622

config SYS_BOARD
	default "mt7622"

config SYS_CONFIG_NAME
	default "mt7622"

config MTK_BROM_HEADER_INFO
	string
	default "lk=1"

config MTK_BROM_HEADER_INFO
	string
	default "media=nor"

endif
```

## board/mediatek/mt7628/Kconfig
```kconfig
if BOARD_MT7628_RFB

config SYS_BOARD
	default "mt7628"

config SYS_VENDOR
	default "mediatek"

config SYS_CONFIG_NAME
	default "mt7628"

endif
```

## board/mediatek/mt8183/Kconfig
```kconfig
if TARGET_MT8183

config SYS_BOARD
	default "mt8183"

config SYS_CONFIG_NAME
	default "mt8183"

config MTK_BROM_HEADER_INFO
	string
	default "media=emmc"

endif
```

## board/mediatek/mt8512/Kconfig
```kconfig
if TARGET_MT8512

config SYS_BOARD
	default "mt8512"

config SYS_CONFIG_NAME
	default "mt8512"


config MTK_BROM_HEADER_INFO
	string
	default "media=nor"

endif
```

## board/mediatek/mt8516/Kconfig
```kconfig
if TARGET_MT8516

config SYS_BOARD
	default "mt8516"

config SYS_CONFIG_NAME
	default "mt8516"

config MTK_BROM_HEADER_INFO
	string
	default "media=emmc"

endif
```

## board/mediatek/mt8518/Kconfig
```kconfig
if TARGET_MT8518

config SYS_BOARD
	default "mt8518"

config SYS_CONFIG_NAME
	default "mt8518"


config MTK_BROM_HEADER_INFO
	string
	default "media=nor"

endif
```

## board/mediatek/pumpkin/Kconfig
```kconfig
if TARGET_MT8516

config SYS_BOARD
	default "pumpkin"

config SYS_CONFIG_NAME
	default "pumpkin"

config MTK_BROM_HEADER_INFO
	string
	default "media=emmc"

endif
```

## board/microchip/mpfs_generic/Kconfig
```kconfig
if TARGET_MICROCHIP_GENERIC

config SYS_BOARD
	default "mpfs_generic"

config SYS_VENDOR
	default "microchip"

config SYS_CPU
	default "mpfs"

config SYS_CONFIG_NAME
	default "microchip_mpfs_generic"

config TEXT_BASE
	default 0x80000000 if !RISCV_SMODE
	default 0x80200000 if RISCV_SMODE

config BOARD_SPECIFIC_OPTIONS # dummy
	def_bool y
	select MICROCHIP_MPFS
	select BOARD_EARLY_INIT_F
	select BOARD_LATE_INIT
	imply SMP
	imply CMD_DHCP
	imply CMD_EXT2
	imply CMD_EXT4
	imply CMD_FAT
	imply CMD_FS_GENERIC
	imply CMD_NET
	imply CMD_PING
	imply CMD_MMC
	imply DOS_PARTITION
	imply EFI_PARTITION
	imply IP_DYN
	imply ISO_PARTITION
	imply PHY_LIB
	imply PHY_VITESSE
	imply MTD_SPI_NAND
	imply CMD_MTD
	imply CMD_MTDPARTS
	imply DM_MAILBOX
	imply MPFS_MBOX
	imply MISC
	imply MPFS_SYSCONTROLLER

endif
```

## board/microchip/pic32mzda/Kconfig
```kconfig
if TARGET_PIC32MZDASK

config SYS_BOARD
	default "pic32mzda"

config SYS_VENDOR
	default "microchip"

config SYS_CONFIG_NAME
	default "pic32mzdask"

endif
```

## board/micronas/vct/Kconfig
```kconfig
if TARGET_VCT

config SYS_BOARD
	default "vct"

config SYS_VENDOR
	default "micronas"

config SYS_CONFIG_NAME
	default "vct"

menu "vct board options"

choice
	prompt "Board variant"
	optional

config VCT_PLATINUM
	bool "Enable VCT_PLATINUM"

config VCT_PLATINUMAVC
	bool "Enable VCT_PLATINUMAVC"

config VCT_PREMIUM
	bool "Enable VCT_PLATINUMAVC"

endchoice

config VCT_ONENAND
	bool "Enable VCT_ONENAND"

config VCT_SMALL_IMAGE
	bool "Enable VCT_SMALL_IMAGE"

endmenu

endif
```

## board/microsoft/surface-2/Kconfig
```kconfig
if TARGET_SURFACE_2

config SYS_BOARD
	default "surface-2"

config SYS_VENDOR
	default "microsoft"

config TEGRA_BOARD_STRING
	string "Default Tegra board name"
	default "Microsoft Surface 2"

endif
```
