## board/microsoft/surface-rt/Kconfig
```kconfig
if TARGET_SURFACE_RT

config SYS_BOARD
	default "surface-rt"

config SYS_VENDOR
	default "microsoft"

config TEGRA_BOARD_STRING
	string "Default Tegra board name"
	default "Microsoft Surface RT"

endif
```

## board/mimc/mimc200/Kconfig
```kconfig
if TARGET_MIMC200

config SYS_BOARD
	default "mimc200"

config SYS_VENDOR
	default "mimc"

config SYS_SOC
	default "at32ap700x"

config SYS_CONFIG_NAME
	default "mimc200"

endif
```

## board/miromico/hammerhead/Kconfig
```kconfig
if TARGET_HAMMERHEAD

config SYS_BOARD
	default "hammerhead"

config SYS_VENDOR
	default "miromico"

config SYS_SOC
	default "at32ap700x"

config SYS_CONFIG_NAME
	default "hammerhead"

endif
```

## board/mosaixtech/icon/Kconfig
```kconfig
if TARGET_ICON

config SYS_BOARD
	default "icon"

config SYS_VENDOR
	default "mosaixtech"

config SYS_CONFIG_NAME
	default "icon"

endif
```

## board/motionpro/Kconfig
```kconfig
if TARGET_MOTIONPRO

config SYS_BOARD
	default "motionpro"

config SYS_CONFIG_NAME
	default "motionpro"

endif
```

## board/motorola/mot/Kconfig
```kconfig
if TARGET_MOT

config SYS_BOARD
	default "mot"

config SYS_VENDOR
	default "motorola"

config SYS_CONFIG_NAME
	default "mot"

config TEGRA_BOARD_STRING
	string "Default Tegra board name"
	default "Motorola Mot"

endif
```

## board/mpc8308_p1m/Kconfig
```kconfig
if TARGET_MPC8308_P1M

config SYS_BOARD
	string
	default "mpc8308_p1m"

config SYS_CONFIG_NAME
	string
	default "mpc8308_p1m"

endif
```

## board/mpl/mip405/Kconfig
```kconfig
if TARGET_MIP405 || TARGET_MIP405T

config SYS_BOARD
	default "mip405"

config SYS_VENDOR
	default "mpl"

config SYS_CONFIG_NAME
	default "MIP405"

config ISO_STRING
	string
	default "MEV-10082-001" if TARGET_MIP405T
	default "MEV-10072-001" if TARGET_MIP405

endif
```

## board/mpl/pati/Kconfig
```kconfig
if TARGET_PATI

config SYS_BOARD
	default "pati"

config SYS_VENDOR
	default "mpl"

config SYS_CONFIG_NAME
	default "PATI"

config ISO_STRING
	string
	default "MEV-10084-001"
endif
```

## board/mpl/pip405/Kconfig
```kconfig
if TARGET_PIP405

config SYS_BOARD
	default "pip405"

config SYS_VENDOR
	default "mpl"

config SYS_CONFIG_NAME
	default "PIP405"

endif
```

## board/mpl/vcma9/Kconfig
```kconfig
if TARGET_VCMA9

config SYS_CPU
	default "arm920t"

config SYS_BOARD
	default "vcma9"

config SYS_VENDOR
	default "mpl"

config SYS_SOC
	default "s3c24x0"

config SYS_CONFIG_NAME
	default "VCMA9"

endif
```

## board/mpr2/Kconfig
```kconfig
if TARGET_MPR2

config SYS_BOARD
	default "mpr2"

config SYS_CONFIG_NAME
	default "mpr2"

endif
```

## board/mqmaker/miqi_rk3288/Kconfig
```kconfig
if TARGET_MIQI_RK3288

config SYS_BOARD
	default "miqi_rk3288"

config SYS_VENDOR
	default "mqmaker"

config SYS_CONFIG_NAME
	default "miqi_rk3288"

endif
```

## board/ms7720se/Kconfig
```kconfig
if TARGET_MS7720SE

config SYS_BOARD
	default "ms7720se"

config SYS_CONFIG_NAME
	default "ms7720se"

endif
```

## board/ms7722se/Kconfig
```kconfig
if TARGET_MS7722SE

config SYS_BOARD
	default "ms7722se"

config SYS_CONFIG_NAME
	default "ms7722se"

endif
```

## board/ms7750se/Kconfig
```kconfig
if TARGET_MS7750SE

config SYS_BOARD
	default "ms7750se"

config SYS_CONFIG_NAME
	default "ms7750se"

endif
```

## board/muas3001/Kconfig
```kconfig
if TARGET_MUAS3001

config SYS_BOARD
	default "muas3001"

config SYS_CONFIG_NAME
	default "muas3001"

endif
```

## board/munices/Kconfig
```kconfig
if TARGET_MUNICES

config SYS_BOARD
	default "munices"

config SYS_CONFIG_NAME
	default "munices"

endif
```

## board/musenki/Kconfig
```kconfig
if TARGET_MUSENKI

config SYS_BOARD
	default "musenki"

config SYS_CONFIG_NAME
	default "MUSENKI"

endif
```

## board/mvblue/Kconfig
```kconfig
if TARGET_MVBLUE

config SYS_BOARD
	default "mvblue"

config SYS_CONFIG_NAME
	default "MVBLUE"

endif
```

## board/neorv32/neorv32/Kconfig
```kconfig
# SPDX-License-Identifier: GPL-2.0+

if TARGET_NEORV32

config SYS_BOARD
	default "neorv32"

config SYS_VENDOR
	default "neorv32"

config SYS_CPU
	default "generic"

config SYS_CONFIG_NAME
	default "neorv32"

config TEXT_BASE
	default 0x80000000

config BOARD_SPECIFIC_OPTIONS
	def_bool y
	select GENERIC_RISCV

endif
```

## board/netvia/Kconfig
```kconfig
if TARGET_NETVIA

config SYS_BOARD
	default "netvia"

config SYS_CONFIG_NAME
	default "NETVIA"

endif
```

## board/nokia/rx51/Kconfig
```kconfig
if TARGET_NOKIA_RX51

config USB_DEVICE
	def_bool y
	help
	  Legacy UDC device support

config USB_TTY
	def_bool y
	help
	  Legacy tty type of device available to talk to the UDC device

config USBD_VENDORID
	hex
	default 0x0421

config USBD_PRODUCTID_CDCACM
	hex
	default 0x01c8

config USBD_PRODUCTID_GSERIAL
	hex
	default 0x01c8

config USBD_MANUFACTURER
	string
	default "Nokia"

config USBD_PRODUCT_NAME
	string
	default "N900 (U-Boot)"

config NR_DRAM_BANKS
	default 2

config SYS_BOARD
	default "rx51"

config SYS_VENDOR
	default "nokia"

config SYS_CONFIG_NAME
	default "nokia_rx51"

config SYS_PROMPT
	default "Nokia RX-51 # "

endif
```

## board/novtech/meerkat96/Kconfig
```kconfig
if TARGET_MEERKAT96

config SYS_BOARD
	default "meerkat96"

config SYS_VENDOR
	default "novtech"

config SYS_CONFIG_NAME
	default "meerkat96"

endif
```

## board/nuvoton/arbel_evb/Kconfig
```kconfig
if TARGET_ARBEL_EVB

config SYS_BOARD
	default "arbel_evb"

config SYS_VENDOR
	default "nuvoton"

config SYS_CONFIG_NAME
	default "arbel"

config SYS_MEM_TOP_HIDE
	hex "Reserved TOP memory"
	default 0xB000000
	help
	  Reserve memory for ECC/GFX/VCD/ECE.

endif
```
