## board/nvidia/beaver/Kconfig
```kconfig
if TARGET_BEAVER

config SYS_BOARD
	default "beaver"

config SYS_VENDOR
	default "nvidia"

config TEGRA_BOARD_STRING
	string "Default Tegra board name"
	default "NVIDIA Beaver"

endif
```

## board/nvidia/cardhu/Kconfig
```kconfig
if TARGET_CARDHU

config SYS_BOARD
	default "cardhu"

config SYS_VENDOR
	default "nvidia"

config TEGRA_BOARD_STRING
	string "Default Tegra board name"
	default "NVIDIA Cardhu"

endif
```

## board/nvidia/dalmore/Kconfig
```kconfig
if TARGET_DALMORE

config SYS_BOARD
	string
	default "dalmore"

config SYS_VENDOR
	string
	default "nvidia"

config SYS_CONFIG_NAME
	string
	default "dalmore"

endif
```

## board/nvidia/harmony/Kconfig
```kconfig
if TARGET_HARMONY

config SYS_BOARD
	default "harmony"

config SYS_VENDOR
	default "nvidia"

config TEGRA_BOARD_STRING
	string "Default Tegra board name"
	default "NVIDIA Harmony"

endif
```

## board/nvidia/jetson-tk1/Kconfig
```kconfig
if TARGET_JETSON_TK1

config SYS_BOARD
	default "jetson-tk1"

config SYS_VENDOR
	default "nvidia"

config TEGRA_BOARD_STRING
	string "Default Tegra board name"
	default "NVIDIA Jetson TK1"

endif
```

## board/nvidia/nyan-big/Kconfig
```kconfig
if TARGET_NYAN_BIG

config SYS_BOARD
	default "nyan-big"

config SYS_VENDOR
	default "nvidia"

config TEGRA_BOARD_STRING
	string "Default Tegra board name"
	default "Google/NVIDIA Nyan-big"

endif
```

## board/nvidia/p2371-0000/Kconfig
```kconfig
if TARGET_P2371_0000

config SYS_BOARD
	default "p2371-0000"

config SYS_VENDOR
	default "nvidia"

config TEGRA_BOARD_STRING
	string "Default Tegra board name"
	default "NVIDIA P2371-0000"

endif
```

## board/nvidia/p2371-2180/Kconfig
```kconfig
if TARGET_P2371_2180

config SYS_BOARD
	default "p2371-2180"

config SYS_VENDOR
	default "nvidia"

config TEGRA_BOARD_STRING
	string "Default Tegra board name"
	default "NVIDIA P2371-2180"

endif
```

## board/nvidia/p2571/Kconfig
```kconfig
if TARGET_P2571

config SYS_BOARD
	default "p2571"

config SYS_VENDOR
	default "nvidia"

config TEGRA_BOARD_STRING
	string "Default Tegra board name"
	default "NVIDIA P2571"

endif
```

## board/nvidia/p2771-0000/Kconfig
```kconfig
# Copyright (c) 2016, NVIDIA CORPORATION.
#
# SPDX-License-Identifier: GPL-2.0

if TARGET_P2771_0000

config SYS_BOARD
	default "p2771-0000"

config SYS_VENDOR
	default "nvidia"

config TEGRA_BOARD_STRING
	string "Default Tegra board name"
	default "NVIDIA P2771-0000"

endif
```

## board/nvidia/p3450-0000/Kconfig
```kconfig
if TARGET_P3450_0000

config SYS_BOARD
	default "p3450-0000"

config SYS_VENDOR
	default "nvidia"

config TEGRA_BOARD_STRING
	string "Default Tegra board name"
	default "NVIDIA P3450-0000"

endif
```

## board/nvidia/seaboard/Kconfig
```kconfig
if TARGET_SEABOARD

config SYS_BOARD
	default "seaboard"

config SYS_VENDOR
	default "nvidia"

config TEGRA_BOARD_STRING
	string "Default Tegra board name"
	default "NVIDIA Seaboard"

endif
```

## board/nvidia/tegratab/Kconfig
```kconfig
if TARGET_TEGRATAB

config SYS_BOARD
	default "tegratab"

config SYS_VENDOR
	default "nvidia"

config TEGRA_BOARD_STRING
	string "Default Tegra board name"
	default "NVIDIA TegraTab"

config TEGRA_PRAM_SIZE
	depends on TEGRA_PRAM
	default 0x21c00

endif
```

## board/nvidia/venice2/Kconfig
```kconfig
if TARGET_VENICE2

config SYS_BOARD
	default "venice2"

config SYS_VENDOR
	default "nvidia"

config TEGRA_BOARD_STRING
	string "Default Tegra board name"
	default "NVIDIA Venice2"

endif
```

## board/nvidia/ventana/Kconfig
```kconfig
if TARGET_VENTANA

config SYS_BOARD
	default "ventana"

config SYS_VENDOR
	default "nvidia"

config TEGRA_BOARD_STRING
	string "Default Tegra board name"
	default "NVIDIA Ventana"

endif
```

## board/nvidia/whistler/Kconfig
```kconfig
if TARGET_WHISTLER

config SYS_BOARD
	default "whistler"

config SYS_VENDOR
	default "nvidia"

config SYS_CONFIG_NAME
	default "whistler"

endif
```

## board/nxp/imx8mn_evk/Kconfig
```kconfig
if TARGET_IMX8MN_EVK || TARGET_IMX8MN_DDR4_EVK

config SYS_BOARD
	default "imx8mn_evk"

config SYS_VENDOR
	default "nxp"

config SYS_CONFIG_NAME
	default "imx8mn_evk"

config IMX8MN_LOW_DRIVE_MODE
	bool "Enable the low drive mode of iMX8MN on EVK board"

config IMX_CONFIG
	default "board/nxp/imx8mn_evk/imximage-8mn-ddr4.cfg"

endif
```

## board/nxp/imx8mp_evk/Kconfig
```kconfig
if TARGET_IMX8MP_EVK

config SYS_BOARD
	default "imx8mp_evk"

config SYS_VENDOR
	default "nxp"

config SYS_CONFIG_NAME
	default "imx8mp_evk"

config IMX_CONFIG
	default "board/nxp/imx8mp_evk/imximage-8mp-lpddr4.cfg"

endif
```

## board/nxp/imx8qxp_mek/Kconfig
```kconfig
if TARGET_IMX8QXP_MEK

config SYS_BOARD
	default "imx8qxp_mek"

config SYS_VENDOR
	default "nxp"

config SYS_CONFIG_NAME
	default "imx8qxp_mek"

config IMX_CONFIG
	default "board/nxp/imx8qxp_mek/imximage.cfg"

endif
```

## board/nxp/imx8ulp_evk/Kconfig
```kconfig
if TARGET_IMX8ULP_EVK

config SYS_BOARD
	default "imx8ulp_evk"

config SYS_VENDOR
	default "nxp"

config SYS_CONFIG_NAME
	default "imx8ulp_evk"

endif
```

## board/nxp/imx94_evk/Kconfig
```kconfig
if TARGET_IMX943_EVK

config SYS_BOARD
	default "imx94_evk"

config SYS_VENDOR
	default "nxp"

config SYS_CONFIG_NAME
	default "imx94_evk"

endif
```

## board/nxp/imx952_evk/Kconfig
```kconfig
if TARGET_IMX952_EVK

config SYS_BOARD
	default "imx952_evk"

config SYS_VENDOR
	default "nxp"

config SYS_CONFIG_NAME
	default "imx952_evk"

endif
```

## board/nxp/imxrt1170-evk/Kconfig
```kconfig
if TARGET_IMXRT1170_EVK

config SYS_BOARD
	default "imxrt1170-evk"

config SYS_VENDOR
	default "nxp"

config SYS_SOC
	default "imxrt1170"

config SYS_CONFIG_NAME
	default "imxrt1170-evk"

config IMX_CONFIG
	default "board/nxp/imxrt1170-evk/imximage.cfg"

endif
```

## board/nxp/m5282evb/Kconfig
```kconfig
if TARGET_M5282EVB

config SYS_CPU
	default "mcf52x2"

config SYS_BOARD
	default "m5282evb"

config SYS_VENDOR
	default "nxp"

config SYS_CONFIG_NAME
	default "M5282EVB"

endif
```

## board/nxp/m5329evb/Kconfig
```kconfig
if TARGET_M5329EVB

config SYS_CPU
	default "mcf532x"

config SYS_BOARD
	default "m5329evb"

config SYS_VENDOR
	default "nxp"

config SYS_CONFIG_NAME
	default "M5329EVB"

endif
```
