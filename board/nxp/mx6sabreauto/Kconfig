## board/nxp/mx6sabreauto/Kconfig
```kconfig
if TARGET_MX6SABREAUTO

config SYS_BOARD
	default "mx6sabreauto"

config SYS_VENDOR
	default "nxp"

config SYS_CONFIG_NAME
	default "mx6sabreauto"

endif
```

## board/nxp/mx6slevk/Kconfig
```kconfig
if TARGET_MX6SLEVK

config SYS_BOARD
	default "mx6slevk"

config SYS_VENDOR
	default "nxp"

config SYS_CONFIG_NAME
	default "mx6slevk"

config IMX_CONFIG
	default "board/nxp/mx6slevk/imximage.cfg"

endif
```

## board/nxp/mx6sllevk/Kconfig
```kconfig
if TARGET_MX6SLLEVK

config SYS_BOARD
	default "mx6sllevk"

config SYS_VENDOR
	default "nxp"

config SYS_CONFIG_NAME
	default "mx6sllevk"

config IMX_CONFIG
	default "board/nxp/mx6sllevk/imximage.cfg"

endif
```

## board/nxp/mx6sxsabreauto/Kconfig
```kconfig
if TARGET_MX6SXSABREAUTO

config SYS_BOARD
	default "mx6sxsabreauto"

config SYS_VENDOR
	default "nxp"

config SYS_CONFIG_NAME
	default "mx6sxsabreauto"

config IMX_CONFIG
	default "board/nxp/mx6sxsabreauto/imximage.cfg"

endif
```

## board/nxp/mx6sxsabresd/Kconfig
```kconfig
if TARGET_MX6SXSABRESD

config SYS_BOARD
	default "mx6sxsabresd"

config SYS_VENDOR
	default "nxp"

config SYS_CONFIG_NAME
	default "mx6sxsabresd"

config IMX_CONFIG
	default "board/nxp/mx6sxsabresd/imximage.cfg"

endif
```

## board/nxp/mx6ullevk/Kconfig
```kconfig
if TARGET_MX6ULL_14X14_EVK

config SYS_BOARD
	default "mx6ullevk"

config SYS_VENDOR
	default "nxp"

config SYS_CONFIG_NAME
	default "mx6ullevk"

config IMX_CONFIG
	default "board/nxp/mx6ullevk/imximage.cfg"

endif
```

## board/nxp/mx7ulp_evk/Kconfig
```kconfig
if TARGET_MX7ULP_EVK

config SYS_BOARD
	default "mx7ulp_evk"

config SYS_VENDOR
	default "nxp"

config SYS_CONFIG_NAME
	default "mx7ulp_evk"

config IMX_CONFIG
	default "board/nxp/mx7ulp_evk/imximage.cfg"

endif
```

## board/nxp/t104xrdb/Kconfig
```kconfig
if TARGET_T1042D4RDB

config SYS_BOARD
	default "t104xrdb"

config SYS_VENDOR
	default "nxp"

config SYS_CONFIG_NAME
	default "T104xRDB"

endif
```

## board/nxp/t4rdb/Kconfig
```kconfig
if TARGET_T4240RDB

config SYS_BOARD
	default "t4rdb"

config SYS_VENDOR
	default "nxp"

config SYS_CONFIG_NAME
	default "T4240RDB"

endif
```

## board/olimex/mx23_olinuxino/Kconfig
```kconfig
if TARGET_MX23_OLINUXINO

config SYS_CPU
	default "arm926ejs"

config SYS_BOARD
	default "mx23_olinuxino"

config SYS_VENDOR
	default "olimex"

config SYS_SOC
	default "mxs"

config SYS_CONFIG_NAME
	default "mx23_olinuxino"

endif
```

## board/omicron/calimain/Kconfig
```kconfig
if TARGET_CALIMAIN

config SYS_BOARD
	default "calimain"

config SYS_VENDOR
	default "omicron"

config SYS_CONFIG_NAME
	default "calimain"

endif
```

## board/onion/omega4_rv1103/Kconfig
```kconfig
if TARGET_OMEGA4_RV1103

config SYS_BOARD
	default "omega4_rv1103"

config SYS_VENDOR
	default "onion"

config SYS_CONFIG_NAME
	default "omega4_rv1103"

endif
```

## board/openrisc/openrisc-generic/Kconfig
```kconfig
if TARGET_OPENRISC_GENERIC

config SYS_BOARD
	default "openrisc-generic"

config SYS_VENDOR
	default "openrisc"

config SYS_CONFIG_NAME
	default "openrisc-generic"

endif
```

## board/out4/o4-imx6ull-nano/Kconfig
```kconfig
if TARGET_O4_IMX6ULL_NANO

config SYS_BOARD
	default "o4-imx6ull-nano"

config SYS_VENDOR
	default "out4"

config SYS_CONFIG_NAME
	default "o4-imx6ull-nano"

choice
	prompt "Memory model"
	default K4B4G1646D_BCMA
	help
	    Memory type setup.

	    Please choose correct memory model here.

config K4B4G1646D_BCMA
	bool "K4B4G1646D-BCMA 256Mx16 (512 MiB/chip)"
	help
	    Samsung DDR3 SDRAM
	    K4B4G1646D-BCMA

config MT41K256M16HA_125E
	bool "MT41K256M16HA-125:E 256Mx16 (512 MiB/chip)"
	help
	    Micron DDR3L SDRAM
	    MT41K256M16HA-125:E

endchoice

choice
	prompt "Mainboard model"
	default O4_IMX_NANO
	help
	    Mainboard setup.

	    Please choose correct main board model here.

config O4_IMX_NANO
	bool "O4-iMX-NANO"
	help
	    A baseboard for EV-iMX280-NANO module:
	    https://out4.ru/products/board/18-o4-imx-nano.html

endchoice

config IMX_CONFIG
	default "board/out4/o4-imx6ull-nano/K4B4G1646D-BCMA.cfg" if K4B4G1646D_BCMA
	default "board/out4/o4-imx6ull-nano/MT41K256M16HA-125E.cfg" if MT41K256M16HA_125E

config DEFAULT_DEVICE_TREE
	default "o4-imx-nano" if O4_IMX_NANO

endif
```

## board/ouya/ouya/Kconfig
```kconfig
if TARGET_OUYA

config SYS_BOARD
	default "ouya"

config SYS_VENDOR
	default "ouya"

config TEGRA_BOARD_STRING
	string "Default Tegra board name"
	default "Ouya Game Console"

endif
```

## board/overo/Kconfig
```kconfig
if TARGET_OMAP3_OVERO

config SYS_BOARD
	string
	default "overo"

config SYS_CONFIG_NAME
	string
	default "omap3_overo"

endif
```

## board/palmld/Kconfig
```kconfig
if TARGET_PALMLD

config SYS_BOARD
	default "palmld"

config SYS_CONFIG_NAME
	default "palmld"

endif
```

## board/palmtc/Kconfig
```kconfig
if TARGET_PALMTC

config SYS_BOARD
	default "palmtc"

config SYS_CONFIG_NAME
	default "palmtc"

endif
```

## board/palmtreo680/Kconfig
```kconfig
if TARGET_PALMTREO680

config SYS_CPU
	default "pxa"

config SYS_BOARD
	default "palmtreo680"

config SYS_CONFIG_NAME
	default "palmtreo680"

endif
```

## board/pandora/Kconfig
```kconfig
if TARGET_OMAP3_PANDORA

config SYS_BOARD
	string
	default "pandora"

config SYS_CONFIG_NAME
	string
	default "omap3_pandora"

endif
```

## board/pb1x00/Kconfig
```kconfig
if TARGET_PB1X00

config SYS_BOARD
	default "pb1x00"

config SYS_SOC
	default "au1x00"

config SYS_CONFIG_NAME
	default "pb1x00"

config SYS_TEXT_BASE
	default 0x83800000

config SYS_DCACHE_SIZE
	default 16384

config SYS_DCACHE_LINE_SIZE
	default 32

config SYS_ICACHE_SIZE
	default 16384

config SYS_ICACHE_LINE_SIZE
	default 32

endif
```

## board/pcs440ep/Kconfig
```kconfig
if TARGET_PCS440EP

config SYS_BOARD
	default "pcs440ep"

config SYS_CONFIG_NAME
	default "pcs440ep"

endif
```

## board/pdm360ng/Kconfig
```kconfig
if TARGET_PDM360NG

config SYS_BOARD
	default "pdm360ng"

config SYS_CONFIG_NAME
	default "pdm360ng"

endif
```

## board/pegatron/chagall/Kconfig
```kconfig
if TARGET_CHAGALL

config SYS_BOARD
	default "chagall"

config SYS_VENDOR
	default "pegatron"

config TEGRA_BOARD_STRING
	string "Default Tegra board name"
	default "Pegatron Chagall"

endif
```

## board/phytec/common/Kconfig
```kconfig
config PHYTEC_SOM_DETECTION
	bool "Support SoM detection for PHYTEC platforms"
	select SPL_CRC8 if SPL
	help
	   Support of I2C EEPROM based SoM detection.

config PHYTEC_SOM_DETECTION_BLOCKS
	bool "Extend SoM detection with block support"
	depends on PHYTEC_SOM_DETECTION
	help
	   Extend the I2C EEPROM based SoM detection with API v3. This API
	   introduces blocks with different payloads.

config PHYTEC_IMX8M_SOM_DETECTION
	bool "Support SoM detection for i.MX8M PHYTEC platforms"
	depends on ARCH_IMX8M && PHYTEC_SOM_DETECTION
	default y
	help
	  Support of I2C EEPROM based SoM detection. Supported
	  for PHYTEC i.MX8MM/i.MX8MP boards

config PHYTEC_IMX93_SOM_DETECTION
	bool "Support SoM detection for i.MX93 PHYTEC platforms"
	depends on ARCH_IMX9 && PHYTEC_SOM_DETECTION
	default y
	help
	  Support of I2C EEPROM based SoM detection. Supported
	  for PHYTEC i.MX93 based boards

config PHYTEC_AM62_SOM_DETECTION
	bool "Support SoM detection for AM62x PHYTEC platforms"
	depends on (TARGET_PHYCORE_AM62X_A53 || TARGET_PHYCORE_AM62X_R5) && \
		   PHYTEC_SOM_DETECTION
	select PHYTEC_SOM_DETECTION_BLOCKS
	depends on SPL_I2C && DM_I2C
	default y
	help
	   Support of I2C EEPROM based SoM detection. Supported
	   for PHYTEC AM62x boards.

config PHYTEC_AM62A_SOM_DETECTION
	bool "Support SoM detection for AM62Ax PHYTEC platforms"
	depends on (TARGET_PHYCORE_AM62AX_A53 || TARGET_PHYCORE_AM62AX_R5) && \
		   PHYTEC_SOM_DETECTION
	select SUPPORT_EXTENSION_SCAN
	depends on SPL_I2C && DM_I2C
	default y
	help
	   Support of I2C EEPROM based SoM detection. Supported
	   for PHYTEC AM62Ax boards.

config PHYTEC_AM64_SOM_DETECTION
	bool "Support SoM detection for AM64x PHYTEC platforms"
	depends on (TARGET_PHYCORE_AM64X_A53 || TARGET_PHYCORE_AM64X_R5) && \
		   PHYTEC_SOM_DETECTION
	select PHYTEC_SOM_DETECTION_BLOCKS
	depends on SPL_I2C && DM_I2C
	default y
	help
	   Support of I2C EEPROM based SoM detection. Supported
	   for PHYTEC AM64x boards.
```
