## board/phytec/common/k3/Kconfig
```kconfig
config PHYTEC_K3_DDR_PATCH
	bool "Patch DDR timings on PHYTEC K3 SoMs"
	help
	   Allow to override default DDR timings prior to
	   DDRSS driver probing.
```

## board/phytec/imx8mp-libra-fpsc/Kconfig
```kconfig
if TARGET_IMX8MP_LIBRA_FPSC

config SYS_BOARD
	default "imx8mp-libra-fpsc"

config SYS_VENDOR
	default "phytec"

config IMX_CONFIG
	default "board/phytec/imx8mp-libra-fpsc/imximage-8mp-sd.cfg"

config SYS_CONFIG_NAME
	default "imx8mp-libra-fpsc"

source "board/phytec/common/Kconfig"
endif
```

## board/phytec/imx93_phycore/Kconfig
```kconfig
if TARGET_IMX93_PHYCORE

config SYS_BOARD
	default "imx93_phycore"

config SYS_VENDOR
	default "phytec"

config SYS_CONFIG_NAME
	default "imx93_phycore"

config IMX93_PHYCORE_LPDDR4X_1GB
	bool "Using LPDDR4X Timing and size of 1GB"
	default y
	select IMX9_LPDDR4X
	help
	  Select the LPDDR4X timing and size of 1GB

          This sets the LPDDR4X timing and size of 1GB.
endif
```

## board/phytec/pcl063/Kconfig
```kconfig
if TARGET_PCL063

config SYS_BOARD
	default "pcl063"

config SYS_VENDOR
	default "phytec"

config SYS_CONFIG_NAME
	default "pcl063"

endif
```

## board/phytec/pcm030/Kconfig
```kconfig
if TARGET_PCM030

config SYS_BOARD
	default "pcm030"

config SYS_VENDOR
	default "phytec"

config SYS_CONFIG_NAME
	default "pcm030"

endif
```

## board/phytec/pcm051/Kconfig
```kconfig
if TARGET_PCM051

config SYS_BOARD
	default "pcm051"

config SYS_VENDOR
	default "phytec"

config SYS_SOC
	default "am33xx"

config SYS_CONFIG_NAME
	default "pcm051"

config DM
	default y

config DM_GPIO
	default y

config DM_SERIAL
	default y

endif
```

## board/phytec/pcm052/Kconfig
```kconfig
if TARGET_PCM052

config SYS_BOARD
	default "pcm052"

config SYS_VENDOR
	default "phytec"

config SYS_SOC
	default "vf610"

config SYS_CONFIG_NAME
	default "pcm052"

endif
```

## board/phytec/pfla02/Kconfig
```kconfig
if TARGET_PFLA02

config SYS_BOARD
	default "pfla02"

config SYS_VENDOR
	default "phytec"

config SYS_CONFIG_NAME
	default "pfla02"

endif
```

## board/phytec/phycore_am62ax/Kconfig
```kconfig
# SPDX-License-Identifier: GPL-2.0-or-later OR MIT
#
# Copyright (C) 2024 PHYTEC America LLC
# Author: Garrett Giordano <ggiordano@phytec.com>

if TARGET_PHYCORE_AM62AX_A53

config SYS_BOARD
       default "phycore_am62ax"

config SYS_VENDOR
       default "phytec"

config SYS_CONFIG_NAME
       default "phycore_am62ax"

source "board/phytec/common/Kconfig"

endif

if TARGET_PHYCORE_AM62AX_R5

config SYS_BOARD
       default "phycore_am62ax"

config SYS_VENDOR
       default "phytec"

config SYS_CONFIG_NAME
       default "phycore_am62ax"

config SPL_LDSCRIPT
	default "arch/arm/mach-omap2/u-boot-spl.lds"

source "board/phytec/common/Kconfig"

endif
```

## board/phytec/phycore_am62x/Kconfig
```kconfig
# SPDX-License-Identifier:     GPL-2.0+
#
# Copyright (C) 2022 - 2023 PHYTEC Messtechnik GmbH
# Author: Wadim Egorov <w.egorov@phytec.de>

if TARGET_PHYCORE_AM62X_A53

config SYS_BOARD
       default "phycore_am62x"

config SYS_VENDOR
       default "phytec"

config SYS_CONFIG_NAME
       default "phycore_am62x"

source "board/phytec/common/Kconfig"

endif

if TARGET_PHYCORE_AM62X_R5

config SYS_BOARD
       default "phycore_am62x"

config SYS_VENDOR
       default "phytec"

config SYS_CONFIG_NAME
       default "phycore_am62x"

config SPL_LDSCRIPT
	default "arch/arm/mach-omap2/u-boot-spl.lds"

source "board/phytec/common/Kconfig"
source "board/phytec/common/k3/Kconfig"

endif

config PHYCORE_AM62X_RAM_SIZE_FIX
        bool "Set phyCORE-AM62x RAM size fix instead of detecting"
        default false
        help
          RAM size is automatic being detected with the help of
          the EEPROM introspection data. Set RAM size to a fix value
          instead.

choice
        prompt "phyCORE-AM62x RAM size"
        depends on PHYCORE_AM62X_RAM_SIZE_FIX
        default PHYCORE_AM62X_RAM_SIZE_2GB

config PHYCORE_AM62X_RAM_SIZE_1GB
        bool "1GB RAM"
        help
          Set RAM size fix to 1GB for phyCORE-AM62x.

config PHYCORE_AM62X_RAM_SIZE_2GB
        bool "2GB RAM"
        help
          Set RAM size fix to 2GB for phyCORE-AM62x.

config PHYCORE_AM62X_RAM_SIZE_4GB
        bool "4GB RAM"
        help
          Set RAM size fix to 4GB for phyCORE-AM62x.

endchoice
```

## board/phytec/phycore_am64x/Kconfig
```kconfig
# SPDX-License-Identifier:     GPL-2.0+
#
# Copyright (C) 2021 PHYTEC America, LLC - https://www.phytec.com
# Author: Matt McKee <mmckee@phytec.com>
#
# Copyright (C) 2022 - 2024 PHYTEC Messtechnik GmbH
# Author: Wadim Egorov <w.egorov@phytec.de>

if TARGET_PHYCORE_AM64X_A53

config SYS_BOARD
       default "phycore_am64x"

config SYS_VENDOR
       default "phytec"

config SYS_CONFIG_NAME
       default "phycore_am64x"

source "board/phytec/common/Kconfig"

endif

if TARGET_PHYCORE_AM64X_R5

config SYS_BOARD
       default "phycore_am64x"

config SYS_VENDOR
       default "phytec"

config SYS_CONFIG_NAME
       default "phycore_am64x"

source "board/phytec/common/Kconfig"

endif

config PHYCORE_AM64X_RAM_SIZE_FIX
        bool "Set phyCORE-AM64x RAM size fix instead of detecting"
        default false
        help
          RAM size is automatic being detected with the help of
          the EEPROM introspection data. Set RAM size to a fix value
          instead.

choice
        prompt "phyCORE-AM64x RAM size"
        depends on PHYCORE_AM64X_RAM_SIZE_FIX
        default PHYCORE_AM64X_RAM_SIZE_2GB

config PHYCORE_AM64X_RAM_SIZE_1GB
        bool "1GB RAM"
        help
          Set RAM size fix to 1GB for phyCORE-AM64x.

config PHYCORE_AM64X_RAM_SIZE_2GB
        bool "2GB RAM"
        help
          Set RAM size fix to 2GB for phyCORE-AM64x.

endchoice
```

## board/phytec/phycore_am68x/Kconfig
```kconfig
# SPDX-License-Identifier: GPL-2.0-only OR MIT
#
# Copyright (C) 2025 PHYTEC Messtechnik GmbH
# Author: Dominik Haller <d.haller@phytec.de>

if TARGET_PHYCORE_AM68X_A72

config SYS_BOARD
       default "phycore_am68x"

config SYS_VENDOR
       default "phytec"

config SYS_CONFIG_NAME
       default "phycore_am68x"

config ENV_SOURCE_FILE
       default "phycore_am68x"

source "board/phytec/common/Kconfig"

endif

if TARGET_PHYCORE_AM68X_R5

config SYS_BOARD
       default "phycore_am68x"

config SYS_VENDOR
       default "phytec"

config SYS_CONFIG_NAME
       default "phycore_am68x"

config ENV_SOURCE_FILE
       default "phycore_am68x"

source "board/phytec/common/Kconfig"
source "board/phytec/common/k3/Kconfig"

endif
```

## board/phytec/phycore_imx8mp/Kconfig
```kconfig
if TARGET_PHYCORE_IMX8MP

config SYS_BOARD
	default "phycore_imx8mp"

config SYS_VENDOR
	default "phytec"

config SYS_CONFIG_NAME
	default "phycore_imx8mp"

config IMX_CONFIG
	default "board/phytec/phycore_imx8mp/imximage-8mp-sd.cfg"

config PHYCORE_IMX8MP_RAM_SIZE_FIX
	bool "Set phyCORE-i.MX8MP RAM size fix instead of detecting"
	default false
	help
	  RAM size is automatic being detected with the help of
	  the EEPROM introspection data. Set RAM size to a fix value
	  instead.

choice
	prompt "phyCORE-i.MX8MP RAM size"
	depends on PHYCORE_IMX8MP_RAM_SIZE_FIX
	default PHYCORE_IMX8MP_RAM_SIZE_2GB

config PHYCORE_IMX8MP_RAM_SIZE_1GB
	bool "1GB RAM"
	help
	  Set RAM size fix to 1GB for phyCORE-i.MX8MP.
	  RAM frequency is configured independent.

config PHYCORE_IMX8MP_RAM_SIZE_2GB
	bool "2GB RAM"
	help
	  Set RAM size fix to 2GB for phyCORE-i.MX8MP.
	  RAM frequency is configured independent.

config PHYCORE_IMX8MP_RAM_SIZE_4GB
	bool "4GB RAM"
	help
	  Set RAM size fix to 4GB for phyCORE-i.MX8MP.
	  RAM frequency is configured independent.

config PHYCORE_IMX8MP_RAM_SIZE_8GB
	bool "8GB RAM"
	help
	  Set RAM size fix to 8GB for phyCORE-i.MX8MP.
	  Only 2GHz RAMs are supported.

endchoice

config PHYCORE_IMX8MP_RAM_FREQ_FIX
	bool "Set phyCORE-i.MX8MP RAM frequency fix instead of detecting"
	help
	  RAM frequency is automatic being detected with the help of
	  the EEPROM introspection data. Set RAM frequency to a fix value
	  instead.

choice
	prompt "phyCORE-i.MX8MP RAM frequency"
	depends on PHYCORE_IMX8MP_RAM_FREQ_FIX
	default PHYCORE_IMX8MP_USE_1_5GHZ_RAM_TIMINGS

config PHYCORE_IMX8MP_USE_2GHZ_RAM_TIMINGS
	bool "Use 2GHz RAM timings"
	help
	  Use fix 2GHz RAM timings for phyCORE-i.MX8MP instead of
	  1.5GHz timings.

config PHYCORE_IMX8MP_USE_1_5GHZ_RAM_TIMINGS
	depends on !PHYCORE_IMX8MP_RAM_SIZE_8GB
	bool "Use 1.5GHz RAM timings"
	help
	  Use fix 1.5GHz RAM timings for phyCORE-i.MX8MP instead of
	  2GHz timings.
endchoice

source "board/phytec/common/Kconfig"
endif
```

## board/phytec/phycore_imx91_93/Kconfig
```kconfig
if TARGET_PHYCORE_IMX91 || TARGET_PHYCORE_IMX93

config SYS_BOARD
	default "phycore_imx91_93"

config SYS_VENDOR
	default "phytec"

config SYS_CONFIG_NAME
	default "phycore_imx91_93"

config PHYCORE_IMX91_93_RAM_TYPE_FIX
	bool "Set phyCORE-i.MX91/93 RAM type and size fix instead of detecting"
	default false
	help
	  RAM type and size is being automatically detected with the help
	  of the PHYTEC EEPROM introspection data.
	  Set RAM type to a fix value instead.

choice
	prompt "phyCORE-i.MX91/93 RAM type"
	depends on PHYCORE_IMX91_93_RAM_TYPE_FIX
	default PHYCORE_IMX91_93_RAM_TYPE_LPDDR4X_1GB

config PHYCORE_IMX91_93_RAM_TYPE_LPDDR4_1GB
	bool "LPDDR4 1GB RAM"
	help
	  Set RAM type fixed to LPDDR4 and RAM size fixed to 1GB
	  for phyCORE-i.MX91/93.

config PHYCORE_IMX91_93_RAM_TYPE_LPDDR4X_1GB
	bool "LPDDR4X 1GB RAM"
	help
	  Set RAM type fixed to LPDDR4X and RAM size fixed to 1GB
	  for phyCORE-i.MX91/93.

config PHYCORE_IMX91_93_RAM_TYPE_LPDDR4X_2GB
	bool "LPDDR4X 2GB RAM"
	help
	  Set RAM type fixed to LPDDR4X and RAM size fixed to 2GB
	  for phyCORE-i.MX91/93.

endchoice

source "board/phytec/common/Kconfig"
endif
```

## board/phytec/phycore_imx93/Kconfig
```kconfig
if TARGET_PHYCORE_IMX93

config SYS_BOARD
	default "phycore_imx93"

config SYS_VENDOR
	default "phytec"

config SYS_CONFIG_NAME
	default "phycore_imx93"

config PHYCORE_IMX93_RAM_TYPE_FIX
	bool "Set phyCORE-i.MX93 RAM type and size fix instead of detecting"
	default false
	help
	  RAM type and size is being automatically detected with the help
	  of the PHYTEC EEPROM introspection data.
	  Set RAM type to a fix value instead.

choice
	prompt "phyCORE-i.MX93 RAM type"
	depends on PHYCORE_IMX93_RAM_TYPE_FIX
	default PHYCORE_IMX93_RAM_TYPE_LPDDR4X_1GB

config PHYCORE_IMX93_RAM_TYPE_LPDDR4X_1GB
	bool "LPDDR4X 1GB RAM"
	help
	  Set RAM type fixed to LPDDR4X and RAM size fixed to 1GB
	  for phyCORE-i.MX93.

config PHYCORE_IMX93_RAM_TYPE_LPDDR4X_2GB
	bool "LPDDR4X 2GB RAM"
	help
	  Set RAM type fixed to LPDDR4X and RAM size fixed to 2GB
	  for phyCORE-i.MX93.

endchoice

source "board/phytec/common/Kconfig"
endif
```

## board/phytec/phycore_rk3288/Kconfig
```kconfig
if TARGET_PHYCORE_RK3288

config SYS_BOARD
	default "phycore_rk3288"

config SYS_VENDOR
	default "phytec"

config SYS_CONFIG_NAME
	default "phycore_rk3288"

endif
```

## board/pine64/quartzpro64-rk3588/Kconfig
```kconfig
if TARGET_QUARTZPRO64_RK3588

config SYS_BOARD
	default "quartzpro64-rk3588"

config SYS_VENDOR
	default "pine64"

config SYS_CONFIG_NAME
	default "quartzpro64-rk3588"

endif
```

## board/pine64/rockpro64_rk3399/Kconfig
```kconfig
if TARGET_ROCKPRO64_RK3399

config SYS_BOARD
	default "rockpro64_rk3399"

config SYS_VENDOR
	default "pine64"

config SYS_CONFIG_NAME
	default "rockpro64_rk3399"

endif
```

## board/pm520/Kconfig
```kconfig
if TARGET_PM520

config SYS_BOARD
	default "pm520"

config SYS_CONFIG_NAME
	default "PM520"

endif
```

## board/pm826/Kconfig
```kconfig
if TARGET_PM826

config SYS_BOARD
	default "pm826"

config SYS_CONFIG_NAME
	default "PM826"

endif
```

## board/pm828/Kconfig
```kconfig
if TARGET_PM828

config SYS_BOARD
	default "pm828"

config SYS_CONFIG_NAME
	default "PM828"

endif
```

## board/powkiddy/x55/Kconfig
```kconfig
if TARGET_POWKIDDY_X55_RK3566

config SYS_BOARD
	default "x55"

config SYS_VENDOR
	default "powkiddy"

config SYS_CONFIG_NAME
	default "powkiddy-x55-rk3566"

config BOARD_SPECIFIC_OPTIONS
	def_bool y

endif
```

## board/ppcag/bg0900/Kconfig
```kconfig
if TARGET_BG0900

config SYS_CPU
	default "arm926ejs"

config SYS_BOARD
	default "bg0900"

config SYS_VENDOR
	default "ppcag"

config SYS_SOC
	default "mxs"

config SYS_CONFIG_NAME
	default "bg0900"

endif
```

## board/ppmc7xx/Kconfig
```kconfig
if TARGET_PPMC7XX

config SYS_BOARD
	default "ppmc7xx"

config SYS_CONFIG_NAME
	default "ppmc7xx"

endif
```

## board/ppmc8260/Kconfig
```kconfig
if TARGET_PPMC8260

config SYS_BOARD
	default "ppmc8260"

config SYS_CONFIG_NAME
	default "ppmc8260"

endif
```
