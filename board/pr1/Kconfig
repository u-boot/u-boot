## board/pr1/Kconfig
```kconfig
if TARGET_PR1

config SYS_BOARD
	default "pr1"

config SYS_CONFIG_NAME
	default "pr1"

endif
```

## board/prodrive/alpr/Kconfig
```kconfig
if TARGET_ALPR

config SYS_BOARD
	default "alpr"

config SYS_VENDOR
	default "prodrive"

config SYS_CONFIG_NAME
	default "alpr"

endif
```

## board/prodrive/p3mx/Kconfig
```kconfig
if TARGET_P3MX

config SYS_BOARD
	default "p3mx"

config SYS_VENDOR
	default "prodrive"

config SYS_CONFIG_NAME
	default "p3mx"

endif
```

## board/prodrive/p3p440/Kconfig
```kconfig
if TARGET_P3P440

config SYS_BOARD
	default "p3p440"

config SYS_VENDOR
	default "prodrive"

config SYS_CONFIG_NAME
	default "p3p440"

endif
```

## board/psyent/pci5441/Kconfig
```kconfig
if TARGET_PCI5441

config SYS_BOARD
	string
	default "pci5441"

config SYS_VENDOR
	string
	default "psyent"

config SYS_CONFIG_NAME
	string
	default "PCI5441"

endif
```

## board/psyent/pk1c20/Kconfig
```kconfig
if TARGET_PK1C20

config SYS_BOARD
	string
	default "pk1c20"

config SYS_VENDOR
	string
	default "psyent"

config SYS_CONFIG_NAME
	string
	default "PK1C20"

endif
```

## board/pxa255_idp/Kconfig
```kconfig
if TARGET_PXA255_IDP

config SYS_BOARD
	default "pxa255_idp"

config SYS_CONFIG_NAME
	default "pxa255_idp"

endif
```

## board/qca/ap121/Kconfig
```kconfig
if TARGET_AP121

config SYS_VENDOR
	default "qca"

config SYS_BOARD
	default "ap121"

config SYS_CONFIG_NAME
	default "ap121"

endif
```

## board/qca/ap143/Kconfig
```kconfig
if TARGET_AP143

config SYS_VENDOR
	default "qca"

config SYS_BOARD
	default "ap143"

config SYS_CONFIG_NAME
	default "ap143"

endif
```

## board/qemu-mips/Kconfig
```kconfig
if TARGET_QEMU_MIPS

config SYS_BOARD
	default "qemu-mips"

config SYS_CONFIG_NAME
	default "qemu-mips" if 32BIT
	default "qemu-mips64" if 64BIT

config SYS_TEXT_BASE
	default 0xbfc00000 if 32BIT
	default 0xffffffffbfc00000 if 64BIT

endif
```

## board/qnap/ts433/Kconfig
```kconfig
if TARGET_QNAP_TS433_RK3568

config SYS_BOARD
	default "qnap_ts433"

config SYS_VENDOR
	default "qnap"

config SYS_CONFIG_NAME
	default "qnap_ts433"

endif
```

## board/r360mpi/Kconfig
```kconfig
if TARGET_R360MPI

config SYS_BOARD
	default "r360mpi"

config SYS_CONFIG_NAME
	default "R360MPI"

endif
```

## board/radxa/rock-2-rk3528/Kconfig
```kconfig
if TARGET_RADXA_ROCK_2_RK3528

config SYS_BOARD
	default "rock-2-rk3528"

config SYS_VENDOR
	default "radxa"

config BOARD_SPECIFIC_OPTIONS # dummy
	def_bool y
	select ADC
	select SPL_ADC

endif
```

## board/radxa/rock-5-itx-rk3588/Kconfig
```kconfig
if TARGET_ROCK_5_ITX_RK3588

config SYS_BOARD
	default "rock-5-itx-rk3588"

config SYS_VENDOR
	default "radxa"

config SYS_CONFIG_NAME
	default "rock-5-itx-rk3588"

endif
```

## board/radxa/rock-5c-rk3588s/Kconfig
```kconfig
if TARGET_ROCK_5C_RK3588S

config SYS_BOARD
	default "rock-5c-rk3588s"

config SYS_VENDOR
	default "radxa"

config SYS_CONFIG_NAME
	default "rock-5c-rk3588s"

endif
```

## board/radxa/rock/Kconfig
```kconfig
if TARGET_ROCK

config SYS_BOARD
	default "rock"

config SYS_VENDOR
	default "radxa"

config SYS_CONFIG_NAME
	default "rock"

endif
```

## board/radxa/rockpi4-rk3399/Kconfig
```kconfig
if TARGET_ROCKPI4_RK3399

config SYS_BOARD
	default "rockpi4-rk3399"

config SYS_VENDOR
	default "radxa"

config SYS_CONFIG_NAME
	default "rockpi4-rk3399"

config BOARD_SPECIFIC_OPTIONS # dummy
	def_bool y

endif
```

## board/radxa/zero3-rk3566/Kconfig
```kconfig
if TARGET_RADXA_ZERO_3_RK3566

config SYS_BOARD
	default "zero3-rk3566"

config SYS_VENDOR
	default "radxa"

config SYS_CONFIG_NAME
	default "evb_rk3568"

endif
```

## board/raidsonic/ib62x0/Kconfig
```kconfig
if TARGET_IB62X0

config SYS_BOARD
	string
	default "ib62x0"

config SYS_VENDOR
	string
	default "raidsonic"

config SYS_CONFIG_NAME
	string
	default "ib62x0"

endif
```

## board/raspberrypi/rpi/Kconfig
```kconfig
if TARGET_RPI

config SYS_BOARD
	default "rpi"

config SYS_VENDOR
	default "raspberrypi"

config SYS_SOC
	default "bcm2835"

config SYS_CONFIG_NAME
	default "rpi"

endif
```

## board/raspberrypi/rpi_2/Kconfig
```kconfig
if TARGET_RPI_2

config SYS_BOARD
	default "rpi_2"

config SYS_VENDOR
	default "raspberrypi"

config SYS_SOC
	default "bcm2835"

config SYS_CONFIG_NAME
	default "rpi_2"

endif
```

## board/raspberrypi/rpi_b/Kconfig
```kconfig
if TARGET_RPI_B

config SYS_CPU
	default "arm1176"

config SYS_BOARD
	default "rpi_b"

config SYS_VENDOR
	default "raspberrypi"

config SYS_SOC
	default "bcm2835"

config SYS_CONFIG_NAME
	default "rpi_b"

endif
```

## board/renesas/MigoR/Kconfig
```kconfig
if TARGET_MIGOR

config SYS_CPU
	default "sh4"

config SYS_BOARD
	default "MigoR"

config SYS_VENDOR
	default "renesas"

config SYS_CONFIG_NAME
	default "MigoR"

endif
```

## board/renesas/alt/Kconfig
```kconfig
if TARGET_ALT

config SYS_BOARD
	default "alt"

config SYS_VENDOR
	default "renesas"

config SYS_CONFIG_NAME
	default "alt"

config R8A7794_ETHERNET_B
	bool "Use ethernet B function"
	depends on TARGET_ALT
	default n
	help
	  ALT board can use default ethernet and etnernet B function.
	  This config set pin function of ethenet B. You also needt to change
	  DIP switch of board in order to use this function.

endif
```

## board/renesas/ap325rxa/Kconfig
```kconfig
if TARGET_AP325RXA

config SYS_BOARD
	default "ap325rxa"

config SYS_VENDOR
	default "renesas"

config SYS_CONFIG_NAME
	default "ap325rxa"

endif
```
