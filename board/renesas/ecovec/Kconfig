## board/renesas/ecovec/Kconfig
```kconfig
if TARGET_ECOVEC

config SYS_CPU
	default "sh4"

config SYS_BOARD
	default "ecovec"

config SYS_VENDOR
	default "renesas"

config SYS_CONFIG_NAME
	default "ecovec"

endif
```

## board/renesas/geist/Kconfig
```kconfig
if TARGET_GEIST

config SYS_SOC
	default "renesas"

config SYS_BOARD
	default "geist"

config SYS_VENDOR
	default "renesas"

config SYS_CONFIG_NAME
	default "geist"

endif
```

## board/renesas/genmai/Kconfig
```kconfig
if TARGET_GENMAI

config SYS_BOARD
	default "genmai"

config SYS_VENDOR
	default "renesas"

config SYS_CONFIG_NAME
	default "genmai"

endif
```

## board/renesas/ironhide/Kconfig
```kconfig
if TARGET_IRONHIDE

config SYS_SOC
	default "renesas"

config SYS_BOARD
	default "ironhide"

config SYS_VENDOR
	default "renesas"

config SYS_CONFIG_NAME
	default "ironhide"

endif
```

## board/renesas/koelsch/Kconfig
```kconfig
if TARGET_KOELSCH

config SYS_BOARD
	string
	default "koelsch"

config SYS_VENDOR
	string
	default "renesas"

config SYS_CONFIG_NAME
	string
	default "koelsch"

endif
```

## board/renesas/lager/Kconfig
```kconfig
if TARGET_LAGER

config SYS_BOARD
	string
	default "lager"

config SYS_VENDOR
	string
	default "renesas"

config SYS_CONFIG_NAME
	string
	default "lager"

endif
```

## board/renesas/r0p7734/Kconfig
```kconfig
if TARGET_R0P7734

config SYS_CPU
	default "sh4"

config SYS_BOARD
	default "r0p7734"

config SYS_VENDOR
	default "renesas"

config SYS_CONFIG_NAME
	default "r0p7734"

endif
```

## board/renesas/r2dplus/Kconfig
```kconfig
if TARGET_R2DPLUS

config SYS_CPU
	string
	default "sh4"

config SYS_BOARD
	string
	default "r2dplus"

config SYS_VENDOR
	string
	default "renesas"

config SYS_CONFIG_NAME
	string
	default "r2dplus"

endif
```

## board/renesas/r7780mp/Kconfig
```kconfig
if TARGET_R7780MP

config SYS_CPU
	string
	default "sh4"

config SYS_BOARD
	string
	default "r7780mp"

config SYS_VENDOR
	string
	default "renesas"

config SYS_CONFIG_NAME
	string
	default "r7780mp"

endif
```

## board/renesas/rsk7203/Kconfig
```kconfig
if TARGET_RSK7203

config SYS_BOARD
	default "rsk7203"

config SYS_VENDOR
	default "renesas"

config SYS_CONFIG_NAME
	default "rsk7203"

endif
```

## board/renesas/rsk7264/Kconfig
```kconfig
if TARGET_RSK7264

config SYS_BOARD
	default "rsk7264"

config SYS_VENDOR
	default "renesas"

config SYS_CONFIG_NAME
	default "rsk7264"

endif
```

## board/renesas/rsk7269/Kconfig
```kconfig
if TARGET_RSK7269

config SYS_BOARD
	default "rsk7269"

config SYS_VENDOR
	default "renesas"

config SYS_CONFIG_NAME
	default "rsk7269"

endif
```

## board/renesas/s4sk/Kconfig
```kconfig
if TARGET_S4SK

config SYS_SOC
	default "renesas"

config SYS_BOARD
	default "s4sk"

config SYS_VENDOR
	default "renesas"

config SYS_CONFIG_NAME
	default "s4sk"

endif
```

## board/renesas/sh7752evb/Kconfig
```kconfig
if TARGET_SH7752EVB

config SYS_CPU
	default "sh4"

config SYS_BOARD
	default "sh7752evb"

config SYS_VENDOR
	default "renesas"

config SYS_CONFIG_NAME
	default "sh7752evb"

endif
```

## board/renesas/sh7753evb/Kconfig
```kconfig
if TARGET_SH7753EVB

config SYS_CPU
	string
	default "sh4"

config SYS_BOARD
	string
	default "sh7753evb"

config SYS_VENDOR
	string
	default "renesas"

config SYS_CONFIG_NAME
	string
	default "sh7753evb"

endif
```

## board/renesas/sh7757lcr/Kconfig
```kconfig
if TARGET_SH7757LCR

config SYS_CPU
	string
	default "sh4"

config SYS_BOARD
	string
	default "sh7757lcr"

config SYS_VENDOR
	string
	default "renesas"

config SYS_CONFIG_NAME
	string
	default "sh7757lcr"

endif
```

## board/renesas/sh7763rdp/Kconfig
```kconfig
if TARGET_SH7763RDP

config SYS_CPU
	string
	default "sh4"

config SYS_BOARD
	string
	default "sh7763rdp"

config SYS_VENDOR
	string
	default "renesas"

config SYS_CONFIG_NAME
	string
	default "sh7763rdp"

endif
```

## board/renesas/sh7785lcr/Kconfig
```kconfig
if TARGET_SH7785LCR

config SYS_BOARD
	default "sh7785lcr"

config SYS_VENDOR
	default "renesas"

config SYS_CONFIG_NAME
	default "sh7785lcr"

endif
```

## board/renesas/sparrowhawk/Kconfig
```kconfig
if TARGET_SPARROWHAWK

config SYS_SOC
	default "renesas"

config SYS_BOARD
	default "sparrowhawk"

config SYS_VENDOR
	default "renesas"

config SYS_CONFIG_NAME
	default "sparrowhawk"

endif
```

## board/rikomagic/mk808/Kconfig
```kconfig
if TARGET_MK808

config SYS_BOARD
	default "mk808"

config SYS_VENDOR
	default "rikomagic"

config SYS_CONFIG_NAME
	default "mk808"

endif
```

## board/rockchip/evb_rk3308/Kconfig
```kconfig
if TARGET_EVB_RK3308

config SYS_BOARD
	default "evb_rk3308"

config SYS_VENDOR
	default "rockchip"

config SYS_CONFIG_NAME
	default "evb_rk3308"

endif
```

## board/rockchip/kylin_rk3036/Kconfig
```kconfig
if TARGET_KYLIN_RK3036

config SYS_BOARD
	default "kylin_rk3036"

config SYS_VENDOR
	default "rockchip"

config SYS_CONFIG_NAME
	default "kylin_rk3036"

endif
```

## board/rockchip/miniarm_rk3288/Kconfig
```kconfig
if TARGET_MINIARM_RK3288

config SYS_BOARD
	default "miniarm_rk3288"

config SYS_VENDOR
	default "rockchip"

config SYS_CONFIG_NAME
	default "miniarm_rk3288"

config BOARD_SPECIFIC_OPTIONS # dummy
	def_bool y

endif
```

## board/rockchip/sheep_rk3368/Kconfig
```kconfig
if TARGET_SHEEP

config SYS_BOARD
	default "sheep_rk3368"

config SYS_VENDOR
	default "rockchip"

config SYS_CONFIG_NAME
	default "sheep_rk3368"

endif
```

## board/rockchip/tinker_rk3288/Kconfig
```kconfig
if TARGET_TINKER_RK3288

config SYS_BOARD
	default "tinker_rk3288"

config SYS_VENDOR
	default "rockchip"

config SYS_CONFIG_NAME
	default "tinker_rk3288"

endif
```
