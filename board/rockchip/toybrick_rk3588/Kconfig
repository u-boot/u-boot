## board/rockchip/toybrick_rk3588/Kconfig
```kconfig
if TARGET_TOYBRICK_RK3588

config SYS_BOARD
	default "toybrick_rk3588"

config SYS_VENDOR
	default "rockchip"

config SYS_CONFIG_NAME
	default "toybrick_rk3588"

endif
```

## board/ronetix/imx8mq-cm/Kconfig
```kconfig
if TARGET_IMX8MQ_CM

config SYS_BOARD
	default "imx8mq-cm"

config SYS_VENDOR
	default "ronetix"

config SYS_CONFIG_NAME
	default "imx8mq_cm"

endif
```

## board/ronetix/pm9261/Kconfig
```kconfig
if TARGET_PM9261

config SYS_CPU
	default "arm926ejs"

config SYS_BOARD
	default "pm9261"

config SYS_VENDOR
	default "ronetix"

config SYS_SOC
	default "at91"

config SYS_CONFIG_NAME
	default "pm9261"

endif
```

## board/ronetix/pm9263/Kconfig
```kconfig
if TARGET_PM9263

config SYS_CPU
	string
	default "arm926ejs"

config SYS_BOARD
	string
	default "pm9263"

config SYS_VENDOR
	string
	default "ronetix"

config SYS_SOC
	string
	default "at91"

config SYS_CONFIG_NAME
	string
	default "pm9263"

endif
```

## board/ronetix/pm9g45/Kconfig
```kconfig
if TARGET_PM9G45

config SYS_BOARD
	default "pm9g45"

config SYS_VENDOR
	default "ronetix"

config SYS_SOC
	default "at91"

config SYS_CONFIG_NAME
	default "pm9g45"

endif
```

## board/sacsng/Kconfig
```kconfig
if TARGET_SACSNG

config SYS_BOARD
	default "sacsng"

config SYS_CONFIG_NAME
	default "sacsng"

endif
```

## board/samsung/arndale/Kconfig
```kconfig
if TARGET_ARNDALE

config SYS_BOARD
	string
	default "arndale"

config SYS_VENDOR
	string
	default "samsung"

config SYS_CONFIG_NAME
	string
	default "arndale"

endif
```

## board/samsung/axy17lte/Kconfig
```kconfig
config SYS_CONFIG_NAME
	string "Board configuration name"
	default "exynos78x0-common.h"
	help
	  This option contains information about board configuration name.
	  Based on this option include/configs/<CONFIG_SYS_CONFIG_NAME>.h header
	  will be used for board configuration.

if TARGET_A5Y17LTE
config SYS_BOARD
	default "axy17lte"
	help
	  a5y17lte is a production board for SM-A520F phone on Exynos7880 SoC.

config SYS_VENDOR
	default "samsung"

config SYS_CONFIG_NAME
	default "a5y17lte"

config EXYNOS7880
    bool "Exynos 7880 SOC support"
    default y
endif

if TARGET_A7Y17LTE
config SYS_BOARD
	default "axy17lte"
	help
	  a7y17lte is a production board for SM-A720F phone on Exynos7880 SoC.

config SYS_VENDOR
	default "samsung"

config SYS_CONFIG_NAME
	default "a5y17lte"

config EXYNOS7880
    bool "Exynos 7880 SOC support"
    default y
endif

if TARGET_A3Y17LTE
config SYS_BOARD
	default "axy17lte"
	help
	  a3y17lte is a production board for SM-A320F phone on Exynos7870 SoC.

config SYS_VENDOR
	default "samsung"

config SYS_CONFIG_NAME
	default "a3y17lte"

config EXYNOS7870
    bool "Exynos 7870 SOC support"
    default y
endif
```

## board/samsung/coreprimevelte/Kconfig
```kconfig
if TARGET_COREPRIMEVELTE

config SYS_BOARD
	default "coreprimevelte"

config SYS_VENDOR
	default "samsung"

config SYS_CONFIG_NAME
	default "pxa1908"

endif
```

## board/samsung/exynos-mobile/Kconfig
```kconfig
if TARGET_EXYNOS_MOBILE

config ENV_SOURCE_FILE
	default "exynos-mobile"

config LNX_KRNL_IMG_TEXT_OFFSET_BASE
	default TEXT_BASE

config SYS_BOARD
	default "exynos-mobile"

config SYS_CONFIG_NAME
	default "exynos-mobile"

config SYS_VENDOR
	default "samsung"

endif # TARGET_EXYNOS_MOBILE
```

## board/samsung/goni/Kconfig
```kconfig
if TARGET_S5P_GONI

config SYS_BOARD
	default "goni"

config SYS_VENDOR
	default "samsung"

config SYS_SOC
	default "s5pc1xx"

config SYS_CONFIG_NAME
	default "s5p_goni"

config DM
	default y

config DM_GPIO
	default y

config DM_SERIAL
	default y

endif
```

## board/samsung/itop4412/Kconfig
```kconfig
if TARGET_ITOP4412

config SYS_BOARD
	default "itop4412"

config SYS_VENDOR
	default "samsung"

config SYS_CONFIG_NAME
	default "itop4412"

config ITOP4412
    bool "TOPEET iTOP4412 development board"
    default y

config EXYNOS4412
    bool "Samsung Exynos4412 SoC used"
    default y

endif
```

## board/samsung/n1/Kconfig
```kconfig
if TARGET_SAMSUNG_N1

config SYS_BOARD
	default "n1"

config SYS_VENDOR
	default "samsung"

config TEGRA_BOARD_STRING
	string "Default Tegra board name"
	default "Samsung N1"

endif
```

## board/samsung/odroid/Kconfig
```kconfig
if TARGET_ODROID

config SYS_BOARD
	string
	default "odroid"

config SYS_VENDOR
	string
	default "samsung"

config SYS_CONFIG_NAME
	string
	default "odroid"

endif
```

## board/samsung/origen/Kconfig
```kconfig
if TARGET_ORIGEN

config SYS_BOARD
	string
	default "origen"

config SYS_VENDOR
	string
	default "samsung"

config SYS_CONFIG_NAME
	string
	default "origen"

endif
```

## board/samsung/smdk2410/Kconfig
```kconfig
if TARGET_SMDK2410

config SYS_BOARD
	default "smdk2410"

config SYS_VENDOR
	default "samsung"

config SYS_SOC
	default "s3c24x0"

config SYS_CONFIG_NAME
	default "smdk2410"

endif
```

## board/samsung/smdk5250/Kconfig
```kconfig
if TARGET_SMDK5250

config SYS_BOARD
	string
	default "smdk5250"

config SYS_VENDOR
	string
	default "samsung"

config SYS_CONFIG_NAME
	string
	default "smdk5250"

endif

if TARGET_SNOW

config SYS_BOARD
	string
	default "smdk5250"

config SYS_VENDOR
	string
	default "samsung"

config SYS_CONFIG_NAME
	string
	default "snow"

endif
```

## board/samsung/smdk5420/Kconfig
```kconfig
if TARGET_PEACH_PI

config SYS_BOARD
	string
	default "smdk5420"

config SYS_VENDOR
	string
	default "samsung"

config SYS_CONFIG_NAME
	string
	default "peach-pi"

endif

if TARGET_PEACH_PIT

config SYS_BOARD
	default "smdk5420"

config SYS_VENDOR
	default "samsung"

config SYS_CONFIG_NAME
	default "peach-pit"

endif

if TARGET_SMDK5420

config SYS_BOARD
	default "smdk5420"

config SYS_VENDOR
	default "samsung"

config SYS_CONFIG_NAME
	default "smdk5420"

endif
```

## board/samsung/smdkc100/Kconfig
```kconfig
if TARGET_SMDKC100

config SYS_BOARD
	default "smdkc100"

config SYS_VENDOR
	default "samsung"

config SYS_SOC
	default "s5pc1xx"

config SYS_CONFIG_NAME
	default "smdkc100"

config DM
	default y

config DM_GPIO
	default y

config DM_SERIAL
	default y

endif
```

## board/samsung/smdkv310/Kconfig
```kconfig
if TARGET_SMDKV310

config SYS_BOARD
	string
	default "smdkv310"

config SYS_VENDOR
	string
	default "samsung"

config SYS_CONFIG_NAME
	string
	default "smdkv310"

endif
```

## board/samsung/starqltechn/Kconfig
```kconfig
if TARGET_STARQLTECHN

config SYS_BOARD
	default "starqltechn"
	help
	  starqltechn is a production board for S9 and S9+ phones(SM-G96x0) phones based on SDM845 SoC.

config SYS_CONFIG_NAME
	default "sdm845"

config SYS_VENDOR
	default "samsung"

endif
```

## board/samsung/trats/Kconfig
```kconfig
if TARGET_TRATS

config SYS_BOARD
	string
	default "trats"

config SYS_VENDOR
	string
	default "samsung"

config SYS_CONFIG_NAME
	string
	default "trats"

endif
```

## board/samsung/trats2/Kconfig
```kconfig
if TARGET_TRATS2

config SYS_BOARD
	string
	default "trats2"

config SYS_VENDOR
	string
	default "samsung"

config SYS_CONFIG_NAME
	string
	default "trats2"

endif
```

## board/samsung/universal_c210/Kconfig
```kconfig
if TARGET_S5PC210_UNIVERSAL

config SYS_BOARD
	string
	default "universal_c210"

config SYS_VENDOR
	string
	default "samsung"

config SYS_CONFIG_NAME
	string
	default "s5pc210_universal"

endif
```

## board/samsung/x4412/Kconfig
```kconfig
if TARGET_X4412

config SYS_BOARD
	default "x4412"

config SYS_VENDOR
	default "samsung"

config SYS_CONFIG_NAME
	default "x4412"

config X4412
    bool "9tripod's X4412 board"
    default y

config EXYNOS4x12
    bool "exynos4x12 SoC"
    default y

endif
```
