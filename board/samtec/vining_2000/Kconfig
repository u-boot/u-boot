## board/samtec/vining_2000/Kconfig
```kconfig
if TARGET_SAMTEC_VINING_2000

config SYS_BOARD
	default "vining_2000"

config SYS_VENDOR
	default "samtec"

config SYS_CONFIG_NAME
	default "vining_2000"

endif
```

## board/sandburst/karef/Kconfig
```kconfig
if TARGET_KAREF

config SYS_BOARD
	default "karef"

config SYS_VENDOR
	default "sandburst"

config SYS_CONFIG_NAME
	default "KAREF"

endif
```

## board/sandburst/metrobox/Kconfig
```kconfig
if TARGET_METROBOX

config SYS_BOARD
	default "metrobox"

config SYS_VENDOR
	default "sandburst"

config SYS_CONFIG_NAME
	default "METROBOX"

endif
```

## board/sandisk/sansa_fuze_plus/Kconfig
```kconfig
if TARGET_SANSA_FUZE_PLUS

config SYS_CPU
	string
	default "arm926ejs"

config SYS_BOARD
	string
	default "sansa_fuze_plus"

config SYS_VENDOR
	string
	default "sandisk"

config SYS_SOC
	string
	default "mxs"

config SYS_CONFIG_NAME
	string
	default "sansa_fuze_plus"

endif
```

## board/sandpoint/Kconfig
```kconfig
if TARGET_SANDPOINT8240

config SYS_BOARD
	default "sandpoint"

config SYS_CONFIG_NAME
	default "Sandpoint8240"

endif

if TARGET_SANDPOINT8245

config SYS_BOARD
	default "sandpoint"

config SYS_CONFIG_NAME
	default "Sandpoint8245"

endif
```

## board/sbc405/Kconfig
```kconfig
if TARGET_SBC405

config SYS_BOARD
	default "sbc405"

config SYS_CONFIG_NAME
	default "sbc405"

endif
```

## board/sbc8349/Kconfig
```kconfig
if TARGET_SBC8349

config SYS_BOARD
	string
	default "sbc8349"

config SYS_CONFIG_NAME
	string
	default "sbc8349"

endif
```

## board/sbc8548/Kconfig
```kconfig
if TARGET_SBC8548

config SYS_BOARD
	string
	default "sbc8548"

config SYS_CONFIG_NAME
	string
	default "sbc8548"

endif
```

## board/sbc8641d/Kconfig
```kconfig
if TARGET_SBC8641D

config SYS_BOARD
	string
	default "sbc8641d"

config SYS_CONFIG_NAME
	string
	default "sbc8641d"

endif
```

## board/sc3/Kconfig
```kconfig
if TARGET_SC3

config SYS_BOARD
	default "sc3"

config SYS_CONFIG_NAME
	default "sc3"

endif
```

## board/scb9328/Kconfig
```kconfig
if TARGET_SCB9328

config SYS_BOARD
	default "scb9328"

config SYS_SOC
	default "imx"

config SYS_CONFIG_NAME
	default "scb9328"

endif
```

## board/schulercontrol/sc_sps_1/Kconfig
```kconfig
if TARGET_SC_SPS_1

config SYS_CPU
	string
	default "arm926ejs"

config SYS_BOARD
	string
	default "sc_sps_1"

config SYS_VENDOR
	string
	default "schulercontrol"

config SYS_SOC
	string
	default "mxs"

config SYS_CONFIG_NAME
	string
	default "sc_sps_1"

endif
```

## board/seco/tiago/Kconfig
```kconfig
if TARGET_TIAGO

config SYS_BOARD
	default "tiago"

config SYS_VENDOR
	default "seco"

config SYS_CONFIG_NAME
	default "tiago"

config CHAIN_OF_TRUST
	bool "Enable chain of trust"
	depends on FIT_SIGNATURE
	select IMX_HAB
	select ENV_IS_NOWHERE
	select BOARD_LATE_INIT
	help
	  Say Y here to enable options necessary for establishing a chain of
	  trust from the IMX boot ROM to Linux.

config BOOTDELAY
	default -2 if CHAIN_OF_TRUST

endif
```

## board/seco/tiago/dummy.its
```
/dts-v1/;

/ {
	description = "";
	#address-cells = <1>;

	images {
		dummy {
			data = <>;
			hash-1 {
				algo = "sha256";
			};
		};
	};
	configurations {
		default = "conf-1";
		conf-1 {
			dummy = "dummy";
			signature {
				algo = "sha256,rsa2048";
				key-name-hint = "vboot";
				sign-images = "dummy";
			};
		};
	};
};
```

## board/seco/tiago/u-boot.its
```
/dts-v1/;

/ {
	description = "";
	#address-cells = <1>;
	images {
		u-boot {
			description = "";
			data = /incbin/("../../../u-boot-nodtb.bin");
			type = "standalone";
			os = "U-Boot";
			arch = "arm";
			compression = "none";
			load = <0x87800000>;
			entry = <0x87800000>;
			hash-1 {
				algo = "sha256";
			};
		};

		fdt {
			description = "";
			data = /incbin/("../../../u-boot.dtb");
			type = "flat_dt";
			compression = "none";
			hash-1 {
				algo = "sha256";
			};
		};
	};

	configurations {
		default = "config-1";
		config-1 {
			description = "";
			loadables = "u-boot";
			fdt = "fdt";
			signature {
				algo = "sha256,rsa2048";
				key-name-hint = "vboot";
				sign-images = "loadables", "fdt";
			};
		};
	};
};
```

## board/shmin/Kconfig
```kconfig
if TARGET_SHMIN

config SYS_BOARD
	default "shmin"

config SYS_CONFIG_NAME
	default "shmin"

endif
```

## board/sielaff/imx6dl-sielaff/Kconfig
```kconfig
if TARGET_MX6S_SIELAFF

config SYS_BOARD
	default "imx6dl-sielaff"

config SYS_VENDOR
	default "sielaff"

config SYS_CONFIG_NAME
	default "imx6dl-sielaff"

endif
```

## board/siemens/capricorn/Kconfig
```kconfig
if TARGET_CAPRICORN


config SYS_BOARD
	default "capricorn"

config SYS_VENDOR
	default "siemens"

config SYS_CONFIG_NAME
	default "capricorn-common"

config IMX_CONFIG
	default "board/siemens/capricorn/imximage.cfg"

endif


config SPL_CMT
	bool "Enable Siemens SPL RAM test"
	depends on SPL
	help
	  Enable SIemens SPL RAM test.

source "board/siemens/common/Kconfig"
```

## board/siemens/common/Kconfig
```kconfig
config FACTORYSET
	bool

config DDR_SI_TEST
	bool "DDR signal integrity test implementations"
	depends on TARGET_CAPRICORN
	default y
```

## board/siemens/corvus/Kconfig
```kconfig
if TARGET_CORVUS

config SYS_BOARD
	default "corvus"

config SYS_VENDOR
	default "siemens"

config SYS_SOC
	default "at91"

config SYS_CONFIG_NAME
	default "corvus"

endif
```

## board/siemens/draco/Kconfig
```kconfig
if TARGET_DRACO

config SYS_BOARD
	default "draco"

config SYS_VENDOR
	default "siemens"

config SYS_SOC
	default "am33xx"

config SYS_CONFIG_NAME
	default "draco"

endif

if TARGET_DXR2

config SYS_BOARD
	default "draco"

config SYS_VENDOR
	default "siemens"

config SYS_SOC
	default "am33xx"

config SYS_CONFIG_NAME
	default "dxr2"

endif
```

## board/siemens/iot2050/Kconfig
```kconfig
# SPDX-License-Identifier: GPL-2.0+
#
# Copyright (c) Siemens AG, 2018-2023
#
# Authors:
#   Le Jin <le.jin@siemens.com>
#   Jan Kiszka <jan.kiszka@siemens.com>

config TARGET_IOT2050_A53
	bool "IOT2050 running on A53"
	select ARM64
	select SOC_K3_AM654
	select BOARD_LATE_INIT
	select SYS_DISABLE_DCACHE_OPS
	select BINMAN
	help
	  This builds U-Boot for the IOT2050 devices.

if TARGET_IOT2050_A53

config SYS_BOARD
	default "iot2050"

config SYS_VENDOR
	default "siemens"

config SYS_CONFIG_NAME
	default "iot2050"

config IOT2050_BOOT_SWITCH
	bool "Disable eMMC boot via USER button (Advanced version only)"
	default y

config IOT2050_EMBED_OTPCMD
	bool "Embed OTP programming data"
	help
	  Embed signed OTP programming data 'otpcmd.bin' into the firmware
	  image. This data will be evaluated and executed on first boot of the
	  device.

endif
```

## board/siemens/pxm2/Kconfig
```kconfig
if TARGET_PXM2

config SYS_CPU
	string
	default "armv7"

config SYS_BOARD
	string
	default "pxm2"

config SYS_VENDOR
	string
	default "siemens"

config SYS_SOC
	string
	default "am33xx"

config SYS_CONFIG_NAME
	string
	default "pxm2"

endif
```

## board/siemens/rut/Kconfig
```kconfig
if TARGET_RUT

config SYS_CPU
	string
	default "armv7"

config SYS_BOARD
	string
	default "rut"

config SYS_VENDOR
	string
	default "siemens"

config SYS_SOC
	string
	default "am33xx"

config SYS_CONFIG_NAME
	string
	default "rut"

endif
```

## board/siemens/taurus/Kconfig
```kconfig
if TARGET_TAURUS

config SYS_BOARD
	default "taurus"

config SYS_VENDOR
	default "siemens"

config SYS_CONFIG_NAME
	default "taurus"

endif
```
