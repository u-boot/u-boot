## board/sifive/fu540/Kconfig
```kconfig
if TARGET_SIFIVE_FU540

config SYS_BOARD
	default "fu540"

config SYS_VENDOR
	default "sifive"

config SYS_CPU
	default "fu540"

config SYS_CONFIG_NAME
	default "sifive-fu540"

config SYS_TEXT_BASE
	default 0x80200000 if SPL
	default 0x80000000 if !RISCV_SMODE
	default 0x80200000 if RISCV_SMODE

config SPL_TEXT_BASE
	default 0x08000000

config SPL_OPENSBI_LOAD_ADDR
	default 0x80000000

config BOARD_SPECIFIC_OPTIONS # dummy
	def_bool y
	select SIFIVE_FU540
	select SUPPORT_SPL
	select RAM
	select SPL_RAM if SPL
	imply CMD_DHCP
	imply CMD_EXT2
	imply CMD_EXT4
	imply CMD_FAT
	imply CMD_FS_GENERIC
	imply CMD_GPT
	imply PARTITION_TYPE_GUID
	imply CMD_NET
	imply CMD_PING
	imply CMD_SF
	imply CLK_SIFIVE
	imply CLK_SIFIVE_FU540_PRCI
	imply DOS_PARTITION
	imply EFI_PARTITION
	imply IP_DYN
	imply ISO_PARTITION
	imply MACB
	imply MII
	imply NET_RANDOM_ETHADDR
	imply PHY_LIB
	imply PHY_MSCC
	imply SIFIVE_SERIAL
	imply SPI
	imply SPI_SIFIVE
	imply SPI_FLASH
	imply SPI_FLASH_ISSI
	imply MMC
	imply MMC_SPI
	imply MMC_BROKEN_CD
	imply CMD_MMC
	imply DM_GPIO
	imply SIFIVE_GPIO
	imply CMD_GPIO
	imply SMP
	imply MISC
	imply SIFIVE_OTP

endif
```

## board/silica/pengwyn/Kconfig
```kconfig
if TARGET_PENGWYN

config SYS_BOARD
	default "pengwyn"

config SYS_VENDOR
	default "silica"

config SYS_SOC
	default "am33xx"

config SYS_CONFIG_NAME
	default "pengwyn"

config DM
	default y

config DM_GPIO
	default y

config DM_SERIAL
	default y

endif
```

## board/sixnet/Kconfig
```kconfig
if TARGET_SXNI855T

config SYS_BOARD
	string
	default "sixnet"

config SYS_CONFIG_NAME
	string
	default "SXNI855T"

endif
```

## board/skyworth/hc2910-2aghd05/Kconfig
```kconfig
if TARGET_HC2910_2AGHD05

config SYS_BOARD
	default "hc2910-2aghd05"

config SYS_VENDOR
	default "skyworth"

config SYS_SOC
	default "hi3798mv200"

endif
```

## board/socrates/Kconfig
```kconfig
if TARGET_SOCRATES

config SYS_BOARD
	string
	default "socrates"

config SYS_CONFIG_NAME
	string
	default "socrates"

endif
```

## board/solidrun/clearfog/Kconfig
```kconfig
menu "ClearFog configuration"
	depends on TARGET_CLEARFOG

config TARGET_CLEARFOG_BASE
	bool "Use ClearFog Base static configuration"
	help
	  Use the ClearFog Base as the static configuration instead of the
	  default which uses the ClearFog Pro.

	  Runtime board detection is always attempted and used if available. The
	  static configuration is used as a fallback in cases where runtime
	  detection is disabled, is not available in hardware, or otherwise fails.

	  Only newer revisions of the ClearFog product line support runtime
	  detection via additional EEPROM hardware. This option enables selecting
	  the Base variant for older hardware revisions.

config CLEARFOG_SFP_25GB
	bool "Enable 2.5 Gbps mode for SFP"
	help
	  Set the SFP module connection to support 2.5 Gbps transfer speed for the
	  SGMII connection (requires a supporting SFP). By default, transfer speed
	  of 1.25 Gbps is used, suitable for a more common 1 Gbps SFP module.

endmenu
```

## board/solidrun/hummingboard/Kconfig
```kconfig
if TARGET_HUMMINGBOARD

config SYS_BOARD
	default "hummingboard"

config SYS_VENDOR
	default "solidrun"

config SYS_SOC
	default "mx6"

config SYS_CONFIG_NAME
	default "hummingboard"

endif
```

## board/solidrun/mx6cuboxi/Kconfig
```kconfig
if TARGET_MX6CUBOXI

config SYS_BOARD
	default "mx6cuboxi"

config SYS_VENDOR
	default "solidrun"

config SYS_SOC
	default "mx6"

config SYS_CONFIG_NAME
	default "mx6cuboxi"

endif
```

## board/somlabs/visionsom-6ull/Kconfig
```kconfig
if TARGET_SOMLABS_VISIONSOM_6ULL

config SYS_BOARD
	default "visionsom-6ull"

config SYS_VENDOR
	default "somlabs"

config SYS_CONFIG_NAME
	default "somlabs_visionsom_6ull"

endif
```

## board/sophgo/licheerv_nano/Kconfig
```kconfig
if TARGET_LICHEERV_NANO

config SYS_BOARD
	default "licheerv_nano"

config SYS_VENDOR
	default "sophgo"

config SYS_CPU
	default "cv1800b"

config SYS_CONFIG_NAME
	default "licheerv_nano"

config TEXT_BASE
	default 0x80200000

config ENV_SIZE
	default 0x20000

config ENV_SECT_SIZE
	default 0x40000

config BOARD_SPECIFIC_OPTIONS
	def_bool y
	select SOPHGO_CV1800B

endif
```

## board/spacemit/bananapi-f3/Kconfig
```kconfig
if TARGET_BANANAPI_F3

config SYS_BOARD
	default "bananapi-f3"

config SYS_VENDOR
	default "spacemit"

config SYS_CPU
	default "k1"

config SYS_CONFIG_NAME
	default "bananapi-f3"

config TEXT_BASE
	default 0x00200000

config SPL_OPENSBI_LOAD_ADDR
	default 0x00000000

config BOARD_SPECIFIC_OPTIONS
	def_bool y
	select SPACEMIT_K1

endif
```

## board/spacemit/k1/Kconfig
```kconfig
if TARGET_SPACEMIT_K1

config SYS_BOARD
	default "k1"

config SYS_VENDOR
	default "spacemit"

config SYS_CPU
	default "k1"

config SYS_CONFIG_NAME
	default "k1"

config TEXT_BASE
	default 0x00200000

config SPL_OPENSBI_LOAD_ADDR
	default 0x00000000

config BOARD_SPECIFIC_OPTIONS
	def_bool y
	select SPACEMIT_K1

endif
```

## board/spd8xx/Kconfig
```kconfig
if TARGET_SPD823TS

config SYS_BOARD
	default "spd8xx"

config SYS_CONFIG_NAME
	default "SPD823TS"

endif
```

## board/spear/spear300/Kconfig
```kconfig
if TARGET_SPEAR300

config SYS_CPU
	string
	default "arm926ejs"

config SYS_BOARD
	string
	default "spear300"

config SYS_VENDOR
	string
	default "spear"

config SYS_SOC
	string
	default "spear"

config SYS_CONFIG_NAME
	string
	default "spear3xx_evb"

endif
```

## board/spear/spear310/Kconfig
```kconfig
if TARGET_SPEAR310

config SYS_CPU
	string
	default "arm926ejs"

config SYS_BOARD
	string
	default "spear310"

config SYS_VENDOR
	string
	default "spear"

config SYS_SOC
	string
	default "spear"

config SYS_CONFIG_NAME
	string
	default "spear3xx_evb"

endif
```

## board/spear/spear600/Kconfig
```kconfig
if TARGET_SPEAR600

config SYS_CPU
	default "arm926ejs"

config SYS_BOARD
	default "spear600"

config SYS_VENDOR
	default "spear"

config SYS_SOC
	default "spear"

config SYS_CONFIG_NAME
	default "spear6xx_evb"

endif
```

## board/spear/x600/Kconfig
```kconfig
if TARGET_X600

config SYS_CPU
	default "arm926ejs"

config SYS_BOARD
	default "x600"

config SYS_VENDOR
	default "spear"

config SYS_SOC
	default "spear"

config SYS_CONFIG_NAME
	default "x600"

endif
```

## board/st-ericsson/snowball/Kconfig
```kconfig
if TARGET_SNOWBALL

config SYS_CPU
	default "armv7"

config SYS_BOARD
	default "snowball"

config SYS_VENDOR
	default "st-ericsson"

config SYS_SOC
	default "u8500"

config SYS_CONFIG_NAME
	default "snowball"

endif
```

## board/st-ericsson/u8500/Kconfig
```kconfig
if TARGET_U8500_HREF

config SYS_CPU
	default "armv7"

config SYS_BOARD
	default "u8500"

config SYS_VENDOR
	default "st-ericsson"

config SYS_SOC
	default "u8500"

config SYS_CONFIG_NAME
	default "u8500_href"

endif
```

## board/st/common/Kconfig
```kconfig
config CMD_STBOARD
	bool "stboard - command for OTP board information"
	depends on ARCH_STM32MP
	default y if TARGET_ST_STM32MP15x
	help
	  This compile the stboard command to
	  read and write the board in the OTP.

config MTDPARTS_NAND0_BOOT
	string "mtd boot partitions for nand0"
	default "2m(fsbl),2m(ssbl1),2m(ssbl2)"
	depends on SYS_MTDPARTS_RUNTIME && ARCH_STM32MP
	help
	  This define the partitions of nand0 used to build mtparts dynamically
	  for boot from nand0.
	  Each partition need to be aligned with the device erase block size,
	  512KB is the max size for the NAND supported by stm32mp1 platform.

config MTDPARTS_NAND0_TEE
	string "mtd tee partitions for nand0"
	default "512k(teeh),512k(teed),512k(teex)"
	depends on SYS_MTDPARTS_RUNTIME && ARCH_STM32MP
	help
	  This define the tee partitions added in mtparts dynamically
	  when tee is supported with boot from nand0.
	  Each partition need to be aligned with the device erase block size,
	  512KB is the max size for the NAND supported by stm32mp1 platform.

config MTDPARTS_NOR0_BOOT
	string "mtd boot partitions for nor0"
	default "256k(fsbl1),256k(fsbl2),2m(ssbl),512k(u-boot-env)"
	depends on SYS_MTDPARTS_RUNTIME && ARCH_STM32MP
	help
	  This define the partitions of nand0 used to build mtparts dynamically
	  for boot from nor0.
	  Each partition need to be aligned with the device erase block size,
	  with 256KB we support all the NOR.
	  U-Boot env partition (512kB) use 2 erase block for redundancy.

config MTDPARTS_NOR0_TEE
	string "mtd tee partitions for nor0"
	default "256k(teeh),256k(teed),256k(teex)"
	depends on SYS_MTDPARTS_RUNTIME && ARCH_STM32MP
	help
	  This define the tee partitions added in mtparts dynamically
	  when tee is supported with boot from nor0.

config MTDPARTS_SPINAND0_BOOT
	string "mtd boot partitions for spi-nand0"
	default "2m(fsbl),2m(ssbl1),2m(ssbl2)"
	depends on SYS_MTDPARTS_RUNTIME && ARCH_STM32MP
	help
	  This define the partitions of nand0 used to build mtparts dynamically
	  for boot from spi-nand0,
	  512KB is the max size for the NAND supported by stm32mp1 platform.

config MTDPARTS_SPINAND0_TEE
	string "mtd tee partitions for spi-nand0"
	default "512k(teeh),512k(teed),512k(teex)"
	depends on SYS_MTDPARTS_RUNTIME && ARCH_STM32MP
	help
	  This define the tee partitions added in mtparts dynamically
	  when tee is supported with boot from spi-nand0,
	  512KB is the max size for the NAND supported by stm32mp1 platform.

config DFU_ALT_RAM0
	string "dfu for ram0"
	default "uImage ram 0xc2000000 0x2000000;devicetree.dtb ram 0xc4000000 0x100000;uramdisk.image.gz ram 0xc4400000 0x10000000"
	depends on ARCH_STM32MP && SET_DFU_ALT_INFO
	help
	  This defines the partitions of ram used to build dfu dynamically.
```

## board/st/nhk8815/Kconfig
```kconfig
if NOMADIK_NHK8815

config SYS_BOARD
	default "nhk8815"

config SYS_VENDOR
	default "st"

config SYS_CONFIG_NAME
	default "nhk8815"

endif
```

## board/st/stih410-b2260/Kconfig
```kconfig
if TARGET_STIH410_B2260

config SYS_BOARD
	default "stih410-b2260"

config SYS_VENDOR
	default "st"

config SYS_SOC
	default "stih410"

config SYS_CONFIG_NAME
	default "stih410-b2260"

endif
```

## board/st/stm32f429-discovery/Kconfig
```kconfig
if TARGET_STM32F429_DISCOVERY

config SYS_BOARD
	default "stm32f429-discovery"

config SYS_VENDOR
	default "st"

config SYS_SOC
	default "stm32f4"

config SYS_CONFIG_NAME
	default "stm32f429-discovery"

endif
```

## board/st/stm32f429-evaluation/Kconfig
```kconfig
if TARGET_STM32F429_EVALUATION

config SYS_BOARD
	default "stm32f429-evaluation"

config SYS_VENDOR
	default "st"

config SYS_SOC
	default "stm32f4"

config SYS_CONFIG_NAME
	default "stm32f429-evaluation"

endif
```

## board/st/stm32f746-disco/Kconfig
```kconfig
if TARGET_STM32F746_DISCO

config SYS_BOARD
	default "stm32f746-disco"

config SYS_VENDOR
	default "st"

config SYS_SOC
	default "stm32f7"

config SYS_CONFIG_NAME
	default "stm32f746-disco"

endif
```
