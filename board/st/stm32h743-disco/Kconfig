## board/svm_sc8xx/Kconfig
```kconfig
if TARGET_SVM_SC8XX

config SYS_BOARD
	string
	default "svm_sc8xx"

config SYS_CONFIG_NAME
	string
	default "svm_sc8xx"

endif
```

## board/synopsys/Kconfig
```kconfig
if TARGET_ARCANGEL4

config SYS_VENDOR
	default "synopsys"

config SYS_CONFIG_NAME
	default "arcangel4"

endif
```

## board/synopsys/axs101/Kconfig
```kconfig
if TARGET_AXS101

config SYS_CPU
	default "arc700"

config SYS_BOARD
	default "axs101"

config SYS_VENDOR
	default "synopsys"

config SYS_CONFIG_NAME
	default "axs101"

endif
```

## board/synopsys/axs10x/Kconfig
```kconfig
if TARGET_AXS10X

config SYS_BOARD
	default "axs10x"

config SYS_VENDOR
	default "synopsys"

config SYS_CONFIG_NAME
	default "axs10x"

endif
```

## board/synopsys/emdk/Kconfig
```kconfig
if TARGET_EMDK

config SYS_BOARD
	default "emdk"

config SYS_VENDOR
	default "synopsys"

config SYS_CONFIG_NAME
	default "emdk"

endif
```

## board/synopsys/hsdk/Kconfig
```kconfig
if TARGET_HSDK

config SYS_BOARD
	default "hsdk"

config SYS_VENDOR
	default "synopsys"

config SYS_CONFIG_NAME
	default "hsdk"

choice
	prompt "HSDK board type"
	default BOARD_HSDK

config BOARD_HSDK
	bool "ARC HS Development Kit"
	help
	  ARC HS Development Kit based on quard core ARC HS38 processor

config BOARD_HSDK_4XD
	bool "ARC HS4x/HS4xD Development Kit"
	help
	  ARC HS4x/HS4xD Development Kit based on quard core ARC HS48/HS47D
	  processor

endchoice

endif
```

## board/synopsys/nsim/Kconfig
```kconfig
if TARGET_NSIM

config SYS_BOARD
	default "nsim"

config SYS_VENDOR
	default "synopsys"

config SYS_CONFIG_NAME
	default "nsim"

endif
```

## board/sysam/amcore/Kconfig
```kconfig
if TARGET_AMCORE

config SYS_CPU
        default "mcf530x"

config SYS_BOARD
        default "amcore"

config SYS_VENDOR
        default "sysam"

config SYS_CONFIG_NAME
        default "amcore"

endif
```

## board/sysam/stmark2/Kconfig
```kconfig
if TARGET_STMARK2

config CF_SBF
	def_bool y

config EXTRA_CLOCK
	def_bool y

config SYS_INPUT_CLKSRC
	hex
	default 30000000

config SYS_CPU
	default "mcf5445x"

config SYS_BOARD
	default "stmark2"

config SYS_VENDOR
	default "sysam"

config SYS_CONFIG_NAME
	default "stmark2"

endif
```

## board/syteco/jadecpu/Kconfig
```kconfig
if TARGET_JADECPU

config SYS_BOARD
	default "jadecpu"

config SYS_VENDOR
	default "syteco"

config SYS_SOC
	default "mb86r0x"

config SYS_CONFIG_NAME
	default "jadecpu"

endif
```

## board/t3corp/Kconfig
```kconfig
if TARGET_T3CORP

config SYS_BOARD
	default "t3corp"

config SYS_CONFIG_NAME
	default "t3corp"

endif
```

## board/taskit/stamp9g20/Kconfig
```kconfig
if TARGET_STAMP9G20

config SYS_BOARD
	default "stamp9g20"

config SYS_VENDOR
	default "taskit"

config SYS_SOC
	default "at91"

config SYS_CONFIG_NAME
	default "stamp9g20"

endif
```

## board/tbs/tbs2910/Kconfig
```kconfig
if TARGET_TBS2910

config SYS_BOARD
	default "tbs2910"

config SYS_VENDOR
	default "tbs"

config SYS_CONFIG_NAME
	default "tbs2910"

config MX6Q
	default y

config IMX_CONFIG
	default "board/boundary/nitrogen6x/nitrogen6q2g.cfg"

endif
```
