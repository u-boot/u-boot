## board/st/stm32h743-disco/Kconfig
```kconfig
if TARGET_STM32H743_DISCO

config SYS_BOARD
	default "stm32h743-disco"

config SYS_VENDOR
	default "st"

config SYS_SOC
	default "stm32h7"

config SYS_CONFIG_NAME
	default "stm32h743-disco"

endif
```

## board/st/stm32h743-eval/Kconfig
```kconfig
if TARGET_STM32H743_EVAL

config SYS_BOARD
	default "stm32h743-eval"

config SYS_VENDOR
	default "st"

config SYS_SOC
	default "stm32h7"

config SYS_CONFIG_NAME
	default "stm32h743-eval"

endif
```

## board/st/stm32h743-nucleo/Kconfig
```kconfig
if TARGET_STM32H743_NUCLEO

config SYS_BOARD
	string
	default "stm32h743-nucleo"

config SYS_VENDOR
	string
	default "st"

config SYS_SOC
	string
	default "stm32h7"

config SYS_CONFIG_NAME
	string
	default "stm32h743-nucleo"

config SYS_EXEC_IN_PLACE
	bool "Execute-in-place (ROM) rather than relocating to RAM"
	default y
	help
	  If true, execute U-boot code in-place from flash ROM.
	  Do not relocate the code and read-only data to RAM.
	  The .data and .bss sections must be located in RAM.
	  The .data section will be initialized from a ROM copy.

config SYS_GLOBAL_DATA_POINTER
	hex "Address of global data pointer in RAM"
	default 0x30047FC0
	help
	  If defined, this is the address in RAM of the global data pointer.
	  For most targets the global data pointer is held in a reserved
	  CPU register. If the register is needed for something else, the
	  pointer can be stored in a known fixed RAM location. This costs
	  two memory-referencing instructions for reference to global data,
	  but it frees up a CPU register for use by application programs.

endif
```

## board/st/stm32h747-disco/Kconfig
```kconfig
if TARGET_STM32H747_DISCO

config SYS_BOARD
	default "stm32h747-disco"

config SYS_VENDOR
	default "st"

config SYS_SOC
	default "stm32h7"

config SYS_CONFIG_NAME
	default "stm32h747-disco"

endif
```

## board/st/stm32h750-art-pi/Kconfig
```kconfig
if TARGET_STM32H750_ART_PI

config SYS_BOARD
	default "stm32h750-art-pi"

config SYS_VENDOR
	default "st"

config SYS_SOC
	default "stm32h7"

config SYS_CONFIG_NAME
	default "stm32h750-art-pi"

endif
```

## board/st/stm32mp1/Kconfig
```kconfig
if TARGET_ST_STM32MP15x

config SYS_BOARD
	default "stm32mp1"

config SYS_VENDOR
	default "st"

config SYS_CONFIG_NAME
	default "stm32mp15_st_common"

source "board/st/common/Kconfig"

config FWU_NUM_BANKS
       default 2

config FWU_NUM_IMAGES_PER_BANK
	default 1

endif
```

## board/st/stv0991/Kconfig
```kconfig
if TARGET_STV0991

config SYS_CPU
	string
	default "armv7"

config SYS_BOARD
	string
	default "stv0991"

config SYS_VENDOR
	string
	default "st"

config SYS_SOC
	string
	default "stv0991"

config SYS_CONFIG_NAME
	string
	default "stv0991"

endif
```

## board/storopack/smegw01/Kconfig
```kconfig
if TARGET_SMEGW01

config SYS_BOARD
	default "smegw01"

config SYS_VENDOR
	default "storopack"

config SYS_CONFIG_NAME
	default "smegw01"

config IMX_CONFIG
	default "board/storopack/smegw01/imximage.cfg"

endif
```

## board/stx/stxgp3/Kconfig
```kconfig
if TARGET_STXGP3

config SYS_BOARD
	default "stxgp3"

config SYS_VENDOR
	default "stx"

config SYS_CONFIG_NAME
	default "stxgp3"

endif
```

## board/stx/stxssa/Kconfig
```kconfig
if TARGET_STXSSA

config SYS_BOARD
	default "stxssa"

config SYS_VENDOR
	default "stx"

config SYS_CONFIG_NAME
	default "stxssa"

endif
```

## board/stx/stxxtc/Kconfig
```kconfig
if TARGET_STXXTC

config SYS_BOARD
	string
	default "stxxtc"

config SYS_VENDOR
	string
	default "stx"

config SYS_CONFIG_NAME
	string
	default "stxxtc"

endif
```
