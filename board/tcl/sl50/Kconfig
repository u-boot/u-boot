## board/tcl/sl50/Kconfig
```kconfig
if TARGET_AM335X_SL50

config SYS_BOARD
	default "sl50"

config SYS_VENDOR
	default "tcl"

config SYS_SOC
	default "am33xx"

config SYS_CONFIG_NAME
	default "am335x_sl50"

config CONS_INDEX
	int "UART used for console"
	range 1 6
	default 1
	help
	  The AM335x SoC has a total of 6 UARTs (UART0 to UART5 as referenced
	  in documentation, etc) available to it.  Depending on your specific
	  board you may want something other than UART0 as for example the IDK
	  uses UART3 so enter 4 here.

endif
```

## board/tcm-bf518/Kconfig
```kconfig
if TARGET_TCM_BF518

config SYS_BOARD
	default "tcm-bf518"

config SYS_CONFIG_NAME
	default "tcm-bf518"

endif
```

## board/tcm-bf537/Kconfig
```kconfig
if TARGET_TCM_BF537

config SYS_BOARD
	default "tcm-bf537"

config SYS_CONFIG_NAME
	default "tcm-bf537"

endif
```

## board/technexion/pico-imx8mq/Kconfig
```kconfig
if TARGET_PICO_IMX8MQ

config SYS_BOARD
	default "pico-imx8mq"

config SYS_VENDOR
	default "technexion"

config SYS_CONFIG_NAME
	default "pico-imx8mq"

config IMX_CONFIG
	default "board/technexion/pico-imx8mq/imximage.cfg"

endif
```

## board/technexion/tao3530/Kconfig
```kconfig
if TARGET_TAO3530

config SYS_BOARD
	string
	default "tao3530"

config SYS_VENDOR
	string
	default "technexion"

config SYS_CONFIG_NAME
	string
	default "tao3530"

endif
```

## board/technexion/twister/Kconfig
```kconfig
if TARGET_TWISTER

config SYS_BOARD
	default "twister"

config SYS_VENDOR
	default "technexion"

config SYS_CONFIG_NAME
	default "twister"

endif
```

## board/teejet/mt_ventoux/Kconfig
```kconfig
if TARGET_MT_VENTOUX

config SYS_BOARD
	default "mt_ventoux"

config SYS_VENDOR
	default "teejet"

config SYS_CONFIG_NAME
	default "mt_ventoux"

endif
```

## board/theobroma-systems/jaguar_rk3588/Kconfig
```kconfig
if TARGET_JAGUAR_RK3588

config SYS_BOARD
	default "jaguar_rk3588"

config SYS_VENDOR
	default "theobroma-systems"

config SYS_CONFIG_NAME
	default "jaguar_rk3588"

config BOARD_SPECIFIC_OPTIONS # dummy
	def_bool y
	select ENV_IS_NOWHERE

endif
```

## board/theobroma-systems/lion_rk3368/Kconfig
```kconfig
if TARGET_LION_RK3368

config SYS_BOARD
	default "lion_rk3368"

config SYS_VENDOR
	default "theobroma-systems"

config SYS_CONFIG_NAME
	default "lion_rk3368"

config BOARD_SPECIFIC_OPTIONS # dummy
	def_bool y

endif
```

## board/theobroma-systems/puma_rk3399/Kconfig
```kconfig
if TARGET_PUMA_RK3399

config SYS_BOARD
	default "puma_rk3399"

config SYS_VENDOR
	default "theobroma-systems"

config SYS_CONFIG_NAME
	default "puma_rk3399"

config BOARD_SPECIFIC_OPTIONS # dummy
	def_bool y

endif
```

## board/theobroma-systems/puma_rk3399/fit_spl_atf.its
```
/* SPDX-License-Identifier: GPL-2.0+ OR X11 */
/*
 * Copyright (C) 2017 Theobroma Systems Design und Consulting GmbH
 *
 * Minimal dts for a SPL FIT image payload.
 */

/dts-v1/;

/ {
	description = "FIT image with U-Boot proper, ATF bl31, M0 Firmware, DTB";
	#address-cells = <1>;

	images {
		uboot {
			description = "U-Boot (64-bit)";
			data = /incbin/("../../../u-boot-nodtb.bin");
			type = "standalone";
			os = "U-Boot";
			arch = "arm64";
			compression = "none";
			load = <0x00200000>;
		};
		atf {
			description = "ARM Trusted Firmware";
			data = /incbin/("../../../bl31-rk3399.bin");
			type = "firmware";
			arch = "arm64";
			os = "arm-trusted-firmware";
			compression = "none";
			load = <0x1000>;
			entry = <0x1000>;
		};
		pmu {
		        description = "Cortex-M0 firmware";
			data = /incbin/("../../../rk3399m0.bin");
			type = "pmu-firmware";
			compression = "none";
			load = <0x180000>;
                };
		fdt {
			description = "RK3399-Q7 (Puma) flat device-tree";
			data = /incbin/("../../../u-boot.dtb");
			type = "flat_dt";
			compression = "none";
		};
	};

	configurations {
		default = "conf";
		conf {
			description = "Theobroma Systems RK3399-Q7 (Puma) SoM";
			firmware = "atf";
			loadables = "uboot", "pmu";
			fdt = "fdt";
		};
	};
};
```

## board/theobroma-systems/ringneck_px30/Kconfig
```kconfig
if TARGET_RINGNECK_PX30

config SYS_BOARD
	default "ringneck_px30"

config SYS_VENDOR
	default "theobroma-systems"

config SYS_CONFIG_NAME
	default "ringneck_px30"

config BOARD_SPECIFIC_OPTIONS # dummy
	def_bool y

config ENV_SIZE
	default 0x3000

endif
```

## board/theobroma-systems/tiger_rk3588/Kconfig
```kconfig
if TARGET_TIGER_RK3588

config SYS_BOARD
	default "tiger_rk3588"

config SYS_VENDOR
	default "theobroma-systems"

config SYS_CONFIG_NAME
	default "tiger_rk3588"

config BOARD_SPECIFIC_OPTIONS # dummy
	def_bool y
	select ENV_IS_NOWHERE

endif
```

## board/ti/am335x/Kconfig
```kconfig
if TARGET_AM335X_EVM

config SYS_BOARD
	default "am335x"

config SYS_VENDOR
	default "ti"

config SYS_SOC
	default "am33xx"

config SYS_CONFIG_NAME
	default "am335x_evm"

config CONS_INDEX
	int "UART used for console"
	range 1 6
	default 1
	help
	  The AM335x SoC has a total of 6 UARTs (UART0 to UART5 as referenced
	  in documentation, etc) available to it.  Depending on your specific
	  board you may want something other than UART0 as for example the IDK
	  uses UART3 so enter 4 here.

config NOR
	bool "Support for NOR flash"
	help
	  The AM335x SoC supports having a NOR flash connected to the GPMC.
	  In practice this is seen as a NOR flash module connected to the
	  "memory cape" for the BeagleBone family.

source "board/ti/common/Kconfig"

endif
```

## board/ti/am3517crane/Kconfig
```kconfig
if TARGET_AM3517_CRANE

config SYS_BOARD
	string
	default "am3517crane"

config SYS_VENDOR
	string
	default "ti"

config SYS_CONFIG_NAME
	string
	default "am3517_crane"

endif
```

## board/ti/am43xx/Kconfig
```kconfig
if TARGET_AM43XX_EVM

config SYS_CPU
	string
	default "armv7"

config SYS_BOARD
	string
	default "am43xx"

config SYS_VENDOR
	string
	default "ti"

config SYS_SOC
	string
	default "am33xx"

config SYS_CONFIG_NAME
	string
	default "am43xx_evm"

endif
```

## board/ti/am57xx/Kconfig
```kconfig
if TARGET_AM57XX_EVM

config SYS_BOARD
	default "am57xx"

config SYS_VENDOR
	default "ti"

config SYS_CONFIG_NAME
	default "am57xx_evm"

config ENV_SOURCE_FILE
	default "am57xx"

source "board/ti/common/Kconfig"

endif

if TARGET_DRA7XX_EVM

config ENV_SOURCE_FILE
	default "am57xx"

source "board/ti/common/Kconfig"

endif
```

## board/ti/am62px/Kconfig
```kconfig
# SPDX-License-Identifier: GPL-2.0+
#
# Copyright (C) 2023 Texas Instruments Incorporated - https://www.ti.com/
#

if TARGET_AM62P5_R5_EVM || TARGET_AM62P5_A53_EVM

config SYS_BOARD
       default "am62px"

config SYS_VENDOR
       default "ti"

config SYS_CONFIG_NAME
       default "am62px_evm"

source "board/ti/common/Kconfig"

endif

if TARGET_AM62P5_R5_EVM

config SPL_LDSCRIPT
	default "arch/arm/mach-omap2/u-boot-spl.lds"

endif
```

## board/ti/am62x/Kconfig
```kconfig
# SPDX-License-Identifier: GPL-2.0+
#
# Copyright (C) 2020-2022 Texas Instruments Incorporated - https://www.ti.com/
#	Suman Anna <s-anna@ti.com>

choice
	prompt "TI K3 AM62x based boards"
	optional

config TARGET_AM625_A53_EVM
	bool "TI K3 based AM625 EVM running on A53"
	select ARM64
	select SOC_K3_AM625

config TARGET_AM625_R5_EVM
	bool "TI K3 based AM625 EVM running on R5"
	select CPU_V7R
	select SYS_THUMB_BUILD
	select K3_LOAD_SYSFW
	select SOC_K3_AM625
	select RAM
	select SPL_RAM
	select K3_DDRSS
	imply SYS_K3_SPL_ATF

endchoice

if TARGET_AM625_A53_EVM

config SYS_BOARD
       default "am62x"

config SYS_VENDOR
       default "ti"

config SYS_CONFIG_NAME
       default "am62x_evm"

source "board/ti/common/Kconfig"

endif

if TARGET_AM625_R5_EVM

config SYS_BOARD
       default "am62x"

config SYS_VENDOR
       default "ti"

config SYS_CONFIG_NAME
       default "am62x_evm"

config SPL_LDSCRIPT
	default "arch/arm/mach-omap2/u-boot-spl.lds"

source "board/ti/common/Kconfig"

endif
```

## board/ti/am64x/Kconfig
```kconfig
# SPDX-License-Identifier: GPL-2.0+
#
# Copyright (C) 2020-2021 Texas Instruments Incorporated - https://www.ti.com/

choice
	prompt "K3 AM64 based boards"
	optional

config TARGET_AM642_A53_EVM
	bool "TI K3 based AM642 EVM running on A53"
	select ARM64
	select SOC_K3_AM642
	imply BOARD
	imply SPL_BOARD
	imply TI_I2C_BOARD_DETECT

config TARGET_AM642_R5_EVM
	bool "TI K3 based AM642 EVM running on R5"
	select CPU_V7R
	select SYS_THUMB_BUILD
	select K3_LOAD_SYSFW
	select SOC_K3_AM642
	select RAM
	select SPL_RAM
	select K3_DDRSS
	imply SYS_K3_SPL_ATF
	imply TI_I2C_BOARD_DETECT

endchoice

if TARGET_AM642_A53_EVM

config SYS_BOARD
       default "am64x"

config SYS_VENDOR
       default "ti"

config SYS_CONFIG_NAME
       default "am64x_evm"

source "board/ti/common/Kconfig"

endif

if TARGET_AM642_R5_EVM

config SYS_BOARD
       default "am64x"

config SYS_VENDOR
       default "ti"

config SYS_CONFIG_NAME
       default "am64x_evm"

source "board/ti/common/Kconfig"

endif
```

## board/ti/am65x/Kconfig
```kconfig
# SPDX-License-Identifier: GPL-2.0+
#
# Copyright (C) 2017-2018 Texas Instruments Incorporated - http://www.ti.com/
#	Lokesh Vutla <lokeshvutla@ti.com>

choice
	prompt "K3 AM65 based boards"
	optional

config TARGET_AM654_A53_EVM
	bool "TI K3 based AM654 EVM running on A53"
	select ARM64
	select SOC_K3_AM654
	select SYS_DISABLE_DCACHE_OPS
	select BOARD_LATE_INIT
	imply TI_I2C_BOARD_DETECT

config TARGET_AM654_R5_EVM
	bool "TI K3 based AM654 EVM running on R5"
	select CPU_V7R
	select SYS_THUMB_BUILD
	select SOC_K3_AM654
	select K3_LOAD_SYSFW
	select K3_AM654_DDRSS
	imply SYS_K3_SPL_ATF
	imply TI_I2C_BOARD_DETECT

endchoice

if TARGET_AM654_A53_EVM

config SYS_BOARD
       default "am65x"

config SYS_VENDOR
       default "ti"

config SYS_CONFIG_NAME
       default "am65x_evm"

source "board/ti/common/Kconfig"

endif

if TARGET_AM654_R5_EVM

config SYS_BOARD
       default "am65x"

config SYS_VENDOR
       default "ti"

config SYS_CONFIG_NAME
       default "am65x_evm"

source "board/ti/common/Kconfig"

endif
```

## board/ti/beagle/Kconfig
```kconfig
if TARGET_OMAP3_BEAGLE

config SYS_BOARD
	string
	default "beagle"

config SYS_VENDOR
	string
	default "ti"

config SYS_CONFIG_NAME
	string
	default "omap3_beagle"

endif
```

## board/ti/beagle_x15/Kconfig
```kconfig
if TARGET_BEAGLE_X15

config SYS_BOARD
	default "beagle_x15"

config SYS_VENDOR
	default "ti"

config SYS_CONFIG_NAME
	default "beagle_x15"

endif
```

## board/ti/common/Kconfig
```kconfig
config TI_I2C_BOARD_DETECT
	bool "Support for Board detection for TI platforms"
	help
	   Support for detection board information on Texas Instrument's
	   Evaluation Boards which have I2C based EEPROM detection

config EEPROM_BUS_ADDRESS
	int "Board EEPROM's I2C bus address"
	range 0 8
	default 0

config EEPROM_CHIP_ADDRESS
	hex "Board EEPROM's I2C chip address"
	range 0 0xff
	default 0x50
```

## board/ti/dra7xx/Kconfig
```kconfig
if TARGET_DRA7XX_EVM

config SYS_BOARD
	default "dra7xx"

config SYS_VENDOR
	default "ti"

config SYS_CONFIG_NAME
	default "dra7xx_evm"

config CONS_INDEX
	int "UART used for console"
	range 1 6
	default 1
	help
	  The DRA7xx (and AM57x) SoC has a total of 6 UARTs available to it.
	  Depending on your specific board you may want something other than UART1
	  here.
endif
```
