## board/ti/evm/Kconfig
```kconfig
if TARGET_OMAP3_EVM

config SYS_BOARD
	default "evm"

config SYS_VENDOR
	default "ti"

config SYS_CONFIG_NAME
	default "omap3_evm"

endif

if TARGET_OMAP3_EVM_QUICK_MMC

config SYS_BOARD
	default "evm"

config SYS_VENDOR
	default "ti"

config SYS_CONFIG_NAME
	default "omap3_evm_quick_mmc"

endif

if TARGET_OMAP3_EVM_QUICK_NAND

config SYS_BOARD
	default "evm"

config SYS_VENDOR
	default "ti"

config SYS_CONFIG_NAME
	default "omap3_evm_quick_nand"

endif
```

## board/ti/j7200/Kconfig
```kconfig
# SPDX-License-Identifier: GPL-2.0+
#
# Copyright (C) 2018-2019 Texas Instruments Incorporated - https://www.ti.com/
#	Lokesh Vutla <lokeshvutla@ti.com>

if TARGET_J7200_A72_EVM

config SYS_BOARD
       default "j7200"

config SYS_VENDOR
       default "ti"

config SYS_CONFIG_NAME
       default "j721e_evm"

config ENV_SOURCE_FILE
       default "j7200"

source "board/ti/common/Kconfig"

endif

if TARGET_J7200_R5_EVM

config SYS_BOARD
       default "j7200"

config SYS_VENDOR
       default "ti"

config SYS_CONFIG_NAME
       default "j721e_evm"

config ENV_SOURCE_FILE
       default "j7200"

source "board/ti/common/Kconfig"

endif
```

## board/ti/j721e/Kconfig
```kconfig
# SPDX-License-Identifier: GPL-2.0+
#
# Copyright (C) 2018-2019 Texas Instruments Incorporated - http://www.ti.com/
#	Lokesh Vutla <lokeshvutla@ti.com>

choice
	prompt "K3 J721E based boards"
	optional

config TARGET_J721E_A72_EVM
	bool "TI K3 based J721E EVM running on A72"
	select ARM64
	select SOC_K3_J721E
	select BOARD_LATE_INIT
	imply TI_I2C_BOARD_DETECT
	select SYS_DISABLE_DCACHE_OPS

config TARGET_J721E_R5_EVM
	bool "TI K3 based J721E EVM running on R5"
	select CPU_V7R
	select SYS_THUMB_BUILD
	select SOC_K3_J721E
	select K3_LOAD_SYSFW
	select RAM
	select SPL_RAM
	select K3_J721E_DDRSS
	imply SYS_K3_SPL_ATF
	imply TI_I2C_BOARD_DETECT

config TARGET_J7200_A72_EVM
	bool "TI K3 based J7200 EVM running on A72"
	select ARM64
	select SOC_K3_J721E
	select BOARD_LATE_INIT
	imply TI_I2C_BOARD_DETECT
	select SYS_DISABLE_DCACHE_OPS

config TARGET_J7200_R5_EVM
	bool "TI K3 based J7200 EVM running on R5"
	select CPU_V7R
	select SYS_THUMB_BUILD
	select SOC_K3_J721E
	select K3_LOAD_SYSFW
	select RAM
	select SPL_RAM
	select K3_J721E_DDRSS
	imply SYS_K3_SPL_ATF
	imply TI_I2C_BOARD_DETECT

endchoice

if TARGET_J721E_A72_EVM

config SYS_BOARD
       default "j721e"

config SYS_VENDOR
       default "ti"

config SYS_CONFIG_NAME
       default "j721e_evm"

source "board/ti/common/Kconfig"

endif

if TARGET_J721E_R5_EVM

config SYS_BOARD
       default "j721e"

config SYS_VENDOR
       default "ti"

config SYS_CONFIG_NAME
       default "j721e_evm"

config SPL_LDSCRIPT
	default "arch/arm/mach-omap2/u-boot-spl.lds"

source "board/ti/common/Kconfig"

endif

if TARGET_J7200_A72_EVM

config SYS_BOARD
       default "j721e"

config SYS_VENDOR
       default "ti"

config SYS_CONFIG_NAME
       default "j721e_evm"

source "board/ti/common/Kconfig"

endif

if TARGET_J7200_R5_EVM

config SYS_BOARD
       default "j721e"

config SYS_VENDOR
       default "ti"

config SYS_CONFIG_NAME
       default "j721e_evm"

config SPL_LDSCRIPT
	default "arch/arm/mach-omap2/u-boot-spl.lds"

source "board/ti/common/Kconfig"

endif
```

## board/ti/j721s2/Kconfig
```kconfig
# SPDX-License-Identifier: GPL-2.0+
#
# Copyright (C) 2021 Texas Instruments Incorporated - https://www.ti.com/
#	David Huang <d-huang@ti.com>

choice
	prompt "K3 J721S2 board"
	optional

config TARGET_J721S2_A72_EVM
	bool "TI K3 based J721S2 EVM running on A72"
	select ARM64
	select SOC_K3_J721S2
	select BOARD_LATE_INIT
	imply TI_I2C_BOARD_DETECT
	select SYS_DISABLE_DCACHE_OPS

config TARGET_J721S2_R5_EVM
	bool "TI K3 based J721S2 EVM running on R5"
	select CPU_V7R
	select SYS_THUMB_BUILD
	select SOC_K3_J721S2
	select K3_LOAD_SYSFW
	select RAM
	select SPL_RAM
	select K3_DDRSS
	imply SYS_K3_SPL_ATF
	imply TI_I2C_BOARD_DETECT

endchoice

if TARGET_J721S2_A72_EVM

config SYS_BOARD
       default "j721s2"

config SYS_VENDOR
       default "ti"

config SYS_CONFIG_NAME
       default "j721s2_evm"

source "board/ti/common/Kconfig"

endif

if TARGET_J721S2_R5_EVM

config SYS_BOARD
       default "j721s2"

config SYS_VENDOR
       default "ti"

config SYS_CONFIG_NAME
       default "j721s2_evm"

source "board/ti/common/Kconfig"

endif
```

## board/ti/j722s/Kconfig
```kconfig
# SPDX-License-Identifier: GPL-2.0+
#
# Copyright (C) 2024 Texas Instruments Incorporated - https://www.ti.com/
#

if TARGET_J722S_R5_EVM || TARGET_J722S_A53_EVM

config SYS_BOARD
       default "j722s"

config SYS_VENDOR
       default "ti"

config SYS_CONFIG_NAME
       default "j722s_evm"

source "board/ti/common/Kconfig"

endif

if TARGET_J722S_R5_EVM

config SPL_LDSCRIPT
	default "arch/arm/mach-omap2/u-boot-spl.lds"

endif
```

## board/ti/j784s4/Kconfig
```kconfig
# SPDX-License-Identifier: GPL-2.0-or-later
#
# Copyright (C) 2023-2024 Texas Instruments Incorporated - https://www.ti.com/
#	Hari Nagalla <hnagalla@ti.com>

if TARGET_J784S4_A72_EVM

config SYS_BOARD
       default "j784s4"

config SYS_VENDOR
       default "ti"

config SYS_CONFIG_NAME
       default "j784s4_evm"

source "board/ti/common/Kconfig"

endif

if TARGET_J784S4_R5_EVM

config SYS_BOARD
       default "j784s4"

config SYS_VENDOR
       default "ti"

config SYS_CONFIG_NAME
       default "j784s4_evm"

config SPL_LDSCRIPT
	default "arch/arm/mach-omap2/u-boot-spl.lds"

source "board/ti/common/Kconfig"

endif

if TARGET_J742S2_A72_EVM

config SYS_BOARD
       default "j784s4"

config SYS_VENDOR
       default "ti"

config SYS_CONFIG_NAME
       default "j784s4_evm"

source "board/ti/common/Kconfig"

endif

if TARGET_J742S2_R5_EVM

config SYS_BOARD
       default "j784s4"

config SYS_VENDOR
       default "ti"

config SYS_CONFIG_NAME
       default "j784s4_evm"

config SPL_LDSCRIPT
	default "arch/arm/mach-omap2/u-boot-spl.lds"

source "board/ti/common/Kconfig"

endif
```

## board/ti/ks2_evm/Kconfig
```kconfig
if TARGET_K2E_EVM

config SYS_BOARD
	default "ks2_evm"

config SYS_VENDOR
	default "ti"

config SYS_CONFIG_NAME
	default "k2e_evm"

endif

if TARGET_K2HK_EVM

config SYS_BOARD
	default "ks2_evm"

config SYS_VENDOR
	default "ti"

config SYS_CONFIG_NAME
	default "k2hk_evm"

endif

if TARGET_K2L_EVM

config SYS_BOARD
	string
	default "ks2_evm"

config SYS_VENDOR
	string
	default "ti"

config SYS_CONFIG_NAME
	string
	default "k2l_evm"

endif
```

## board/ti/omap5912osk/Kconfig
```kconfig
if TARGET_OMAP5912OSK

config SYS_CPU
	string
	default "arm926ejs"

config SYS_BOARD
	string
	default "omap5912osk"

config SYS_VENDOR
	string
	default "ti"

config SYS_SOC
	string
	default "omap"

config SYS_CONFIG_NAME
	string
	default "omap5912osk"

endif
```

## board/ti/omap5_uevm/Kconfig
```kconfig
if TARGET_OMAP5_UEVM

config SYS_BOARD
	string
	default "omap5_uevm"

config SYS_VENDOR
	string
	default "ti"

config SYS_CONFIG_NAME
	string
	default "omap5_uevm"

endif
```

## board/ti/panda/Kconfig
```kconfig
if TARGET_OMAP4_PANDA

config SYS_BOARD
	string
	default "panda"

config SYS_VENDOR
	string
	default "ti"

config SYS_CONFIG_NAME
	string
	default "omap4_panda"

endif
```

## board/ti/sdp3430/Kconfig
```kconfig
if TARGET_OMAP3_SDP3430

config SYS_BOARD
	default "sdp3430"

config SYS_VENDOR
	default "ti"

config SYS_CONFIG_NAME
	default "omap3_sdp3430"

endif
```

## board/ti/sdp4430/Kconfig
```kconfig
if TARGET_OMAP4_SDP4430

config SYS_BOARD
	default "sdp4430"

config SYS_VENDOR
	default "ti"

config SYS_CONFIG_NAME
	default "omap4_sdp4430"

endif
```

## board/ti/ti814x/Kconfig
```kconfig
if TARGET_TI814X_EVM

config SYS_CPU
	string
	default "armv7"

config SYS_BOARD
	string
	default "ti814x"

config SYS_VENDOR
	string
	default "ti"

config SYS_SOC
	string
	default "am33xx"

config SYS_CONFIG_NAME
	string
	default "ti814x_evm"

endif
```

## board/ti/ti816x/Kconfig
```kconfig
if TARGET_TI816X_EVM

config SYS_CPU
	string
	default "armv7"

config SYS_BOARD
	string
	default "ti816x"

config SYS_VENDOR
	string
	default "ti"

config SYS_SOC
	string
	default "am33xx"

config SYS_CONFIG_NAME
	string
	default "ti816x_evm"

endif
```

## board/ti/tnetv107xevm/Kconfig
```kconfig
if TARGET_TNETV107X_EVM

config SYS_BOARD
	default "tnetv107xevm"

config SYS_VENDOR
	default "ti"

config SYS_SOC
	default "tnetv107x"

config SYS_CONFIG_NAME
	default "tnetv107x_evm"

endif
```

## board/timll/devkit3250/Kconfig
```kconfig
if TARGET_DEVKIT3250

config SYS_CPU
	string
	default "arm926ejs"

config SYS_BOARD
	string
	default "devkit3250"

config SYS_VENDOR
	string
	default "timll"

config SYS_SOC
	string
	default "lpc32xx"

config SYS_CONFIG_NAME
	string
	default "devkit3250"

endif
```

## board/timll/devkit8000/Kconfig
```kconfig
if TARGET_DEVKIT8000

config SYS_BOARD
	string
	default "devkit8000"

config SYS_VENDOR
	string
	default "timll"

config SYS_CONFIG_NAME
	string
	default "devkit8000"

endif
```

## board/toradex/apalis_t30/Kconfig
```kconfig
if TARGET_APALIS_T30

config SYS_BOARD
	default "apalis_t30"

config SYS_VENDOR
	default "toradex"

config SYS_CONFIG_NAME
	default "apalis_t30"

endif
```

## board/toradex/aquila-am69/Kconfig
```kconfig
# SPDX-License-Identifier: GPL-2.0-only
#
# Copyright (C) 2025 Toradex
#

if TARGET_AQUILA_AM69_A72

config SYS_BOARD
       default "aquila-am69"

config SYS_VENDOR
       default "toradex"

config SYS_CONFIG_NAME
       default "aquila-am69"

config TDX_CFG_BLOCK
	default y

config TDX_CFG_BLOCK_2ND_ETHADDR
	default y

config TDX_CFG_BLOCK_DEV
	default "0"

config TDX_CFG_BLOCK_EXTRA
	default y

config TDX_CFG_BLOCK_OFFSET
	default "-512"

config TDX_CFG_BLOCK_PART
	default "1"

config TDX_HAVE_EEPROM_EXTRA
	default y

config TDX_HAVE_MMC
	default y

source "board/toradex/common/Kconfig"

endif

if TARGET_AQUILA_AM69_R5

config SYS_BOARD
       default "aquila-am69"

config SYS_VENDOR
       default "toradex"

config SYS_CONFIG_NAME
       default "aquila-am69"

config SPL_LDSCRIPT
	default "arch/arm/mach-omap2/u-boot-spl.lds"

endif
```

## board/toradex/colibri_imx7/Kconfig
```kconfig
if TARGET_COLIBRI_IMX7

config SYS_BOARD
	default "colibri_imx7"

config SYS_VENDOR
	default "toradex"

config SYS_CONFIG_NAME
	default "colibri_imx7"

config COLIBRI_IMX7_EXT_PHYCLK
	bool "External oscillator for Ethernet PHY clock provided"
	help
	  Select this if your module provides a external Ethernet PHY
	  clock source.
	default y

config TDX_CFG_BLOCK
	default y

config TDX_HAVE_NAND
	default y

config TDX_CFG_BLOCK_OFFSET
	default "2048"

config TDX_CFG_BLOCK_OFFSET2
	default "133120"

config TDX_CFG_BLOCK_2ND_ETHADDR
	default y

source "board/toradex/common/Kconfig"

endif
```

## board/toradex/colibri_pxa270/Kconfig
```kconfig
if TARGET_COLIBRI_PXA270

config SYS_BOARD
	default "colibri_pxa270"

config SYS_VENDOR
	default "toradex"

config SYS_CONFIG_NAME
	default "colibri_pxa270"

endif
```

## board/toradex/colibri_t20/Kconfig
```kconfig
if TARGET_COLIBRI_T20

config SYS_BOARD
	default "colibri_t20"

config SYS_VENDOR
	default "toradex"

config SYS_CONFIG_NAME
	default "colibri_t20"

endif
```

## board/toradex/colibri_t20_iris/Kconfig
```kconfig
if TARGET_COLIBRI_T20_IRIS

config SYS_BOARD
	default "colibri_t20_iris"

config SYS_VENDOR
	default "toradex"

config SYS_CONFIG_NAME
	default "colibri_t20_iris"

endif
```

## board/toradex/colibri_t30/Kconfig
```kconfig
if TARGET_COLIBRI_T30

config SYS_BOARD
	default "colibri_t30"

config SYS_VENDOR
	default "toradex"

config SYS_CONFIG_NAME
	default "colibri_t30"

endif
```

## board/toradex/colibri_vf/Kconfig
```kconfig
if TARGET_COLIBRI_VF

config SYS_CPU
	default "armv7"

config SYS_BOARD
	default "colibri_vf"

config SYS_VENDOR
	default "toradex"

config SYS_SOC
	default "vf610"

config SYS_CONFIG_NAME
	default "colibri_vf"

endif
```
