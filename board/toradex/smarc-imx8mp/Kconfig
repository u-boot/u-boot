## board/toradex/smarc-imx8mp/Kconfig
```kconfig
if TARGET_TORADEX_SMARC_IMX8MP

config IMX_CONFIG
	default "board/toradex/smarc-imx8mp/imximage.cfg"

config SYS_BOARD
	default "smarc-imx8mp"

config SYS_CONFIG_NAME
	default "toradex-smarc-imx8mp"

config SYS_VENDOR
	default "toradex"

config TDX_CFG_BLOCK
	default y

config TDX_CFG_BLOCK_2ND_ETHADDR
	default y

config TDX_CFG_BLOCK_DEV
	default "0"

# Toradex config block in eMMC, at the end of 1st "boot sector"
config TDX_CFG_BLOCK_OFFSET
	default "-512"

config TDX_CFG_BLOCK_PART
	default "1"

config TDX_HAVE_EEPROM_EXTRA
	default y

config TDX_HAVE_MMC
	default y

source "board/toradex/common/Kconfig"

endif
```

## board/toradex/smarc-imx95/Kconfig
```kconfig
if TARGET_TORADEX_SMARC_IMX95

config SYS_BOARD
	default "smarc-imx95"

config SYS_VENDOR
	default "toradex"

config SYS_CONFIG_NAME
	default "toradex-smarc-imx95"

config TDX_CFG_BLOCK
	default y

config TDX_CFG_BLOCK_2ND_ETHADDR
	default y

config TDX_CFG_BLOCK_DEV
	default "0"

# Toradex config block in eMMC, at the end of 1st "boot sector"
config TDX_CFG_BLOCK_OFFSET
	default "-512"

config TDX_CFG_BLOCK_PART
	default "1"

config TDX_HAVE_EEPROM_EXTRA
	default y

config TDX_HAVE_MMC
	default y

source "board/toradex/common/Kconfig"

endif
```

## board/total5200/Kconfig
```kconfig
if TARGET_TOTAL5200

config SYS_BOARD
	default "total5200"

config SYS_CONFIG_NAME
	default "Total5200"

endif
```

## board/tplink/wdr4300/Kconfig
```kconfig
if BOARD_TPLINK_WDR4300

config SYS_VENDOR
	default "tplink"

config SYS_SOC
	default "ath79"

config SYS_BOARD
	default "wdr4300"

config SYS_CONFIG_NAME
	default "tplink_wdr4300"

endif
```

## board/tq/common/Kconfig
```kconfig
# SPDX-License-Identifier: GPL-2.0-or-later
#
# Copyright (c) 2023-2026 TQ-Systems GmbH <u-boot@ew.tq-group.com>,
# D-82229 Seefeld, Germany.
# Author: Markus Niebel, Max Merchel
#

config TQ_COMMON_BB
	bool
	default y

config TQ_COMMON_SDMMC
	bool

config TQ_COMMON_SOM
	bool
```

## board/tq/tqma6/Kconfig
```kconfig
if TARGET_TQMA6

config SYS_BOARD
	default "tqma6"

config SYS_VENDOR
	default "tq"

config SYS_CONFIG_NAME
	default "tqma6"

choice
	prompt "TQMa6 SoC variant"
	default TQMA6DL if MX6DL
	default TQMA6Q if MX6Q
	default TQMA6S if MX6S
	help
	  select the TQMa6 module variant. The variants only differ in the used
	  i.MX6 CPU type and DRAM

config TQMA6Q
	bool "TQMa6Q / TQMa6D"
	depends on MX6Q
	help
	  select TQMa6Q / TQMa6D variant with i.MX6Q resp. i.MX6D
	  with 1GiB DRAM

config TQMA6DL
	bool "TQMa6DL"
	depends on MX6DL
	help
	  select TQMa6DL variant with i.MX6DL
	  with 1GiB DRAM

config TQMA6S
	bool "TQMa6S"
	depends on MX6S
	help
	  select TQMa6S variant with i.MX6S
	  with 512 MiB DRAM

endchoice

choice
	prompt "TQMa6 boot configuration"
	default TQMA6X_MMC_BOOT
	help
	  Configure boot device. This is also used to implement environment
	  location.

config TQMA6X_MMC_BOOT
	bool "MMC / SD Boot"
	help
	  Boot from
	  eMMC / SD Card

config TQMA6X_SPI_BOOT
	bool "SPI NOR Boot"
	help
	  Boot from
	  board SPI NOR flash

endchoice

choice
	prompt "TQMa6 base board variant"
	default MBA6
	help
	  Select the baseboard variant for the TQMa6 module.
	  By default the MBA6 starterkit is used.

config MBA6
	bool "TQMa6 on MBa6 Starterkit"
	select USB
	select CMD_USB
	select USB_STORAGE
	select USB_HOST_ETHER
	select USB_ETHER_SMSC95XX
	select PHYLIB
	select PHY_MICREL
	select PHY_MICREL_KSZ90X1
	select MXC_UART
	imply OF_UPSTREAM
	imply DM_I2C
	imply DM_MMC
	imply DM_SPI
	imply DM_GPIO
	help
	  Select the MBa6 starterkit. This features a GigE Phy, USB, SD-Card
	  etc.

config WRU4
	bool "OHB WRU-IV"
	help
	  Select the
	  OHB Systems AG WRU-IV baseboard.

endchoice

config TEXT_BASE
	default 0x2fc00000 if TQMA6S
	default 0x4fc00000 if TQMA6Q || TQMA6DL

config IMX_CONFIG
	default "board/tq/tqma6/tqma6q.cfg" if TQMA6Q
	default "board/tq/tqma6/tqma6dl.cfg" if TQMA6DL
	default "board/tq/tqma6/tqma6s.cfg" if TQMA6S

endif
```

## board/tq/tqma6ul/Kconfig
```kconfig
# SPDX-License-Identifier: GPL-2.0-or-later
#
# Copyright (c) 2016-2026 TQ-Systems GmbH <u-boot@ew.tq-group.com>,
# D-82229 Seefeld, Germany.
# Author: Marco Felsch, Markus Niebel, Max Merchel
#

if TARGET_TQMA6UL

config SYS_BOARD
	default "tqma6ul"

config SYS_VENDOR
	default "tq"

config SYS_CONFIG_NAME
	default "tqma6ul_mba6ul" if MBA6UL

choice
	prompt "TQMa6UL module variant"
	default TQMA6UL_VARIANT_STANDARD
	help
	  Select the variant of the TQMa6UL SoM module being used.
	  By default, the variant with board-to-board connectors is used.

config TQMA6UL_VARIANT_STANDARD
	bool "standard module with board connector"
	help
	  Select for SoM variant connector
	  with board to board connectors

config TQMA6UL_VARIANT_LGA
	bool "LGA module with solder balls"
	help
	  Select for SoM variant LGA
	  with solder balls

endchoice

config TQMA6UL_RAM_256M
	bool

config TQMA6UL_RAM_512M
	bool

choice
	prompt "TQMa6UL RAM configuration"
	default TQMA6UL_RAM_MULTI
	help
	  Select RAM configuration. Normally use default here but for
	  specific setup it is possible to use a single RAM size.

config TQMA6UL_RAM_MULTI
	bool "TQMa6ULx with 256/512 MB RAM - Single image"
	select TQMA6UL_RAM_256M
	select TQMA6UL_RAM_512M
	help
	  Build a single U-Boot solely for variants
	  with 256/512 MB RAM.

config TQMA6UL_RAM_SINGLE_256M
	bool "TQMa6UL with 256 MB RAM"
	select TQMA6UL_RAM_256M
	help
	  Build U-Boot solely for variants
	  with 256 MB RAM.

config TQMA6UL_RAM_SINGLE_512M
	bool "TQMa6UL with 512 MB RAM"
	select TQMA6UL_RAM_512M
	help
	  Build U-Boot solely for variants
	  with 512 MB RAM.

endchoice

choice
	prompt "TQMa6UL base board variant"
	default MBA6UL
	help
	  Select the baseboard variant for the TQMa6UL module.
	  By default the MBA6UL starterkit is used.

config MBA6UL
	bool "TQMa6UL on MBa6ULx Starterkit"
	select TQ_COMMON_BB
	select TQ_COMMON_SDMMC
	select SYSINFO
	select SYSINFO_TQ_EEPROM
	select I2C_EEPROM
	select MISC
	select MXC_UART
	imply DM_ETH
	imply DM_GPIO
	imply DM_MMC
	imply DM_SERIAL
	imply DM_SPI
	imply OF_UPSTREAM
	imply PHYLIB
	imply PHY_SMSC
	imply USB
	imply USB_STORAGE
	help
	  Select the MBa6ULx starterkit.
	  This is the default base board.

endchoice

config IMX_CONFIG
	default "board/tq/tqma6ul/tqma6ul.cfg"

source "board/tq/common/Kconfig"

endif
```

## board/tq/tqma7/Kconfig
```kconfig
# SPDX-License-Identifier: GPL-2.0-or-later
#
# Copyright (c) 2016-2026 TQ-Systems GmbH <u-boot@ew.tq-group.com>,
# D-82229 Seefeld, Germany.
# Author: Markus Niebel, Steffen Doster
#

if TARGET_TQMA7

config SYS_BOARD
	default "tqma7"

config SYS_VENDOR
	default "tq"

config SYS_CONFIG_NAME
	default "tqma7"

choice
	prompt "TQMa7x RAM configuration"
	default TQMA7_RAM_MULTI
	help
	  Select RAM configuration. Normally use default here but for
	  specific setup it is possible to use a single RAM size.

config TQMA7_RAM_MULTI
	bool "TQMa7x with 512/1024/2048 MB RAM - Single image"
	select TQMA7_RAM_2G
	select TQMA7_RAM_1G
	select TQMA7_RAM_512M
	help
	  Build a single U-Boot solely for variants
	  with 512/1024/2048 MB RAM.

config TQMA7_RAM_SINGLE_2G
	bool "TQMa7x with 2 GB RAM"
	select TQMA7_RAM_2G
	help
	  Build U-Boot solely for variants
	  with 2 GB RAM.

config TQMA7_RAM_SINGLE_1G
	bool "TQMa7x with 1 GB RAM"
	select TQMA7_RAM_1G
	help
	  Build U-Boot solely for variants
	  with 1 GB RAM.

config TQMA7_RAM_SINGLE_512M
	bool "TQMa7x with 512 MB RAM"
	select TQMA7_RAM_512M
	help
	  Build U-Boot solely for variants
	  with 512 MB RAM.

endchoice

config TQMA7_RAM_2G
	bool

config TQMA7_RAM_1G
	bool

config TQMA7_RAM_512M
	bool

choice
	prompt "TQMa7x base board variant"
	default MBA7
	help
	  Select base board
	  for TQMa7x

config MBA7
	bool "TQMa7x on MBa7x Starterkit"
	select TQ_COMMON_BB
	select TQ_COMMON_SOM
	select TQ_COMMON_SYSINFO
	select I2C_EEPROM
	select MISC
	imply USB
	imply CMD_USB
	imply USB_STORAGE
	imply PHYLIB
	imply CONFIG_PHY_TI_DP83867
	select MXC_UART
	select DM_MMC
	select DM_SPI
	select DM_I2C
	select DM_GPIO
	imply DM_ETH
	help
	  Select the MBa7x
	  starterkit.

endchoice

config IMX_CONFIG
	default "board/tq/tqma7/tqma7.cfg"

source "board/tq/common/Kconfig"

endif
```

## board/tqc/tqm5200/Kconfig
```kconfig
if TARGET_CHARON

config SYS_BOARD
	default "tqm5200"

config SYS_VENDOR
	default "tqc"

config SYS_CONFIG_NAME
	default "charon"

endif

if TARGET_TQM5200

config SYS_BOARD
	default "tqm5200"

config SYS_VENDOR
	default "tqc"

config SYS_CONFIG_NAME
	default "TQM5200"

endif
```

## board/tqc/tqm8260/Kconfig
```kconfig
if TARGET_TQM8260

config SYS_BOARD
	default "tqm8260"

config SYS_VENDOR
	default "tqc"

config SYS_CONFIG_NAME
	default "TQM8260"

endif
```

## board/tqc/tqm8272/Kconfig
```kconfig
if TARGET_TQM8272

config SYS_BOARD
	default "tqm8272"

config SYS_VENDOR
	default "tqc"

config SYS_CONFIG_NAME
	default "TQM8272"

endif
```

## board/tqc/tqm834x/Kconfig
```kconfig
if TARGET_TQM834X

config SYS_BOARD
	string
	default "tqm834x"

config SYS_VENDOR
	string
	default "tqc"

config SYS_CONFIG_NAME
	string
	default "TQM834x"

endif
```

## board/tqc/tqm8xx/Kconfig
```kconfig
if TARGET_TQM823L

config SYS_BOARD
	default "tqm8xx"

config SYS_VENDOR
	default "tqc"

config SYS_CONFIG_NAME
	default "TQM823L"

endif

if TARGET_TQM823M

config SYS_BOARD
	default "tqm8xx"

config SYS_VENDOR
	default "tqc"

config SYS_CONFIG_NAME
	default "TQM823M"

endif

if TARGET_TQM850L

config SYS_BOARD
	default "tqm8xx"

config SYS_VENDOR
	default "tqc"

config SYS_CONFIG_NAME
	default "TQM850L"

endif

if TARGET_TQM850M

config SYS_BOARD
	default "tqm8xx"

config SYS_VENDOR
	default "tqc"

config SYS_CONFIG_NAME
	default "TQM850M"

endif

if TARGET_TQM855L

config SYS_BOARD
	default "tqm8xx"

config SYS_VENDOR
	default "tqc"

config SYS_CONFIG_NAME
	default "TQM855L"

endif

if TARGET_TQM855M

config SYS_BOARD
	default "tqm8xx"

config SYS_VENDOR
	default "tqc"

config SYS_CONFIG_NAME
	default "TQM855M"

endif

if TARGET_TQM860L

config SYS_BOARD
	default "tqm8xx"

config SYS_VENDOR
	default "tqc"

config SYS_CONFIG_NAME
	default "TQM860L"

endif

if TARGET_TQM860M

config SYS_BOARD
	default "tqm8xx"

config SYS_VENDOR
	default "tqc"

config SYS_CONFIG_NAME
	default "TQM860M"

endif

if TARGET_TQM862L

config SYS_BOARD
	default "tqm8xx"

config SYS_VENDOR
	default "tqc"

config SYS_CONFIG_NAME
	default "TQM862L"

endif

if TARGET_TQM862M

config SYS_BOARD
	default "tqm8xx"

config SYS_VENDOR
	default "tqc"

config SYS_CONFIG_NAME
	default "TQM862M"

endif

if TARGET_TQM866M

config SYS_BOARD
	default "tqm8xx"

config SYS_VENDOR
	default "tqc"

config SYS_CONFIG_NAME
	default "TQM866M"

endif

if TARGET_TQM885D

config SYS_BOARD
	default "tqm8xx"

config SYS_VENDOR
	default "tqc"

config SYS_CONFIG_NAME
	default "TQM885D"

endif
```

## board/tqc/tqma6/Kconfig
```kconfig
if TARGET_TQMA6

config SYS_BOARD
	default "tqma6"

config SYS_VENDOR
	default "tqc"

config SYS_SOC
	default "mx6"

config SYS_CONFIG_NAME
	default "tqma6"

choice
	prompt "TQMa6 SoC variant"
	default TQMA6Q
	help
	  select the TQMa6 module variant. The variants differing in the used
	  i.MX6 CPU type and DRAM

config TQMA6Q
	bool "TQMa6Q / TQMa6D"
	select MX6Q
	help
	  select TQMa6Q / TQMa6D with i.MX6Q/D and 1GiB DRAM

config TQMA6S
	bool "TQMa6S"
	select MX6S
	help
	  select TQMa6S with i.MX6S and 512 MiB DRAM

endchoice

config IMX_CONFIG
	default "board/tqc/tqma6/tqma6q.cfg" if TQMA6Q
	default "board/tqc/tqma6/tqma6s.cfg" if TQMA6S

endif
```

## board/trizepsiv/Kconfig
```kconfig
if TARGET_TRIZEPSIV

config SYS_BOARD
	default "trizepsiv"

config SYS_CONFIG_NAME
	default "trizepsiv"

endif
```

## board/ttcontrol/vision2/Kconfig
```kconfig
if TARGET_VISION2

config SYS_CPU
	default "armv7"

config SYS_BOARD
	default "vision2"

config SYS_VENDOR
	default "ttcontrol"

config SYS_SOC
	default "mx5"

config SYS_CONFIG_NAME
	default "vision2"

endif
```

## board/turing/turing-rk1-rk3588/Kconfig
```kconfig
if TARGET_TURINGRK1_RK3588

config SYS_BOARD
	default "turing-rk1-rk3588"

config SYS_VENDOR
	default "turing"

config SYS_CONFIG_NAME
	default "turing-rk1-rk3588"

endif
```

## board/udoo/Kconfig
```kconfig
if TARGET_UDOO

config SYS_CPU
	default "armv7"

config SYS_BOARD
	default "udoo"

config SYS_SOC
	default "mx6"

config SYS_CONFIG_NAME
	default "udoo"

endif
```

## board/utx8245/Kconfig
```kconfig
if TARGET_UTX8245

config SYS_BOARD
	default "utx8245"

config SYS_CONFIG_NAME
	default "utx8245"

endif
```

## board/v38b/Kconfig
```kconfig
if TARGET_V38B

config SYS_BOARD
	default "v38b"

config SYS_CONFIG_NAME
	default "v38b"

endif
```

## board/variscite/omap4_var_som/Kconfig
```kconfig
if TARGET_OMAP4_VAR_SOM

config SYS_BOARD
	default "omap4_var_som"

config SYS_VENDOR
	default "variscite"

config SYS_CONFIG_NAME
	default "ti_omap4_common"

endif
```

## board/varisys/cyrus/Kconfig
```kconfig
if TARGET_CYRUS

config SYS_BOARD
	default "cyrus"

config SYS_VENDOR
	default "varisys"

config SYS_CONFIG_NAME
	default "cyrus"

endif
```

## board/ve8313/Kconfig
```kconfig
if TARGET_VE8313

config SYS_BOARD
	string
	default "ve8313"

config SYS_CONFIG_NAME
	string
	default "ve8313"

endif
```

## board/vpac270/Kconfig
```kconfig
if TARGET_VPAC270

config SYS_BOARD
	default "vpac270"

config SYS_CONFIG_NAME
	default "vpac270"

endif
```

## board/vscom/baltos/Kconfig
```kconfig
if TARGET_AM335X_BALTOS

config SYS_BOARD
	default "baltos"

config SYS_VENDOR
	default "vscom"

config SYS_SOC
	default "am33xx"

config SYS_CONFIG_NAME
	default "baltos"

config CONS_INDEX
	int "UART used for console"
	range 1 6
	default 1
	help
	  The AM335x SoC has a total of 6 UARTs (UART0 to UART5 as referenced
	  in documentation, etc) available to it.  Depending on your specific
	  board you may want something other than UART0.

endif
```
