## board/w7o/Kconfig
```kconfig
if TARGET_W7OLMC

config SYS_BOARD
	default "w7o"

config SYS_CONFIG_NAME
	default "W7OLMC"

endif

if TARGET_W7OLMG

config SYS_BOARD
	default "w7o"

config SYS_CONFIG_NAME
	default "W7OLMG"

endif
```

## board/wandboard/Kconfig
```kconfig
if TARGET_WANDBOARD

config SYS_BOARD
	default "wandboard"

config SYS_SOC
	default "mx6"

config SYS_CONFIG_NAME
	default "wandboard"

endif
```

## board/warp/Kconfig
```kconfig
if TARGET_WARP

config SYS_BOARD
	default "warp"

config SYS_CONFIG_NAME
	default "warp"

config IMX_CONFIG
	default "board/warp/imximage.cfg"

endif
```

## board/warp7/Kconfig
```kconfig
if TARGET_WARP7

config SYS_BOARD
	default "warp7"

config SYS_CONFIG_NAME
	default "warp7"

config SYS_FDT_ADDR
	hex "FDT load address"
	default 0x83000000
	help
	  The address the FDT file should be loaded to.

endif
```

## board/wexler/qc750/Kconfig
```kconfig
if TARGET_QC750

config SYS_BOARD
	default "qc750"

config SYS_VENDOR
	default "wexler"

config TEGRA_BOARD_STRING
	string "Default Tegra board name"
	default "Wexler QC750"

endif
```

## board/woodburn/Kconfig
```kconfig
if TARGET_WOODBURN

config SYS_CPU
	default "arm1136"

config SYS_BOARD
	default "woodburn"

config SYS_SOC
	default "mx35"

config SYS_CONFIG_NAME
	default "woodburn"

endif

if TARGET_WOODBURN_SD

config SYS_CPU
	default "arm1136"

config SYS_BOARD
	default "woodburn"

config SYS_SOC
	default "mx35"

config SYS_CONFIG_NAME
	default "woodburn_sd"

endif
```

## board/work-microwave/work_92105/Kconfig
```kconfig
if TARGET_WORK_92105

config SYS_BOARD
	default "work_92105"

config SYS_VENDOR
	default "work-microwave"

config SYS_SOC
	default "lpc32xx"

config SYS_CONFIG_NAME
	default "work_92105"

config CMD_HD44760
	bool "Enable 'hd44780' LCD-control comand"
	help
	  This controls the LCD driver.

endif
```

## board/xaeniax/Kconfig
```kconfig
if TARGET_XAENIAX

config SYS_BOARD
	default "xaeniax"

config SYS_CONFIG_NAME
	default "xaeniax"

endif
```

## board/xen/xenguest_arm64/Kconfig
```kconfig
if TARGET_XENGUEST_ARM64

config SYS_BOARD
	default "xenguest_arm64"

config SYS_VENDOR
	default "xen"

config SYS_CONFIG_NAME
	default "xenguest_arm64"

endif
```

## board/xes/xpedite1000/Kconfig
```kconfig
if TARGET_XPEDITE1000

config SYS_BOARD
	default "xpedite1000"

config SYS_VENDOR
	default "xes"

config SYS_CONFIG_NAME
	default "xpedite1000"

endif
```

## board/xes/xpedite517x/Kconfig
```kconfig
if TARGET_XPEDITE517X

config SYS_BOARD
	string
	default "xpedite517x"

config SYS_VENDOR
	string
	default "xes"

config SYS_CONFIG_NAME
	string
	default "xpedite517x"

endif
```

## board/xes/xpedite520x/Kconfig
```kconfig
if TARGET_XPEDITE520X

config SYS_BOARD
	string
	default "xpedite520x"

config SYS_VENDOR
	string
	default "xes"

config SYS_CONFIG_NAME
	string
	default "xpedite520x"

endif
```

## board/xes/xpedite537x/Kconfig
```kconfig
if TARGET_XPEDITE537X

config SYS_BOARD
	string
	default "xpedite537x"

config SYS_VENDOR
	string
	default "xes"

config SYS_CONFIG_NAME
	string
	default "xpedite537x"

endif
```

## board/xes/xpedite550x/Kconfig
```kconfig
if TARGET_XPEDITE550X

config SYS_BOARD
	string
	default "xpedite550x"

config SYS_VENDOR
	string
	default "xes"

config SYS_CONFIG_NAME
	string
	default "xpedite550x"

endif
```

## board/xiaomi/mocha/Kconfig
```kconfig
if TARGET_MOCHA

config SYS_BOARD
	default "mocha"

config SYS_VENDOR
	default "xiaomi"

config TEGRA_BOARD_STRING
	string "Default Tegra board name"
	default "Xiaomi Mocha"

config TEGRA_PRAM_SIZE
	depends on TEGRA_PRAM
	default 0x38400

endif
```

## board/xilinx/mbv/Kconfig
```kconfig
if TARGET_XILINX_MBV

config SYS_BOARD
	default "mbv"

config SYS_VENDOR
	default "xilinx"

config SYS_CPU
	default "generic"

config TEXT_BASE
	default 0x81200000

config SPL_TEXT_BASE
	default 0x80000000

config SPL_OPENSBI_LOAD_ADDR
	hex
	default 0x80200000

config BOARD_SPECIFIC_OPTIONS
	def_bool y
	select GENERIC_RISCV
	select SUPPORT_SPL
	imply BOARD_LATE_INIT
	imply SPL_RAM_SUPPORT
	imply SPL_RAM_DEVICE
	imply CMD_SBI
	imply CMD_PING

source "board/xilinx/Kconfig"

endif
```

## board/xilinx/microblaze-generic/Kconfig
```kconfig
if TARGET_MICROBLAZE_GENERIC

config SYS_BOARD
	default "microblaze-generic"

config SYS_VENDOR
	default "xilinx"

config SYS_CONFIG_NAME
	string "Board configuration name"
	default "microblaze-generic"
	help
	  This option contains information about board configuration name.
	  Based on this option include/configs/<CONFIG_SYS_CONFIG_NAME>.h header
	  will be used for board configuration.

config XILINX_MICROBLAZE0_USE_MSR_INSTR
	int "USE_MSR_INSTR range (0:1)"
	default 0

config XILINX_MICROBLAZE0_USE_PCMP_INSTR
	int "USE_PCMP_INSTR range (0:1)"
	default 0

config XILINX_MICROBLAZE0_USE_BARREL
	int "USE_BARREL range (0:1)"
	default 0

config XILINX_MICROBLAZE0_USE_DIV
	int "USE_DIV range (0:1)"
	default 0

config XILINX_MICROBLAZE0_USE_HW_MUL
	int "USE_HW_MUL values (0=NONE, 1=MUL32, 2=MUL64)"
	default 0

config XILINX_MICROBLAZE0_HW_VER
	string "Core version number"
	default "7.10.d"

config XILINX_MICROBLAZE0_USR_EXCEP
	bool "MicroBlaze user exception support"
	default y
	help
	  Enable this option in order to install the user exception handler
	  (_exception_handler routine from arch/microblaze/cpu/exception.c) in
	  the exception vector table. The user exception vector is located at
	  C_BASE_VECTORS + 0x8 address.

config XILINX_MICROBLAZE0_DELAY_SLOT_EXCEP
	bool "MicroBlaze delay slot exception support"
	default y
	help
	  Enable this option if the MicroBlaze processor supports exceptions
	  caused by delay slot instructions (processor version >= v5.00). When
	  enabled, the hw exception handler will print a message indicating
	  whether the exception was triggered by a delay slot instruction.

config XILINX_MICROBLAZE0_VECTOR_BASE_ADDR
	hex "Location of MicroBlaze vectors"
	default 0x0
	help
	  Memory address location of the exception vector table. It is
	  configurable via the C_BASE_VECTORS hdl parameter.

endif
```

## board/xilinx/ml507/Kconfig
```kconfig
if TARGET_ML507

config SYS_BOARD
	default "ml507"

config SYS_VENDOR
	default "xilinx"

config SYS_CONFIG_NAME
	default "ml507"

endif
```

## board/xilinx/ppc405-generic/Kconfig
```kconfig
if TARGET_XILINX_PPC405_GENERIC

config SYS_BOARD
	default "ppc405-generic"

config SYS_VENDOR
	default "xilinx"

config SYS_CONFIG_NAME
	default "xilinx-ppc405-generic"

endif
```

## board/xilinx/ppc440-generic/Kconfig
```kconfig
if TARGET_XILINX_PPC440_GENERIC

config SYS_BOARD
	default "ppc440-generic"

config SYS_VENDOR
	default "xilinx"

config SYS_CONFIG_NAME
	default "xilinx-ppc440-generic"

endif
```

## board/xilinx/zynq/Kconfig
```kconfig
if TARGET_ZYNQ_MICROZED

config SYS_CPU
	string
	default "armv7"

config SYS_BOARD
	string
	default "zynq"

config SYS_VENDOR
	string
	default "xilinx"

config SYS_SOC
	string
	default "zynq"

config SYS_CONFIG_NAME
	string
	default "zynq_microzed"

endif

if TARGET_ZYNQ_ZC70X

config SYS_CPU
	string
	default "armv7"

config SYS_BOARD
	string
	default "zynq"

config SYS_VENDOR
	string
	default "xilinx"

config SYS_SOC
	string
	default "zynq"

config SYS_CONFIG_NAME
	string
	default "zynq_zc70x"

endif

if TARGET_ZYNQ_ZC770

config SYS_CPU
	string
	default "armv7"

config SYS_BOARD
	string
	default "zynq"

config SYS_VENDOR
	string
	default "xilinx"

config SYS_SOC
	string
	default "zynq"

config SYS_CONFIG_NAME
	string
	default "zynq_zc770"

endif

if TARGET_ZYNQ_ZED

config SYS_CPU
	string
	default "armv7"

config SYS_BOARD
	string
	default "zynq"

config SYS_VENDOR
	string
	default "xilinx"

config SYS_SOC
	string
	default "zynq"

config SYS_CONFIG_NAME
	string
	default "zynq_zed"

endif
```

## board/xilinx/zynqmp/Kconfig
```kconfig
# Copyright (c) 2018, Xilinx, Inc.
#
# SPDX-License-Identifier: GPL-2.0

if ARCH_ZYNQMP

config CMD_ZYNQMP
	bool "Enable ZynqMP specific commands"
	default y
	help
	  Enable ZynqMP specific commands like "zynqmp secure"
	  which is used for zynqmp secure image verification.
	  The secure image is a xilinx specific BOOT.BIN with
	  either authentication or encryption or both encryption
	  and authentication feature enabled while generating
	  BOOT.BIN using Xilinx bootgen tool.

config ZYNQMP_BOARD_DETECT_FRU
	bool "Enable ZynqMP board detection via FRU"
	help
	  Enabling this option u-boot will look at chosen/xlnx,eeprom
	  property and will try to decode board name written in IPMI
	  FRU format.

endif
```

## board/xunlong/orangepi-3b-rk3566/Kconfig
```kconfig
if TARGET_ORANGEPI_3B_RK3566

config SYS_BOARD
	default "orangepi-3b-rk3566"

config SYS_VENDOR
	default "xunlong"

config SYS_CONFIG_NAME
	default "evb_rk3568"

endif
```

## board/xunlong/orangepi-5-ultra-rk3588/Kconfig
```kconfig
if TARGET_ORANGEPI_5_ULTRA_RK3588

config SYS_BOARD
	default "orangepi-5-ultra-rk3588"

config SYS_VENDOR
	default "xunlong"

config SYS_CONFIG_NAME
	default "evb_rk3588"

endif
```

## board/zeus/Kconfig
```kconfig
if TARGET_ZEUS

config SYS_BOARD
	default "zeus"

config SYS_CONFIG_NAME
	default "zeus"

endif
```
