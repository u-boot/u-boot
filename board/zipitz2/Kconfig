## cmd/fastboot/Kconfig
```kconfig
comment "FASTBOOT"

menuconfig FASTBOOT
	bool "Fastboot support"
	depends on USB_GADGET
	default y if ARCH_SUNXI && USB_MUSB_GADGET

if FASTBOOT

config USB_FUNCTION_FASTBOOT
	bool "Enable USB fastboot gadget"
	default y
	select USB_GADGET_DOWNLOAD
	imply ANDROID_BOOT_IMAGE
	imply CMD_FASTBOOT
	help
	  This enables the USB part of the fastboot gadget.

config CMD_FASTBOOT
	bool "Enable FASTBOOT command"
	help
	  This enables the command "fastboot" which enables the Android
	  fastboot mode for the platform's USB device. Fastboot is a USB
	  protocol for downloading images, flashing and device control
	  used on Android devices.

	  See doc/README.android-fastboot for more information.

if USB_FUNCTION_FASTBOOT

config FASTBOOT_BUF_ADDR
	hex "Define FASTBOOT buffer address"
	default 0x82000000 if MX6SX || MX6SL || MX6UL || MX6SLL
	default 0x81000000 if ARCH_OMAP2PLUS
	default 0x42000000 if ARCH_SUNXI && !MACH_SUN9I
	default 0x22000000 if ARCH_SUNXI && MACH_SUN9I
	default 0x60800800 if ROCKCHIP_RK3036 || ROCKCHIP_RK3188 || \
				ROCKCHIP_RK322X
	default 0x800800 if ROCKCHIP_RK3288 || ROCKCHIP_RK3329 || \
				ROCKCHIP_RK3399
	default 0x280000 if ROCKCHIP_RK3368
	default 0x100000 if ARCH_ZYNQMP
	help
	  The fastboot protocol requires a large memory buffer for
	  downloads. Define this to the starting RAM address to use for
	  downloaded images.

config FASTBOOT_BUF_SIZE
	hex "Define FASTBOOT buffer size"
	default 0x8000000 if ARCH_ROCKCHIP
	default 0x6000000 if ARCH_ZYNQMP
	default 0x2000000 if ARCH_SUNXI
	default 0x7000000
	help
	  The fastboot protocol requires a large memory buffer for
	  downloads. This buffer should be as large as possible for a
	  platform. Define this to the size available RAM for fastboot.

config FASTBOOT_USB_DEV
	int "USB controller number"
	default 0
	help
	  Some boards have USB OTG controller other than 0. Define this
	  option so it can be used in compiled environment (e.g. in
	  CONFIG_BOOTCOMMAND).

config FASTBOOT_FLASH
	bool "Enable FASTBOOT FLASH command"
	help
	  The fastboot protocol includes a "flash" command for writing
	  the downloaded image to a non-volatile storage device. Define
	  this to enable the "fastboot flash" command.

config FASTBOOT_FLASH_MMC_DEV
	int "Define FASTBOOT MMC FLASH default device"
	depends on FASTBOOT_FLASH && MMC
	default 0 if ARCH_SUNXI && MMC_SUNXI_SLOT_EXTRA = -1
	default 1 if ARCH_SUNXI && MMC_SUNXI_SLOT_EXTRA != -1
	help
	  The fastboot "flash" command requires additional information
	  regarding the non-volatile storage device. Define this to
	  the eMMC device that fastboot should use to store the image.

config FASTBOOT_FLASH_NAND_DEV
	int "Define FASTBOOT NAND FLASH default device"
	depends on FASTBOOT_FLASH && NAND
	depends on CMD_MTDPARTS
	default 0 if ARCH_SUNXI && NAND_SUNXI
	help
	  The fastboot "flash" command requires additional information
	  regarding the non-volatile storage device. Define this to
	  the NAND device that fastboot should use to store the image.

config FASTBOOT_GPT_NAME
	string "Target name for updating GPT"
	depends on FASTBOOT_FLASH
	default "gpt"
	help
	  The fastboot "flash" command supports writing the downloaded
	  image to the Protective MBR and the Primary GUID Partition
	  Table. (Additionally, this downloaded image is post-processed
	  to generate and write the Backup GUID Partition Table.)
	  This occurs when the specified "partition name" on the
	  "fastboot flash" command line matches the value defined here.
	  The default target name for updating GPT is "gpt".

config FASTBOOT_MBR_NAME
	string "Target name for updating MBR"
	depends on FASTBOOT_FLASH
	default "mbr"
	help
	  The fastboot "flash" command allows to write the downloaded image
	  to the Master Boot Record. This occurs when the "partition name"
	  specified on the "fastboot flash" command line matches the value
	  defined here. The default target name for updating MBR is "mbr".

endif # USB_FUNCTION_FASTBOOT

endif # FASTBOOT
```

## cmd/marvell/Kconfig
```kconfig
menu "Marvell specific command line interface"

config CMD_FAILSAFE
	depends on ARCH_OCTEONTX2
	bool "Command for supporting fail safe boot"
	help
	   Support for fail safe boot on Marvell's OcteonTX2 platforms.
	   Disables forced secondary boot and reports if boot from
	   primary device was successful.

config CMD_ETH
	depends on NET_OCTEONTX2
	bool "Command to change fec and phy-mod type"
	help
	   Support for change of fec and phy-mod type for some specific
	   LMAC modes on RVU PF [CGX] network interfaces on Marvell
	   OcteonTX2 platforms.

config CMD_MDIO_DBG
	depends on ARCH_OCTEONTX2
	bool "PHY registers read/write support on mdio bus"
	help
	   Support to debug phy registers over MDIO bus using SMC interface
	   to ATF for RVU PF [CGX] network interfaces on Marvell OcteonTX2
	   platforms.

config CMD_ATTEST
	depends on ARCH_OCTEONTX2
	bool "Command for supporting Software Attestation"
	help
	   Support for Software Attestation on Marvell's OcteonTX2 platforms.
	   Displays Secure Boot software component version information.

config CMD_BOOTIMGUP
	depends on ARCH_OCTEONTX || ARCH_OCTEONTX2
	depends on MMC_OCTEONTX || SPI_FLASH
	bool "bootimgup"
	help
	  bootimgup command support

endmenu
```

## cmd/mvebu/Kconfig
```kconfig
menu "MVEBU commands"
depends on ARCH_MVEBU

config CMD_MVEBU_BUBT
	bool "bubt"
	default n
	help
	  bubt - Burn a u-boot image to flash
	  For details about bubt command please see the documentation
	  in doc/mvebu/cmd/bubt.txt

config CMD_MV88E6XXX_UTIL
	bool "mvswitch"
	depends on MV88E6XXX_SWITCH
	default y
	help
	  mvswitch command handle mv88e6xxx
	  assist with switch init
	  display switch info and link state

config CMD_MVEBU_MV_FW_INFO
	bool "mv_fw_info"
	depends on TARGET_MVEBU_ARMADA_8K || TARGET_OCTEONTX2_CN913x
	default y
	help
	  mv_fw_info command prints FreeRTOS version and firmware information
	  for the FW running on CM3 CPUs of AP and connected CPs.

config CMD_MVEBU_PHY_FW_DOWNLOAD
	bool "phy_fw_down"
	depends on MVMDIO
	default n
	help
	  phy_fw_down - This command download
	  PHY firmware header to the PHY flash.
	  This command is used for Marvell PHYs
	  88X3220/88X3310

config CMD_MVEBU_TSEN
	bool "tsen"
	depends on MVEBU_THERMAL_SENSOR
	default y
	help
	  tsen - Display the SoC temperature
	  as read from the on chip thermal sensor

config CMD_MVEBU_HW_INFO
	bool "hw_info"
	select BOARD_CONFIG_EEPROM
	default n
	help
	  hw_info - load HW information such as board ID, PCB SLM number,
	  MAC addresses from EEPROM and apply them to environment variables.
	  And update the MAC address in FDT file for Linux.
	  When save the box information, it will be saved to EEPROM.

choice
	prompt "Flash for image"
	default MVEBU_SPI_BOOT

config MVEBU_NAND_BOOT
	bool "NAND flash boot"
	depends on NAND_PXA3XX
	help
	  Enable boot from NAND flash.
	  Allow usage of NAND flash as a target for "bubt" command
	  For details about bubt command please see the documentation
	  in doc/mvebu/cmd/bubt.txt

config MVEBU_SPI_BOOT
	bool "SPI flash boot"
	depends on SPI_FLASH
	help
	  Enable boot from SPI flash.
	  Allow usage of SPI flash as a target for "bubt" command
	  For details about bubt command please see the documentation
	  in doc/mvebu/cmd/bubt.txt

config MVEBU_MMC_BOOT
	bool "eMMC flash boot"
	depends on (MVEBU_MMC || MMC_SDHCI_XENON)
	help
	  Enable boot from eMMC boot partition
	  Allow usage of eMMC/SD device as a target for "bubt" command
	  For details about bubt command please see the documentation
	  in doc/mvebu/cmd/bubt.txt

endchoice

config MVEBU_BOOT_PART
	int "boot partition"
	default 0
	help
	  sets boot partition, and sets a specific
	  partition as a target for "bubt" command.
	  For details about bubt command please see the documentation
	  in doc/mvebu/cmd/bubt.txt

config MVEBU_BOOT_DEVICE
	int "boot device id"
	default 0
	help
	  Used for setting boot device id.

config MVEBU_UBOOT_DFLT_NAME
	string "Default image name for bubt command"
	default "flash-image.bin"
	help
	  This option should contain a default file name to be used with
	  MVEBU "bubt" command if the source file name is omitted

config CMD_MVEBU_EFUSE
	bool "efuse"
	depends on TARGET_MVEBU_ARMADA_37XX
	select MVEBU_EFUSE_SUPPORT
	default n
	help
	  eFuse - allow access to SoC eFuse entries
	  eFuse commands to support efuse list/dump/read/write
	  For details about eFuse command please see help of eFuse
	  in uboot

config CMD_MVEBU_DDR_PHY
	bool "enable ddr_phy register access"
	depends on TARGET_OCTEONTX2_CN913x
	default y
	help
	  Write/Read Phy registers

config CMD_MVEBU_RX_TRAINING
	bool "rx_training"
	depends on TARGET_MVEBU_ARMADA_8K || TARGET_OCTEONTX2_CN913x
	default n
	help
	  Perform RX training sequence

config CMD_MVEBU_AVS
	bool "avs"
	depends on TARGET_MVEBU_ARMADA_8K || TARGET_OCTEONTX2_CN913x
	default y
	help
	  Set/Get the Adaptive Voltage Scaling (AVS) value

config CMD_MVEBU_MAP
	bool "map"
	depends on TARGET_MVEBU_ARMADA_8K || TARGET_OCTEONTX2_CN913x
	default y
	help
	  Dump address translation tables

config CMD_MVEBU_NAND_OEM
	bool "nand"
	depends on (TARGET_MVEBU_ARMADA_8K || TARGET_DB_88F6820_AP || TARGET_OCTEONTX2_CN913x) && CMD_NAND
	default y
	help
	  Introduction: NAND vendors conducts tests to verify if all blocks are
	  OK. In case of failure block, the NAND manufacturer will mark this
	  block as bad (BBM) by setting 0x00 somewhere in the spare area.
	  Moreover NAND manufacturer can pre-programmed the chip with provided
	  image using external burner.

	  Issue: Marvell NFC employ optimized cost/performance ECC mechanism.
	  This results in an unique ECC layout implementation. Marvell NFC sets
	  different layouts according to page size/ECC strength combinations.

	  Therefore after preparing image for the NAND manufacturer for board
	  with Marvell NFC, due to the layout differences used by Marvell NFC
	  and physical NAND chip layout, some valid data will be put on BBM
	  position.  This will result on false bad block indicator and will
	  affect the BBT which is created automatically (by U-Boot or Linux)
	  during first run.

	  To prevent from that kind of situations, the NAND oem command was
	  introduced.

	  The "prepare" part of the command runs once per device data partition
	  in NAND and prepares image which is next send to manufacturer. It
	  checks if under BBM position there is no data which could be then
	  mistakenly taken as a BBM. If so the data together with tracking
	  information is copied to "meta-data" partition and BBM position is
	  overwritten with good indicator.

	  The "restore" part of the command runs once per "prepared" partition
	  and restores its original data. It supposed to run on new boards, on
	  which the NAND manufacturer pre-programmed earlier prepared image.

config CMD_MVEBU_MV_GET_COUNTERS
	bool "mv_get_counters"
	depends on TARGET_MVEBU_ARMADA_8K || TARGET_OCTEONTX2_CN913x
	default y
	help
	  mv_get_counters print MIB Counters.
	  First argument select eth port to print.
	  When no argument is given default port is Ethact.
	  Wrong port being selected could cause crash.

endmenu
```
