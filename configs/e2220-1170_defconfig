## configs/ethernut5_defconfig
```kconfig
CONFIG_ARM=y
CONFIG_ARCH_AT91=y
CONFIG_TARGET_ETHERNUT5=y
CONFIG_SYS_EXTRA_OPTIONS="AT91SAM9XE"
CONFIG_BOOTDELAY=3
# CONFIG_DISPLAY_BOARDINFO is not set
CONFIG_HUSH_PARSER=y
CONFIG_SYS_PROMPT="U-Boot> "
# CONFIG_CMD_BDI is not set
CONFIG_CMD_ASKENV=y
# CONFIG_CMD_LOADS is not set
CONFIG_CMD_MMC=y
CONFIG_CMD_SF=y
CONFIG_CMD_SPI=y
CONFIG_CMD_I2C=y
CONFIG_CMD_USB=y
# CONFIG_CMD_FPGA is not set
CONFIG_CMD_RARP=y
CONFIG_CMD_DHCP=y
CONFIG_CMD_MII=y
CONFIG_CMD_PING=y
CONFIG_CMD_CDP=y
CONFIG_CMD_SNTP=y
CONFIG_CMD_DNS=y
CONFIG_CMD_CACHE=y
CONFIG_CMD_EXT2=y
CONFIG_CMD_FAT=y
CONFIG_CMD_UBI=y
CONFIG_SPI_FLASH=y
CONFIG_SPI_FLASH_ATMEL=y
CONFIG_USB=y
CONFIG_USB_STORAGE=y
```

## configs/ev-imx280-nano-x-mb_defconfig
```kconfig
CONFIG_ARCH_MX6=y
CONFIG_ARM=y
CONFIG_DEFAULT_DEVICE_TREE="ev-imx280-nano-x-mb"
CONFIG_EV_IMX280_NANO_X_MB=y
CONFIG_HUSH_PARSER=y
CONFIG_IMX_MODULE_FUSE=y
CONFIG_MX6ULL=y
CONFIG_PINCTRL=y
CONFIG_PINCTRL_IMX6=y
CONFIG_SYS_TEXT_BASE=0x87800000
CONFIG_TARGET_O4_IMX6ULL_NANO=y

CONFIG_K4B4G1646D_BCMA=y
# CONFIG_MT41K256M16HA_125E is not set

# Device Tree
CONFIG_OF_CONTROL=y
CONFIG_OF_LIBFDT_OVERLAY=y

# Environment
CONFIG_ENV_FAT_DEVICE_AND_PART="0:1"
CONFIG_ENV_IS_IN_FAT=y
CONFIG_ENV_VARS_UBOOT_RUNTIME_CONFIG=y

# Clock driver for imx6ull is not implemented
# CONFIG_CLK_IMX6Q=y

# Thermal
CONFIG_DM_THERMAL=y
CONFIG_IMX_THERMAL=y

# Serial
CONFIG_DM_SERIAL=y
CONFIG_MXC_UART=y

# eMMC support
CONFIG_CMD_MMC=y
CONFIG_DM_MMC=y
CONFIG_FSL_USDHC=y
CONFIG_SUPPORT_EMMC_BOOT=y
CONFIG_SUPPORT_EMMC_RPMB=y

# GPIO support
CONFIG_CMD_GPIO=y
CONFIG_DM_GPIO=y
CONFIG_MXC_GPIO=y

# USB support
CONFIG_CI_UDC=y
CONFIG_CMD_USB=y
CONFIG_CMD_USB_MASS_STORAGE=y
CONFIG_DM_USB=y
CONFIG_USB=y
CONFIG_USB_GADGET=y
CONFIG_USB_GADGET_DOWNLOAD=y

# Fastboot support
CONFIG_CMD_FASTBOOT=y
CONFIG_FASTBOOT_BUF_ADDR=0x82000000
CONFIG_FASTBOOT_CMD_OEM_FORMAT=y
CONFIG_FASTBOOT_FLASH=y
CONFIG_FASTBOOT_FLASH_MMC_DEV=0
CONFIG_USB_FUNCTION_FASTBOOT=y

# Ethernet support
CONFIG_CMD_DHCP=y
CONFIG_CMD_MDIO=y
CONFIG_CMD_MII=y
CONFIG_CMD_PING=y
CONFIG_DM_ETH=y
CONFIG_FEC_MXC=y
CONFIG_MII=y
CONFIG_NET_RANDOM_ETHADDR=y
CONFIG_PHYLIB=y
CONFIG_PHY_SMSC=y

# Watchdog support is broken
# CONFIG_CMD_WDT=y
# CONFIG_IMX_WATCHDOG=y
# CONFIG_SYSRESET_WATCHDOG=y
# CONFIG_WATCHDOG_RESET_DISABLE=y
# CONFIG_WDT=y

# misc
CONFIG_CMD_BOOTZ=y
CONFIG_CMD_EXT4=y
CONFIG_CMD_FAT=y
CONFIG_CMD_GPT=y
CONFIG_CMD_MEMINFO=y
CONFIG_CMD_MEMTEST=y
CONFIG_CMD_PART=y
```

## configs/evb-ast2500_defconfig
```kconfig
CONFIG_ARM=y
CONFIG_ARCH_ASPEED=y
CONFIG_SYS_TEXT_BASE=0x0
CONFIG_ASPEED_AST2500=y
CONFIG_TARGET_EVB_AST2500=y
CONFIG_SYS_MALLOC_F_LEN=0x2000
CONFIG_DEFAULT_DEVICE_TREE="ast2500-evb"
CONFIG_USE_BOOTARGS=y
CONFIG_BOOTARGS="console=ttyS4,115200n8 root=/dev/ram rw"
CONFIG_PRE_CONSOLE_BUFFER=y
CONFIG_PRE_CON_BUF_ADDR=0x1e720000
# CONFIG_DISPLAY_CPUINFO is not set
# CONFIG_AUTO_COMPLETE is not set
CONFIG_CMD_I2C=y
CONFIG_BOOTP_BOOTPATH=y
CONFIG_BOOTP_GATEWAY=y
CONFIG_BOOTP_HOSTNAME=y
CONFIG_BOOTP_SUBNETMASK=y
CONFIG_REGMAP=y
CONFIG_CLK=y
CONFIG_DM_I2C=y
CONFIG_SYS_I2C_ASPEED=y
CONFIG_PINCTRL=y
CONFIG_RAM=y
CONFIG_DM_RESET=y
CONFIG_DM_SERIAL=y
CONFIG_SYS_NS16550=y
CONFIG_SYSRESET=y
CONFIG_TIMER=y
CONFIG_WDT=y
```
