## configs/mt8366_genio_360_evk_defconfig
```kconfig
CONFIG_ARM=y
CONFIG_COUNTER_FREQUENCY=13000000
CONFIG_POSITION_INDEPENDENT=y
CONFIG_ARCH_MEDIATEK=y
CONFIG_TEXT_BASE=0x4c000000
CONFIG_NR_DRAM_BANKS=1
CONFIG_DM_GPIO=y
CONFIG_DEFAULT_DEVICE_TREE="mt8366-genio-360-evk"
CONFIG_OF_LIBFDT_OVERLAY=y
CONFIG_TARGET_MT8366=y
CONFIG_SYS_LOAD_ADDR=0x4c000000
CONFIG_FIT=y
CONFIG_BOOTSTD_FULL=y
CONFIG_DEFAULT_FDT_FILE="mt8366-genio-360-evk"
# CONFIG_BOARD_INIT is not set
CONFIG_CMD_CLK=y
CONFIG_CMD_DM=y
CONFIG_CMD_GPIO=y
CONFIG_CMD_GPT=y
CONFIG_CMD_MMC=y
CONFIG_CMD_MTD=y
CONFIG_CMD_USB=y
CONFIG_CMD_PMIC=y
CONFIG_CMD_REGULATOR=y
CONFIG_NET_LWIP=y
CONFIG_NET_RANDOM_ETHADDR=y
CONFIG_CLK=y
CONFIG_POWER_DOMAIN=y
CONFIG_MMC_HS200_SUPPORT=y
CONFIG_MMC_MTK=y
CONFIG_FS_FAT=y
CONFIG_MTD=y
CONFIG_DM_MTD=y
CONFIG_DM_SPI_FLASH=y
CONFIG_SPI_FLASH_SFDP_SUPPORT=y
CONFIG_SPI_FLASH_MACRONIX=y
CONFIG_SPI_FLASH_MTD=y
CONFIG_DWC_ETH_QOS=y
CONFIG_DWC_ETH_QOS_MTK=y
CONFIG_PHY_AIROHA=y
CONFIG_PHY_AIROHA_AN8801=y
CONFIG_PHY_ETHERNET_ID=y
CONFIG_PHY=y
CONFIG_PHY_MTK_TPHY=y
CONFIG_PINCTRL=y
CONFIG_DM_PMIC=y
CONFIG_DM_PMIC_MTK_PWRAP=y
CONFIG_DM_REGULATOR=y
CONFIG_DM_REGULATOR_FIXED=y
CONFIG_DM_REGULATOR_MT6358=y
CONFIG_DM_PWM=y
CONFIG_PWM_MTK_DISP=y
CONFIG_BAUDRATE=921600
CONFIG_DM_SERIAL=y
CONFIG_MTK_SERIAL=y
CONFIG_SPI=y
CONFIG_DM_SPI=y
CONFIG_MTK_SNOR=y
CONFIG_USB=y
CONFIG_USB_XHCI_HCD=y
CONFIG_USB_XHCI_MTK=y
CONFIG_USB_MTU3=y
CONFIG_VIDEO=y
CONFIG_PANEL_STARTEK_KD070FHFID078=y
CONFIG_VIDEO_MEDIATEK_DSI=y
CONFIG_WDT=y
CONFIG_WDT_MTK=y
```

## configs/nbxv3_tfa_defconfig
```kconfig
CONFIG_ARM=y
CONFIG_SKIP_LOWLEVEL_INIT=y
CONFIG_GIC_V3_ITS=y
CONFIG_TARGET_NBXV3=y
CONFIG_TFABOOT=y
CONFIG_TEXT_BASE=0x82000000
CONFIG_SYS_MALLOC_LEN=0x202000
CONFIG_SYS_MALLOC_F_LEN=0x6000
CONFIG_NR_DRAM_BANKS=3
CONFIG_ENV_SIZE=0x4000
CONFIG_ENV_OFFSET=0x500000
CONFIG_ENV_SECT_SIZE=0x20000
CONFIG_DM_GPIO=y
CONFIG_DEFAULT_DEVICE_TREE="fsl-lx2160a-nbxv3"
CONFIG_FSPI_AHB_EN_4BYTE=y
CONFIG_SYS_MONITOR_LEN=958464
CONFIG_ARMV8_SEC_FIRMWARE_SUPPORT=y
CONFIG_SEC_FIRMWARE_ARMV8_PSCI=y
CONFIG_ENV_ADDR=0x20500000
CONFIG_PCI=y
CONFIG_OF_BOARD_FIXUP=y
CONFIG_SYS_FSL_NUM_CC_PLLS=4
CONFIG_REMAKE_ELF=y
CONFIG_MP=y
CONFIG_DYNAMIC_SYS_CLK_FREQ=y
# CONFIG_EFI_LOADER is not set
CONFIG_FIT_VERBOSE=y
CONFIG_BOOTDELAY=3
CONFIG_OF_BOARD_SETUP=y
CONFIG_OF_STDOUT_VIA_ALIAS=y
CONFIG_USE_BOOTARGS=y
CONFIG_BOOTARGS="console=ttyAMA0,115200 earlycon=pl011,mmio32,0x21c0000 nokaslr"
CONFIG_USE_PREBOOT=y
CONFIG_SYS_PBSIZE=532
CONFIG_LAST_STAGE_INIT=y
# CONFIG_ID_EEPROM is not set
CONFIG_PCI_INIT_R=y
CONFIG_RESET_PHY_R=y
CONFIG_CMDLINE_PS_SUPPORT=y
CONFIG_CMD_HISTORY=y
CONFIG_CMD_GREPENV=y
CONFIG_CMD_EEPROM=y
CONFIG_SYS_I2C_EEPROM_ADDR_LEN=2
CONFIG_SYS_EEPROM_PAGE_WRITE_BITS=5
CONFIG_SYS_EEPROM_PAGE_WRITE_DELAY_MS=5
CONFIG_CMD_DM=y
CONFIG_CMD_GPIO=y
CONFIG_CMD_I2C=y
CONFIG_CMD_MMC=y
CONFIG_CMD_PCI=y
CONFIG_CMD_SPI=y
CONFIG_CMD_TEMPERATURE=y
CONFIG_CMD_USB=y
CONFIG_CMD_WDT=y
CONFIG_CMD_CACHE=y
CONFIG_CMD_RNG=y
CONFIG_CMD_LOG=y
CONFIG_OF_CONTROL=y
CONFIG_ENV_OVERWRITE=y
CONFIG_ENV_IS_IN_SPI_FLASH=y
CONFIG_ENV_SPI_BUS=3
CONFIG_USE_ETHPRIME=y
CONFIG_ETHPRIME="lanconsole0"
CONFIG_NET_RANDOM_ETHADDR=y
CONFIG_FSL_CAAM=y
CONFIG_DYNAMIC_DDR_CLK_FREQ=y
CONFIG_DDR_ECC=y
CONFIG_ECC_INIT_VIA_DDRCONTROLLER=y
CONFIG_SYS_FSL_DDR_INTLV_256B=y
CONFIG_GPIO_HOG=y
CONFIG_DM_PCA953X=y
CONFIG_MPC8XXX_GPIO=y
CONFIG_DM_I2C=y
CONFIG_I2C_SET_DEFAULT_BUS_NUM=y
CONFIG_I2C_MUX=y
CONFIG_I2C_MUX_PCA954x=y
CONFIG_I2C_EEPROM=y
CONFIG_SYS_I2C_EEPROM_ADDR=0x52
CONFIG_SUPPORT_EMMC_RPMB=y
CONFIG_MMC_HS400_SUPPORT=y
CONFIG_FSL_ESDHC=y
CONFIG_MTD=y
CONFIG_DM_SPI_FLASH=y
CONFIG_SPI_FLASH_GIGADEVICE=y
CONFIG_PHYLIB=y
CONFIG_PHY_REALTEK=y
CONFIG_SYS_MEMAC_LITTLE_ENDIAN=y
CONFIG_PCIE_LAYERSCAPE_RC=y
CONFIG_PCI_IOMMU_EXTRA_MAPPINGS=y
CONFIG_PCIE_LAYERSCAPE_GEN4=y
CONFIG_DM_RNG=y
CONFIG_DM_SERIAL=y
CONFIG_PL01X_SERIAL=y
CONFIG_NXP_FSPI=y
CONFIG_DM_THERMAL=y
CONFIG_IMX_TMU=y
CONFIG_DM_THERMAL_JC42=y
CONFIG_PMBUS_THERMAL=y
CONFIG_USB=y
CONFIG_USB_XHCI_HCD=y
CONFIG_USB_XHCI_DWC3=y
CONFIG_USB_MAX_CONTROLLER_COUNT=2
CONFIG_WDT=y
CONFIG_WDT_SBSA=y
CONFIG_SEMIHOSTING=y
CONFIG_ZSTD=y
```

## configs/pinecube_defconfig
```kconfig
CONFIG_ARM=y
CONFIG_ARCH_SUNXI=y
CONFIG_DEFAULT_DEVICE_TREE="allwinner/sun8i-s3-pinecube"
CONFIG_DRAM_CLK=504
CONFIG_SPL=y
CONFIG_MACH_SUN8I_V3S=y
CONFIG_SUNXI_DRAM_DDR3_1333=y
CONFIG_DRAM_ODT_EN=y
CONFIG_I2C0_ENABLE=y
CONFIG_SPL_I2C=y
CONFIG_SPL_SYS_I2C_LEGACY=y
CONFIG_SYS_I2C_MVTWSI=y
CONFIG_SYS_I2C_SLAVE=0x7f
CONFIG_SYS_I2C_SPEED=400000
CONFIG_MTD=y
CONFIG_SPI_FLASH_WINBOND=y
CONFIG_SUN8I_EMAC=y
CONFIG_AXP209_POWER=y
CONFIG_CONS_INDEX=3
CONFIG_SPI=y
```

## configs/qcom_ipq9650_mmc_defconfig
```kconfig
#include "qcom_ipq.config"
CONFIG_SYS_INIT_SP_BSS_OFFSET=0x180000
CONFIG_TEXT_BASE=0x80280000
CONFIG_NR_DRAM_BANKS=24
CONFIG_ENV_SIZE=0x40000
CONFIG_ENV_OFFSET=0
CONFIG_DEFAULT_DEVICE_TREE="qcom/ipq9650-rdp488"
CONFIG_SYS_LOAD_ADDR=0x90000000
CONFIG_SYS_PBSIZE=1024
CONFIG_CLK_QCOM_IPQ9650=y
CONFIG_CMD_MMC=y
CONFIG_ENV_IS_IN_MMC=y
CONFIG_MMC_SDHCI=y
CONFIG_MMC_SDHCI_ADMA=y
CONFIG_MMC_SDHCI_MSM=y
CONFIG_PINCTRL_QCOM_IPQ9650=y
CONFIG_SYS_MALLOC_LEN=0xC0000
```

## configs/qcom_lemans_snagboot_defconfig
```kconfig
#include "qcom_defconfig"
#include "qcom-snagboot.config"

CONFIG_TEXT_BASE=0x1c100000
CONFIG_REMAKE_ELF=y
CONFIG_FASTBOOT_BUF_ADDR=0xdb300000
CONFIG_DEFAULT_DEVICE_TREE="qcom/lemans-evk"
CONFIG_COUNTER_FREQUENCY=19200000
```

## configs/socfpga_agilex5_de25_nano_defconfig
```kconfig
#include <configs/socfpga_agilex5_defconfig>

CONFIG_DEFAULT_DEVICE_TREE="socfpga_agilex5_de25_nano"
CONFIG_MMC_SPEED_MODE_SET=y
# CONFIG_ISO_PARTITION is not set
# CONFIG_EFI_PARTITION is not set
CONFIG_SYS_SPI_U_BOOT_OFFS=0x0a00000
```

## configs/socfpga_agilex5_de25s_defconfig
```kconfig
#include <configs/socfpga_agilex5_defconfig>

CONFIG_DEFAULT_DEVICE_TREE="socfpga_agilex5_de25s"
```

## configs/spacemit_k3_defconfig
```kconfig
CONFIG_RISCV=y
CONFIG_SYS_MALLOC_LEN=0x1000000
CONFIG_SYS_MALLOC_F_LEN=0x80000
CONFIG_NR_DRAM_BANKS=2
CONFIG_HAS_CUSTOM_SYS_INIT_SP_ADDR=y
CONFIG_CUSTOM_SYS_INIT_SP_ADDR=0x102300000
CONFIG_DM_GPIO=y
CONFIG_DEFAULT_DEVICE_TREE="spacemit/k3-pico-itx"
CONFIG_SYS_BOOTM_LEN=0xa000000
CONFIG_SYS_LOAD_ADDR=0x102000000
CONFIG_DEBUG_UART_BASE=0xd4017000
CONFIG_DEBUG_UART_CLOCK=14700000
CONFIG_TARGET_SPACEMIT_K3=y
CONFIG_ARCH_RV64I=y
CONFIG_CMODEL_MEDANY=y
CONFIG_RISCV_SMODE=y
CONFIG_RISCV_ISA_ZICBOM=y
CONFIG_STACK_SIZE=0x100000
CONFIG_FIT=y
CONFIG_SUPPORT_RAW_INITRD=y
CONFIG_SYS_CBSIZE=256
CONFIG_SYS_PBSIZE=276
# CONFIG_BOARD_INIT is not set
CONFIG_HUSH_PARSER=y
CONFIG_CMD_GPIO=y
CONFIG_CMD_I2C=y
CONFIG_CMD_DHCP=y
CONFIG_CMD_DNS=y
CONFIG_CMD_MII=y
CONFIG_CMD_PING=y
CONFIG_CMD_WGET=y
CONFIG_CMD_PXE=y
CONFIG_CMD_PMIC=y
CONFIG_CMD_REGULATOR=y
CONFIG_CMD_FAT=y
CONFIG_CMD_FS_GENERIC=y
CONFIG_DEVICE_TREE_INCLUDES="spacemit-k3-u-boot.dtsi"
CONFIG_NET_LWIP=y
CONFIG_NET_RANDOM_ETHADDR=y
CONFIG_SYSCON=y
CONFIG_CLK_SPACEMIT=y
CONFIG_CLK_SPACEMIT_K3=y
CONFIG_SPACEMIT_GPIO=y
CONFIG_DM_I2C=y
CONFIG_SYS_I2C_SPACEMIT_K1=y
CONFIG_MISC=y
CONFIG_PHY_GIGE=y
CONFIG_DWC_ETH_QOS=y
CONFIG_DWC_ETH_QOS_SPACEMIT=y
CONFIG_PHY_REALTEK=y
CONFIG_PHY=y
CONFIG_PINCTRL=y
CONFIG_PINCTRL_SPACEMIT_K1=y
CONFIG_DM_PMIC=y
CONFIG_PMIC_SPACEMIT_P1=y
CONFIG_DM_REGULATOR=y
CONFIG_DM_REGULATOR_FIXED=y
CONFIG_DM_REGULATOR_SPACEMIT_P1=y
CONFIG_DEBUG_UART_NS16550=y
CONFIG_DEBUG_UART_SHIFT=2
CONFIG_DEBUG_UART_ANNOUNCE=y
CONFIG_SYS_NS16550=y
CONFIG_SYS_NS16550_MEM32=y
CONFIG_TIMER_EARLY=y
```

## configs/x96q_ddr3_v5_1_defconfig
```kconfig
CONFIG_ARM=y
CONFIG_ARCH_SUNXI=y
CONFIG_DEFAULT_DEVICE_TREE="allwinner/sun50i-h313-x96q-ddr3-v5.1"
CONFIG_DRAM_CLK=600
CONFIG_SPL=y
CONFIG_DRAM_SUNXI_DX_ODT=0x03030303
CONFIG_DRAM_SUNXI_DX_DRI=0x0e0e0e0e
CONFIG_DRAM_SUNXI_CA_DRI=0x00001c12
CONFIG_DRAM_SUNXI_TPR0=0xc0000a05
CONFIG_DRAM_SUNXI_TPR2=0x00000000
CONFIG_DRAM_SUNXI_TPR6=0x33808080
CONFIG_DRAM_SUNXI_TPR10=0x002f0006
CONFIG_DRAM_SUNXI_TPR11=0xddddcccc
CONFIG_DRAM_SUNXI_TPR12=0xeddc7564
CONFIG_MACH_SUN50I_H616=y
CONFIG_SUNXI_DRAM_H616_DDR3_1333=y
CONFIG_MMC_SUNXI_SLOT_EXTRA=2
CONFIG_R_I2C_ENABLE=y
# CONFIG_SYS_MALLOC_CLEAR_ON_INIT is not set
CONFIG_SPL_I2C=y
CONFIG_SPL_SYS_I2C_LEGACY=y
CONFIG_SYS_I2C_MVTWSI=y
CONFIG_SYS_I2C_SPEED=400000
CONFIG_SUPPORT_EMMC_BOOT=y
CONFIG_AXP313_POWER=y
CONFIG_AXP_DCDC3_VOLT=1360
CONFIG_USB_EHCI_HCD=y
CONFIG_USB_OHCI_HCD=y
```

## configs/xilinx_mbv32_defconfig
```kconfig
CONFIG_RISCV=y
# CONFIG_SPL_USE_ARCH_MEMCPY is not set
# CONFIG_SPL_USE_ARCH_MEMMOVE is not set
# CONFIG_SPL_USE_ARCH_MEMSET is not set
CONFIG_SYS_MALLOC_LEN=0xe00000
CONFIG_NR_DRAM_BANKS=1
CONFIG_HAS_CUSTOM_SYS_INIT_SP_ADDR=y
CONFIG_CUSTOM_SYS_INIT_SP_ADDR=0x81200000
CONFIG_ENV_SIZE=0x20000
CONFIG_DM_GPIO=y
CONFIG_DEFAULT_DEVICE_TREE="xilinx-mbv32"
CONFIG_SPL_STACK=0x8F000000
CONFIG_SPL_TEXT_BASE=0x0
CONFIG_SPL_BSS_START_ADDR=0xf000
CONFIG_SPL_BSS_MAX_SIZE=0x1000
CONFIG_SYS_LOAD_ADDR=0x80200000
# CONFIG_SPL_SHARES_INIT_SP_ADDR is not set
CONFIG_SPL_HAVE_INIT_STACK=y
CONFIG_SPL_SIZE_LIMIT=0x10000
CONFIG_SPL=y
CONFIG_SYS_CLK_FREQ=100000000
CONFIG_BOOT_SCRIPT_OFFSET=0x0
CONFIG_TARGET_XILINX_MBV=y
# CONFIG_RISCV_ISA_F is not set
# CONFIG_RISCV_ACLINT is not set
# CONFIG_SPL_RISCV_ACLINT is not set
# CONFIG_SPL_SMP is not set
# CONFIG_AVAILABLE_HARTS is not set
CONFIG_SPL_OPTIMIZE_INLINING=y
CONFIG_REMAKE_ELF=y
# CONFIG_EFI_LOADER is not set
CONFIG_FIT=y
CONFIG_SPL_LOAD_FIT_ADDRESS=0x80200000
CONFIG_DISTRO_DEFAULTS=y
CONFIG_DISPLAY_CPUINFO=y
CONFIG_DISPLAY_BOARDINFO=y
# CONFIG_BOARD_INIT is not set
# CONFIG_BOARD_LATE_INIT is not set
CONFIG_SPL_MAX_SIZE=0xf000
# CONFIG_SPL_RAW_IMAGE_SUPPORT is not set
CONFIG_SPL_SYS_MALLOC=y
CONFIG_SPL_HAS_CUSTOM_MALLOC_START=y
CONFIG_SPL_CUSTOM_SYS_MALLOC_ADDR=0x8C000000
CONFIG_SPL_SYS_MALLOC_SIZE=0x200000
# CONFIG_SPL_CPU is not set
CONFIG_SPL_REMAKE_ELF=y
CONFIG_SYS_PROMPT="mbv32> "
CONFIG_CMD_GPIO=y
CONFIG_CMD_GPIO_READ=y
CONFIG_CMD_MTD=y
CONFIG_CMD_SNTP=y
CONFIG_CMD_EXCEPTION=y
CONFIG_CMD_TIMER=y
CONFIG_ENV_RELOC_GD_ENV_ADDR=y
CONFIG_NET_LWIP=y
CONFIG_NET_RANDOM_ETHADDR=y
CONFIG_SPL_DM_SEQ_ALIAS=y
CONFIG_GPIO_HOG=y
CONFIG_DM_GPIO_LOOKUP_LABEL=y
CONFIG_XILINX_GPIO=y
CONFIG_DM_MTD=y
CONFIG_DM_MDIO=y
CONFIG_DM_ETH_PHY=y
CONFIG_XILINX_AXIEMAC=y
CONFIG_XILINX_EMACLITE=y
CONFIG_PHY_MARVELL=y
CONFIG_PHY_TI_DP83867=y
CONFIG_DM_RTC=y
CONFIG_RTC_EMULATION=y
CONFIG_XILINX_UARTLITE=y
CONFIG_XILINX_TIMER=y
# CONFIG_BINMAN_FDT is not set
CONFIG_BINMAN_DTB="./arch/riscv/dts/xilinx-binman.dtb"
CONFIG_PANIC_HANG=y
```

## drivers/bios_emulator/Kconfig
```kconfig
config BIOSEMU
	bool
	select X86EMU_RAW_IO if X86

config SPL_BIOSEMU
	bool
	select X86EMU_RAW_IO if X86

config X86EMU_RAW_IO
	bool
```

## drivers/crypto/aes/Kconfig
```kconfig
config DM_AES
	bool "Enable Driver Model for AES crypto operations"
	depends on DM
	help
	  If you want to use driver model for AES crypto operations, say Y.

config SPL_DM_AES
	bool "Enable Driver Model for AES crypto operations in SPL"
	depends on SPL_DM
	select SPL_CRYPTO
	help
	  If you want to use driver model for AES crypto operations in SPL,
	  say Y.

config AES_SOFTWARE
	bool "Enable driver for AES in software"
	depends on DM_AES && AES
	help
	  Enable driver for AES crypto operations in software. Uses U-Boot
	  AES library.
```

## drivers/crypto/allwinner/Kconfig
```kconfig
# SPDX-License-Identifier: GPL-2.0+

source "drivers/crypto/allwinner/sun8i-ce/Kconfig"
```

## drivers/crypto/allwinner/sun8i-ce/Kconfig
```kconfig
# SPDX-License-Identifier: GPL-2.0+

config SUNXI_CE
	bool
	depends on ARCH_SUNXI
	depends on CLK && DM_RESET

config SPL_SUNXI_CE
	bool
	depends on ARCH_SUNXI
	depends on MACH_SUN50I_H6 || MACH_SUN50I_H616
	depends on SPL_DM
	depends on SPL_OF_CONTROL
	select SPL_CLK
	select SPL_CRYPTO
	select SPL_DM_RESET

config SUNXI_CE_AES
	bool "Allwinner sunxi CE AES"
	depends on ARCH_SUNXI
	depends on DM_AES
	depends on CLK && DM_RESET
	select AES
	select SUNXI_CE
	help
	  Select this option to enable AES encryption and decryption using
	  the Crypto Engine found in Allwinner sunxi SoCs. The driver
	  supports software-provided AES-128, AES-192 and AES-256 keys.

config SPL_SUNXI_CE_AES
	bool "Allwinner sunxi CE AES in SPL"
	depends on ARCH_SUNXI
	depends on MACH_SUN50I_H6 || MACH_SUN50I_H616
	depends on SPL_DM_AES
	depends on SPL_OF_CONTROL
	select SPL_CRYPTO
	select SPL_SUNXI_CE
	help
	  Select this option to enable AES decryption in SPL using the Crypto
	  Engine found in Allwinner H6 and H616 compatible SoCs. This can be
	  used to decrypt FIT images before loading U-Boot proper.

config SUNXI_CE_HASH
	bool "Allwinner sunxi CE hash"
	depends on ARCH_SUNXI
	depends on DM_HASH
	depends on CLK && DM_RESET
	select SUNXI_CE
	help
	  Select this option to enable hash calculation using the Crypto Engine
	  found in Allwinner sunxi SoCs. The driver supports MD5, SHA1,
	  SHA256, SHA384 and SHA512.

config SPL_SUNXI_CE_HASH
	bool "Allwinner sunxi CE hash in SPL"
	depends on ARCH_SUNXI
	depends on MACH_SUN50I_H6 || MACH_SUN50I_H616
	depends on SPL_DM
	depends on SPL_OF_CONTROL
	select SPL_DM_HASH
	select SPL_CRYPTO
	select SPL_SUNXI_CE
	help
	  Select this option to enable hash calculation in SPL using the Crypto
	  Engine found in Allwinner H6 and H616 compatible SoCs. FIT image
	  hashes can then be calculated by the hardware accelerator before
	  U-Boot proper is loaded.

config SUNXI_CE_ECDSA
	bool "Allwinner sunxi CE ECDSA verifier"
	depends on ARCH_SUNXI
	depends on ECDSA_VERIFY
	depends on CLK && DM_RESET
	select SUNXI_CE
	help
	  Select this option to enable ECDSA signature verification using
	  the Crypto Engine found in Allwinner sunxi SoCs. FIT image
	  signatures can then be checked by the hardware accelerator in
	  U-Boot proper. Digests wider than the selected curve are
	  truncated according to ECDSA rules.

config SPL_SUNXI_CE_ECDSA
	bool "Allwinner sunxi CE ECDSA verifier in SPL"
	depends on ARCH_SUNXI
	depends on MACH_SUN50I_H6 || MACH_SUN50I_H616
	depends on SPL_DM
	depends on SPL_OF_CONTROL
	depends on SPL_ECDSA_VERIFY
	select SPL_CRYPTO
	select SPL_SUNXI_CE
	help
	  Select this option to enable ECDSA signature verification in SPL
	  using the Crypto Engine found in Allwinner H6 and H616 compatible
	  SoCs.
	  This allows SPL FIT image signatures to be checked by the hardware
	  accelerator before U-Boot proper is loaded. Digests wider than the
	  selected curve are truncated according to ECDSA rules.

if SUNXI_CE_ECDSA

config SUNXI_CE_ECDSA_SECP224R1
	bool "Support secp224r1"
	default y
	help
	  Enable the secp224r1 curve parameters for the sunxi CE ECDSA
	  verifier.

config SUNXI_CE_ECDSA_PRIME256V1
	bool "Support prime256v1"
	default y
	help
	  Enable the prime256v1 curve parameters for the sunxi CE ECDSA
	  verifier.

config SUNXI_CE_ECDSA_SECP384R1
	bool "Support secp384r1"
	default y
	help
	  Enable the secp384r1 curve parameters for the sunxi CE ECDSA
	  verifier.

config SUNXI_CE_ECDSA_SECP521R1
	bool "Support secp521r1"
	default y
	help
	  Enable the secp521r1 curve parameters for the sunxi CE ECDSA
	  verifier.

endif

if SPL_SUNXI_CE_ECDSA

config SPL_SUNXI_CE_ECDSA_SECP224R1
	bool "Support secp224r1 in SPL"
	default y
	help
	  Enable the secp224r1 curve parameters for the sunxi CE ECDSA
	  verifier in SPL.

config SPL_SUNXI_CE_ECDSA_PRIME256V1
	bool "Support prime256v1 in SPL"
	default y
	help
	  Enable the prime256v1 curve parameters for the sunxi CE ECDSA
	  verifier in SPL.

config SPL_SUNXI_CE_ECDSA_SECP384R1
	bool "Support secp384r1 in SPL"
	default y
	help
	  Enable the secp384r1 curve parameters for the sunxi CE ECDSA
	  verifier in SPL.

config SPL_SUNXI_CE_ECDSA_SECP521R1
	bool "Support secp521r1 in SPL"
	default y
	help
	  Enable the secp521r1 curve parameters for the sunxi CE ECDSA
	  verifier in SPL.

endif
```
