## drivers/crypto/fsl/Kconfig
```kconfig
if ARM || PPC

config FSL_CAAM
	bool "Freescale Crypto Driver Support"
	select SHA_HW_ACCEL
	select ARCH_MISC_INIT
	# hw_sha1() under drivers/crypto, and needed with SHA_HW_ACCEL
	select MISC if DM
	imply SPL_CRYPTO if (ARM && SPL)
	imply CMD_HASH
	help
	  Enables the Freescale's Cryptographic Accelerator and Assurance
	  Module (CAAM), also known as the SEC version 4 (SEC4). The driver uses
	  Job Ring as interface to communicate with CAAM.

config SYS_FSL_MAX_NUM_OF_SEC
	int "Number of job rings in the CAAM"
	depends on FSL_CAAM
	default 1

config CAAM_64BIT
	bool
	depends on FSL_CAAM
	default y if PHYS_64BIT && !ARCH_IMX8M && !ARCH_IMX8
	help
	  Select Crypto driver for 64 bits CAAM version

config SYS_FSL_HAS_SEC
	bool
	help
	  Enable Freescale Secure Boot and Trusted Architecture

config SYS_FSL_SEC_COMPAT_2
	bool
	help
	  Secure boot and trust architecture compatible version 2

config SYS_FSL_SEC_COMPAT_4
	bool
	help
	  Secure boot and trust architecture compatible version 4

config SYS_FSL_SEC_COMPAT_5
	bool
	help
	  Secure boot and trust architecture compatible version 5

config SYS_FSL_SEC_COMPAT_6
	bool
	help
	  Secure boot and trust architecture compatible version 6

config SYS_FSL_SEC_BE
	bool "Big-endian access to Freescale Secure Boot"

config SYS_FSL_SEC_COMPAT
	int "Freescale Secure Boot compatibility"
	depends on SYS_FSL_HAS_SEC
	default 2 if SYS_FSL_SEC_COMPAT_2
	default 4 if SYS_FSL_SEC_COMPAT_4
	default 5 if SYS_FSL_SEC_COMPAT_5
	default 6 if SYS_FSL_SEC_COMPAT_6

config SYS_FSL_SEC_LE
	bool "Little-endian access to Freescale Secure Boot"

if FSL_CAAM

config FSL_CAAM_JR_NTZ_ACCESS
	bool "Give CAAM Job Ring access to non-secure world"
	help
	  It is needed when OP-TEE is not used and Freescale CAAM Job Ring linux
	  driver is used.

config FSL_CAAM_RNG
	bool "Enable CAAM Random Number Generator support"
	depends on DM_RNG
	default y
	help
	  Enable support for the hardware based random number generator
	  module of the CAAM. The random data is fetched from the DRGB
	  using the prediction resistance flag which means the DRGB is
	  reseeded from the TRNG every time random data is generated.

config SPL_FSL_CAAM_RNG
	bool "Enable CAAM Random Number Generator support in SPL"
	depends on SPL_DM_RNG
	help
	  This option is an SPL-variant of the FSL_CAAM_RNG option.
	  See the help of FSL_CAAM_RNG for details.

endif

config FSL_DCP_RNG
	bool "Enable DCP Random Number Generator support"
	depends on DM_RNG
	help
	  Enable support for the hardware based random number generator
	  module of the DCP. It uses the True Random Number Generator (TRNG)
	  and a Pseudo-Random Number Generator (PRNG) to achieve a true
	  randomness and cryptographic strength.

config FSL_CAAM_RNG_SELF_TEST
	bool "Run the CAAM RNG self test on affected i.MX6 chips"
	depends on FSL_CAAM
	default y if MX6S || MX6DL || MX6Q || MX6QDL || MX6SX
	help
	  The boot ROM of a few i.MX6 revisions runs the RNG self test
	  incorrectly and leaves a HAB warning behind, which reads

	    STS = HAB_WARNING (0x69)   RSN = HAB_ENG_FAIL (0x30)
	    CTX = HAB_CTX_ENTRY (0xE1) ENG = HAB_ENG_CAAM (0x1D)

	  The warning itself is harmless and this option does not make it
	  go away. What it does is run the self test correctly, before
	  anything else uses the RNG, so that a genuinely broken RNG is
	  found rather than assumed to be the known warning. The board is
	  stopped if the test fails.

	  Affected are i.MX6Solo, i.MX6DL and i.MX6SX revision 1.4, i.MX6Q
	  revision 1.6 and i.MX6QP revision 1.1, and no other revision of
	  those chips. Chip and revision are read at runtime, so a build
	  covering several of them behaves correctly on each.

endif
```

## drivers/crypto/hash/Kconfig
```kconfig
config DM_HASH
	bool "Enable Driver Model for Hash"
	depends on DM
	help
	  If you want to use driver model for Hash, say Y.

config SPL_DM_HASH
	bool "Enable Driver Model for Hash in SPL"
	depends on SPL_DM
	select SPL_CRYPTO
	help
	  Enable the hash uclass in SPL so SPL code can bind and use
	  UCLASS_HASH providers through the driver model. This is useful for
	  FIT verification paths that want to calculate image hashes through a
	  hardware hash accelerator before U-Boot proper is loaded.
	  HASH_SOFTWARE depends on DM_HASH, so SPL_DM_HASH alone does not
	  provide a software hash device. Enable a hardware hash provider for
	  SPL when selecting this option.

config HASH_SOFTWARE
	bool "Enable driver for Hash in software"
	depends on DM_HASH
	depends on MD5
	depends on SHA1
	depends on SHA256
	depends on SHA384
	depends on SHA512
	help
	  Enable driver for hashing operations in software. Currently
	  it support multiple hash algorithm including CRC/MD5/SHA.

config HASH_ASPEED
	bool "Enable Hash with ASPEED hash accelerator"
	depends on DM_HASH && ARCH_ASPEED
	select ASPEED_HACE
	help
	  Enable this to support HW-assisted hashing operations using ASPEED Hash
	  and Crypto engine - HACE
```

## drivers/ddr/altera/Kconfig
```kconfig
config SPL_ALTERA_SDRAM
	bool "SoCFPGA DDR SDRAM driver in SPL"
	depends on SPL
	depends on ARCH_SOCFPGA_GEN5 || ARCH_SOCFPGA_ARRIA10 || ARCH_SOCFPGA_SOC64
	select RAM if ARCH_SOCFPGA_GEN5 || ARCH_SOCFPGA_SOC64
	select SPL_RAM if ARCH_SOCFPGA_GEN5 || ARCH_SOCFPGA_SOC64
	help
	  Enable DDR SDRAM controller for the SoCFPGA devices.

config IO96B_MB_READY
	bool "Wait for IO96B mailbox MB_READY before commands"
	depends on SPL_ALTERA_SDRAM
	depends on ARCH_SOCFPGA_AGILEX5 || ARCH_SOCFPGA_AGILEX7M
	help
	  Poll MAILBOX_HEADER MB_READY during io96b_mb_init()
	  initialization. Disabled by default because some IOSSM firmware
	  revisions never assert this bit, which would cause the wait
	  to time out and hang DDR init. Enable only when the IOSSM
	  firmware sets MB_READY.
```

## drivers/interconnect/qcom/Kconfig
```kconfig
config INTERCONNECT_QCOM_RPMH
	bool "Enable interconnect support for SoCs with RPMh"
	depends on QCOM_RPMH
	help
	  Enable support for the interconnect helpers to vote with
	  the RPMh subsystems in Qualcomm SoCs

config INTERCONNECT_QCOM_SC7280
	bool "Enable interconnect support for SC7280 SoC"
	depends on INTERCONNECT_QCOM_RPMH
	help
	  Enable support for the interconnect driver for the SC7280 SoC.

config INTERCONNECT_QCOM_QCS8300
	bool "Enable interconnect support for QCS8300 SoC"
	depends on INTERCONNECT_QCOM_RPMH
	help
	  Enable support for the interconnect driver for the QCS8300 SoC.

config INTERCONNECT_QCOM_SM8650
	bool "Enable interconnect support for SM8650 SoC"
	depends on INTERCONNECT_QCOM_RPMH
	help
	  Enable support for the interconnect driver for the SM8650 SoC.
```

## drivers/phy/cadence/Kconfig
```kconfig
config PHY_CADENCE_SIERRA
	bool "Cadence Sierra PHY Driver"
	depends on DM_RESET
	help
	  Enable this to support the Cadence Sierra PHY driver

config PHY_CADENCE_TORRENT
	bool "Cadence Torrent PHY Driver"
	depends on DM_RESET
	help
	  Enable this to support the Cadence Torrent PHY driver

config PHY_CADENCE_TORRENT_AUTO_PROBE
	bool "Auto-probe Cadence Torrent PHY Driver after Binding"
	depends on PHY_CADENCE_TORRENT
	help
	  Enable this to auto-probe the Cadence Torrent PHY driver
	  after binding.

config SPL_PHY_CADENCE_TORRENT
	bool "Cadence Torrent PHY Driver"
	depends on SPL_DM_RESET
	help
	  Enable this to support the Cadence Torrent PHY driver at SPL
	  stage.
```

## drivers/phy/mediatek/Kconfig
```kconfig
# SPDX-License-Identifier: GPL-2.0-or-later

config PHY_MTK_DP
	bool "MediaTek DisplayPort PHY Driver"
	depends on PHY
	depends on ARCH_MEDIATEK
	depends on ARM64
	help
	  Support for the embedded DisplayPort TX PHY found on MediaTek SoCs
	  such as the MT8189. The PHY provides the main link lanes and the
	  AUX channel to the eDP transmitter.

config PHY_MTK_HDMI
	bool "MediaTek HDMI-PHY Driver"
	depends on PHY
	depends on ARCH_MEDIATEK
	depends on ARM64
	depends on CLK
	help
	  Support for the HDMI TX PHY found on MediaTek SoCs such as the
	  MT8188 and MT8195. The PHY provides the TMDS links and the pixel
	  clock PLL to the HDMI TX controller.

config PHY_MTK_MIPI_DSI
	bool "MediaTek MIPI-DSI PHY Driver"
	depends on PHY
	depends on ARCH_MEDIATEK
	depends on ARM64
	depends on CLK
	help
	  Support for the MIPI TX D-PHY found on MediaTek SoCs such as the
	  MT8183 and MT8365. The PHY provides the D-PHY lanes and their PLL.

config PHY_MTK_TPHY
	bool "MediaTek T-PHY Driver"
	depends on PHY
	depends on ARCH_MEDIATEK || SOC_MT7621
	select REGMAP
	select SYSCON
	help
	  MediaTek T-PHY driver supports usb2.0, usb3.0 ports, PCIe and
	  SATA, and meanwhile supports two version T-PHY which have
	  different banks layout, the T-PHY with shared banks between
	  multi-ports is first version, otherwise is second version,
	  so you can easily distinguish them by banks layout.

config PHY_MTK_UFS
	bool "MediaTek UFS M-PHY driver"
	depends on ARCH_MEDIATEK
	depends on PHY
	help
	  Support for UFS M-PHY on MediaTek chipsets.
	  Enable this to provide vendor-specific probing,
	  initialization, power on and power off flow of
	  specified M-PHYs.

config PHY_MTK_XSPHY
	bool "MediaTek XS-PHY Driver"
	depends on PHY
	depends on ARCH_MEDIATEK
	select REGMAP
	select SYSCON
	help
	  Enable this to support the SuperSpeedPlus XS-PHY transceiver for
	  USB3.1 GEN2 controllers on MediaTek chips. The driver supports
	  multiple USB2.0, USB3.1 GEN2 ports.
```

## drivers/phy/spacemit/Kconfig
```kconfig
config PHY_SPACEMIT_K1_PCIE
	bool "Spacemit K1 PCIe PHY driver"
	depends on PHY
	help
	  Support for the Spacemit K1 SoC PCIe and Combo (PCIe/USB3) PHYs.

	  This driver handles both the combo PHY used for port A (which
	  calibrates RX/TX termination values) and the PCIe-only PHYs for
	  ports B and C.  The combo PHY must be enabled even if port A
	  is not used for PCIe, because it provides calibration values
	  required by the other ports.

config PHY_SPACEMIT_K1_USB2
	bool "SpacemiT K1 USB 2.0 PHY driver"
	depends on PHY && CLK
	help
	  Enable this to support the USB 2.0 (UTMI) PHY of the SpacemiT K1
	  and K3 SoCs, used by their DWC3 USB 3 controllers. The driver
	  configures the PLL for the 24 MHz reference clock, releases the
	  internal resets and enables the PHY clocks before the controller
	  is started.
```

## drivers/pinctrl/mediatek/Kconfig
```kconfig
if ARCH_MEDIATEK

config PINCTRL_MTK
	bool "MediaTek pinctrl driver"
	depends on PINCTRL_GENERIC
	default y if !TARGET_MT8183
	select PINCONF
	select REGMAP
	select SYSCON
	help
	  Enable MediaTek pinctrl support.

endif
```

## drivers/reset/spacemit/Kconfig
```kconfig
# SPDX-License-Identifier: GPL-2.0-only

config RESET_SPACEMIT_COMMON
	bool
	select DM_RESET
	help
	  Common reset controller infrastructure for SpacemiT SoCs.
	  Shared by the K1 and K3 reset drivers.

config RESET_SPACEMIT_K1
	bool "SpacemiT K1 reset support"
	select RESET_SPACEMIT_COMMON
	help
	  Reset controller for SpacemiT K1 (MPMU/APBC/APMU/APBC2).
	  Bound from the K1 CCU/syscon devices.

config RESET_SPACEMIT_K3
	bool "SpacemiT K3 reset support"
	select RESET_SPACEMIT_COMMON
	help
	  Reset controller for SpacemiT K3 (MPMU/APBC/APMU/DCIU).
	  Bound from the K3 CCU/syscon devices.
```
