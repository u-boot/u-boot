## configs/pxm2_defconfig
```kconfig
CONFIG_ARM=y
CONFIG_ARCH_OMAP2PLUS=y
CONFIG_SPL_GPIO_SUPPORT=y
CONFIG_SPL_LIBCOMMON_SUPPORT=y
CONFIG_SPL_LIBGENERIC_SUPPORT=y
CONFIG_SYS_MALLOC_F_LEN=0x2000
CONFIG_TARGET_PXM2=y
CONFIG_SPL_MMC_SUPPORT=y
CONFIG_SPL_SERIAL_SUPPORT=y
CONFIG_SPL_LIBDISK_SUPPORT=y
CONFIG_SPL_NAND_SUPPORT=y
CONFIG_SPL_SPI_FLASH_SUPPORT=y
CONFIG_SPL_SPI_SUPPORT=y
CONFIG_SPL_WATCHDOG_SUPPORT=y
CONFIG_SPL_FAT_SUPPORT=y
CONFIG_VIDEO=y
CONFIG_DEFAULT_DEVICE_TREE="am335x-pxm50"
CONFIG_BOOTDELAY=3
# CONFIG_CONSOLE_MUX is not set
CONFIG_SYS_CONSOLE_INFO_QUIET=y
# CONFIG_DISPLAY_CPUINFO is not set
# CONFIG_DISPLAY_BOARDINFO is not set
CONFIG_ARCH_MISC_INIT=y
CONFIG_SPL=y
CONFIG_SYS_MMCSD_RAW_MODE_U_BOOT_USE_SECTOR=y
CONFIG_SYS_MMCSD_RAW_MODE_U_BOOT_SECTOR=0x300
CONFIG_SPL_I2C_SUPPORT=y
CONFIG_SPL_YMODEM_SUPPORT=y
CONFIG_HUSH_PARSER=y
CONFIG_SYS_PROMPT="U-Boot# "
CONFIG_AUTOBOOT_KEYED=y
CONFIG_AUTOBOOT_PROMPT="Autobooting in %d seconds, press \"<Esc><Esc>\" to stop\n"
CONFIG_AUTOBOOT_STOP_STR="\x1b\x1b"
# CONFIG_CMD_IMLS is not set
CONFIG_CMD_ASKENV=y
# CONFIG_CMD_FLASH is not set
CONFIG_CMD_MMC=y
CONFIG_CMD_SF=y
CONFIG_CMD_I2C=y
CONFIG_CMD_USB=y
CONFIG_CMD_DFU=y
CONFIG_CMD_GPIO=y
# CONFIG_CMD_SETEXPR is not set
CONFIG_CMD_DHCP=y
CONFIG_CMD_MII=y
CONFIG_CMD_PING=y
CONFIG_CMD_BMP=y
CONFIG_CMD_CACHE=y
CONFIG_CMD_TIME=y
CONFIG_CMD_EXT2=y
CONFIG_CMD_FAT=y
CONFIG_CMD_UBI=y
CONFIG_OF_CONTROL=y
CONFIG_OF_EMBED=y
CONFIG_DFU_NAND=y
CONFIG_MMC_OMAP_HS=y
CONFIG_SPI_FLASH=y
CONFIG_SPI_FLASH_WINBOND=y
CONFIG_MTD_UBI_FASTMAP=y
CONFIG_MTD_UBI_FASTMAP_AUTOCONVERT=1
CONFIG_SYS_NS16550=y
CONFIG_USB=y
CONFIG_USB_MUSB_HOST=y
CONFIG_USB_MUSB_GADGET=y
CONFIG_USB_STORAGE=y
CONFIG_USB_GADGET=y
CONFIG_USB_GADGET_DOWNLOAD=y
CONFIG_G_DNL_MANUFACTURER="Siemens AG"
CONFIG_G_DNL_VENDOR_NUM=0x0908
CONFIG_G_DNL_PRODUCT_NUM=0x02d2
# CONFIG_VIDEO_SW_CURSOR is not set
CONFIG_SYS_CONSOLE_BG_COL=0xff
CONFIG_SYS_CONSOLE_FG_COL=0x00
```

## configs/qcm6490_defconfig
```kconfig
# Configuration for building U-Boot to be flashed
# to the uefi partition of QCM6490 dev boards with
# the "Linux Embedded" partition layout (which have
# a dedicated "uefi" partition for edk2/U-Boot)

#include "qcom_defconfig"

# Otherwise buildman thinks this isn't an ARM platform
CONFIG_ARM=y

# Address where U-Boot will be loaded
CONFIG_TEXT_BASE=0x9fc00000
CONFIG_REMAKE_ELF=y

CONFIG_DEFAULT_DEVICE_TREE="qcom/qcs6490-rb3gen2"

CONFIG_FASTBOOT_BUF_ADDR=0xd8800000
```

## configs/qcom_defconfig
```kconfig
CONFIG_ARM=y
CONFIG_SKIP_LOWLEVEL_INIT=y
CONFIG_POSITION_INDEPENDENT=y
CONFIG_SYS_INIT_SP_BSS_OFFSET=1572864
CONFIG_ARCH_SNAPDRAGON=y
CONFIG_DEFAULT_DEVICE_TREE="qcom/sdm845-db845c"
CONFIG_SYS_LOAD_ADDR=0xA0000000
CONFIG_BUTTON_CMD=y
CONFIG_FIT=y
CONFIG_FIT_VERBOSE=y
CONFIG_BOOTSTD_FULL=y
# CONFIG_BOOTMETH_VBE is not set
CONFIG_BOOTDELAY=1
CONFIG_OF_BOARD_SETUP=y
CONFIG_USE_PREBOOT=y
CONFIG_SAVE_PREV_BL_INITRAMFS_START_ADDR=y
CONFIG_SYS_CBSIZE=512
CONFIG_LOG_MAX_LEVEL=9
CONFIG_LOG_DEFAULT_LEVEL=4
# CONFIG_DISPLAY_CPUINFO is not set
CONFIG_DISPLAY_BOARDINFO_LATE=y
CONFIG_CMD_BOOTMENU=y
CONFIG_CMD_EEPROM=y
CONFIG_SYS_I2C_EEPROM_BUS=2
CONFIG_SYS_I2C_EEPROM_ADDR_LEN=2
CONFIG_SYS_EEPROM_PAGE_WRITE_BITS=5
# CONFIG_CMD_BIND is not set
CONFIG_CMD_CLK=y
CONFIG_CMD_GPIO=y
CONFIG_CMD_I2C=y
CONFIG_CMD_MMC=y
CONFIG_CMD_UFS=y
CONFIG_CMD_USB=y
CONFIG_CMD_CAT=y
CONFIG_CMD_BMP=y
CONFIG_CMD_LOG=y
CONFIG_OF_LIVE=y
CONFIG_BUTTON_QCOM_PMIC=y
CONFIG_USE_DEFAULT_ENV_FILE=y
CONFIG_DEFAULT_ENV_FILE="board/qualcomm/default.env"
CONFIG_CLK=y
CONFIG_CLK_QCOM_APQ8016=y
CONFIG_CLK_QCOM_APQ8096=y
CONFIG_CLK_QCOM_QCM2290=y
CONFIG_CLK_QCOM_QCS404=y
CONFIG_CLK_QCOM_SDM845=y
CONFIG_CLK_QCOM_SM6115=y
CONFIG_CLK_QCOM_SM8250=y
CONFIG_CLK_QCOM_SM8550=y
CONFIG_CLK_QCOM_SM8650=y
CONFIG_MSM_GPIO=y
CONFIG_QCOM_PMIC_GPIO=y
CONFIG_DM_I2C=y
CONFIG_SYS_I2C_QUP=y
CONFIG_SYS_I2C_GENI=y
CONFIG_I2C_MUX=y
CONFIG_DM_KEYBOARD=y
CONFIG_BUTTON_KEYBOARD=y
CONFIG_IOMMU=y
CONFIG_QCOM_HYP_SMMU=y
CONFIG_MISC=y
CONFIG_NVMEM=y
CONFIG_I2C_EEPROM=y
CONFIG_MMC_HS200_SUPPORT=y
CONFIG_MMC_SDHCI=y
CONFIG_MMC_SDHCI_ADMA=y
CONFIG_MMC_SDHCI_MSM=y
CONFIG_PHY_MICREL=y
CONFIG_PHY_MICREL_KSZ90X1=y
CONFIG_DM_MDIO=y
CONFIG_DM_ETH_PHY=y
CONFIG_DWC_ETH_QOS=y
CONFIG_DWC_ETH_QOS_QCOM=y
CONFIG_RGMII=y
CONFIG_PHY=y
CONFIG_PHY_QCOM_QUSB2=y
CONFIG_PHY_QCOM_USB_SNPS_FEMTO_V2=y
CONFIG_PHY_QCOM_SNPS_EUSB2=y
CONFIG_PINCTRL=y
CONFIG_PINCTRL_QCOM_APQ8016=y
CONFIG_PINCTRL_QCOM_APQ8096=y
CONFIG_PINCTRL_QCOM_QCM2290=y
CONFIG_PINCTRL_QCOM_QCS404=y
CONFIG_PINCTRL_QCOM_SDM845=y
CONFIG_PINCTRL_QCOM_SM6115=y
CONFIG_PINCTRL_QCOM_SM8250=y
CONFIG_PINCTRL_QCOM_SM8550=y
CONFIG_PINCTRL_QCOM_SM8650=y
CONFIG_DM_PMIC=y
CONFIG_PMIC_QCOM=y
CONFIG_DM_REGULATOR=y
CONFIG_DM_REGULATOR_FIXED=y
CONFIG_SCSI=y
CONFIG_MSM_SERIAL=y
CONFIG_MSM_GENI_SERIAL=y
CONFIG_SPMI_MSM=y
CONFIG_SYSINFO=y
CONFIG_SYSINFO_SMBIOS=y
CONFIG_USB=y
CONFIG_USB_XHCI_HCD=y
CONFIG_USB_XHCI_DWC3=y
CONFIG_USB_DWC3=y
CONFIG_USB_DWC3_GENERIC=y
CONFIG_USB_GADGET=y
CONFIG_USB_GADGET_DOWNLOAD=y
CONFIG_USB_FUNCTION_MASS_STORAGE=y
CONFIG_UFS=y
CONFIG_VIDEO=y
# CONFIG_VIDEO_FONT_8X16 is not set
CONFIG_VIDEO_FONT_16X32=y
CONFIG_SYS_WHITE_ON_BLACK=y
CONFIG_NO_FB_CLEAR=y
CONFIG_VIDEO_SIMPLE=y
CONFIG_HEXDUMP=y
CONFIG_LMB_MAX_REGIONS=64
```

## configs/qcom_ipq9574_mmc_defconfig
```kconfig
CONFIG_ARM=y
CONFIG_SKIP_LOWLEVEL_INIT=y
CONFIG_POSITION_INDEPENDENT=y
CONFIG_SYS_INIT_SP_BSS_OFFSET=1572864
CONFIG_ARCH_SNAPDRAGON=y
CONFIG_TEXT_BASE=0x4A240000
CONFIG_NR_DRAM_BANKS=24
CONFIG_ENV_SIZE=0x40000
CONFIG_ENV_OFFSET=0
CONFIG_DEFAULT_DEVICE_TREE="qcom/ipq9574-rdp433"
CONFIG_SYS_LOAD_ADDR=0x50000000
CONFIG_DEBUG_UART_BASE=0x78b1000
CONFIG_DEBUG_UART_CLOCK=1843200
CONFIG_DEBUG_UART=y
CONFIG_REMAKE_ELF=y
# CONFIG_EFI_LOADER is not set
CONFIG_FIT=y
CONFIG_FIT_VERBOSE=y
# CONFIG_BOOTSTD is not set
CONFIG_OF_BOARD_SETUP=y
CONFIG_USE_PREBOOT=y
CONFIG_SYS_PBSIZE=1024
# CONFIG_DISPLAY_CPUINFO is not set
CONFIG_DISPLAY_BOARDINFO_LATE=y
CONFIG_HUSH_PARSER=y
CONFIG_CMD_MMC=y
CONFIG_CMD_PART=y
CONFIG_EFI_PARTITION=y
CONFIG_OF_LIVE=y
CONFIG_ENV_IS_IN_MMC=y
CONFIG_CLK=y
CONFIG_CLK_QCOM_IPQ9574=y
CONFIG_MSM_GPIO=y
# CONFIG_I2C is not set
# CONFIG_INPUT is not set
CONFIG_MMC_SDHCI=y
CONFIG_MMC_SDHCI_ADMA=y
CONFIG_MMC_SDHCI_MSM=y
CONFIG_MTD=y
CONFIG_DM_MDIO=y
CONFIG_DM_ETH_PHY=y
CONFIG_DWC_ETH_QOS=y
CONFIG_DWC_ETH_QOS_QCOM=y
CONFIG_RGMII=y
CONFIG_PHY=y
CONFIG_PHY_QCOM_QMP_UFS=y
CONFIG_PHY_QCOM_QUSB2=y
CONFIG_PINCTRL=y
CONFIG_PINCONF=y
CONFIG_PINCTRL_QCOM_IPQ9574=y
CONFIG_DEBUG_UART_ANNOUNCE=y
CONFIG_MSM_SERIAL=y
CONFIG_MSM_GENI_SERIAL=y
CONFIG_SOC_QCOM=y
```

## configs/qcom_qcs8300_defconfig
```kconfig
# Configuration for building U-Boot to be flashed
# to the uefi partition of QCS8300 dev boards with
# the "Linux Embedded" partition layout (which have
# a dedicated "uefi_a" partition for edk2/U-Boot)

#include "qcom_defconfig"

# Otherwise buildman thinks this isn't an ARM platform
CONFIG_ARM=y

CONFIG_DEBUG_UART=y
CONFIG_DEBUG_UART_ANNOUNCE=y
CONFIG_DEBUG_UART_BASE=0x99C000
CONFIG_DEBUG_UART_MSM_GENI=y
CONFIG_DEBUG_UART_CLOCK=14745600

# Address where U-Boot will be loaded
CONFIG_TEXT_BASE=0xaf000000
CONFIG_REMAKE_ELF=y

CONFIG_DEFAULT_DEVICE_TREE="qcom/qcs8300-ride"
```

## configs/qcom_qcs9100_defconfig
```kconfig
# Configuration for building U-Boot to be flashed
# to the uefi partition of QCS9100 based dev boards with
# the "Linux Embedded" partition layout (which have
# a dedicated "uefi" partition for edk2/U-Boot)

#include "qcom_defconfig"

# Address where U-Boot will be loaded
CONFIG_TEXT_BASE=0xaf000000
CONFIG_REMAKE_ELF=y
CONFIG_FASTBOOT_BUF_ADDR=0xdb300000
CONFIG_DEFAULT_DEVICE_TREE="qcom/qcs9100-ride-r3"
CONFIG_ENV_IS_IN_SCSI=y
CONFIG_SCSI_ENV_PART_UUID="71cb9cd0-acf1-b6cb-ad91-be9572fe11a9"
# CONFIG_ENV_IS_DEFAULT is not set
# CONFIG_ENV_IS_NOWHERE is not set
```

## configs/qcom_sdm636_tulip_defconfig
```kconfig
# Configuration for building U-Boot as 2nd stage
# bootloader to be flashed as part of boot.img to
# boot partition on Xiaomi Redmi Note 6 Pro phones.

#include "qcom_sdm660_defconfig"

# clover device tree is not upstream
CONFIG_OF_UPSTREAM=n
CONFIG_DEFAULT_DEVICE_TREE="qcom/sdm636-xiaomi-tulip"

# xiaomi-tulip is built with no real serial debug uart available,
# it is using ramoops logging instead
# and with pre_console_buffer

# CONFIG_REQUIRE_SERIAL_CONSOLE is not set
# CONFIG_SERIAL_PRESENT is not set
# ^^ reason to disable both debug-uart and bluetooth-uart nodes in dts

CONFIG_DEBUG_UART_RAMOOPS=y
# Values from xiaomi-clover downstream TWRP recovery device tree
CONFIG_DEBUG_UART_RAMOOPS_BASE=0xa0000000
CONFIG_DEBUG_UART_RAMOOPS_SIZE=0x400000
CONFIG_DEBUG_UART_RAMOOPS_CONSOLE_SIZE=0x20000
CONFIG_DEBUG_UART_RAMOOPS_FTRACE_SIZE=0x0
CONFIG_DEBUG_UART_RAMOOPS_RECORD_SIZE=0x20000
CONFIG_DEBUG_UART_RAMOOPS_PMSG_SIZE=0x20000
CONFIG_DEBUG_UART_SKIP_INIT=n

CONFIG_PRE_CONSOLE_BUFFER=y
CONFIG_PRE_CON_BUF_ADDR=0x95100000
CONFIG_PRE_CON_BUF_SZ=16384
```

## configs/qcom_sdm636_whyred_defconfig
```kconfig
# Configuration for building U-Boot as 2nd stage
# bootloader to be flashed as part of boot.img to
# boot partition on Xiaomi Redmi Note 6 Pro phones.

#include "qcom_sdm660_defconfig"

# clover device tree is not upstream
CONFIG_OF_UPSTREAM=n
CONFIG_DEFAULT_DEVICE_TREE="qcom/sdm636-xiaomi-whyred"

# xiaomi-whyred is built with no real serial debug uart available,
# it is using ramoops logging instead

# CONFIG_REQUIRE_SERIAL_CONSOLE is not set
# CONFIG_SERIAL_PRESENT is not set
# ^^ reason to disable both debug-uart and bluetooth-uart nodes in dts

CONFIG_DEBUG_UART_RAMOOPS=y
# Values from xiaomi-whyred downstream TWRP recovery from
#     /sys/module/ramoops/parameters/ *
CONFIG_DEBUG_UART_RAMOOPS_BASE=0xa0000000
CONFIG_DEBUG_UART_RAMOOPS_SIZE=0x400000
CONFIG_DEBUG_UART_RAMOOPS_CONSOLE_SIZE=0x200000
CONFIG_DEBUG_UART_RAMOOPS_FTRACE_SIZE=0x0
CONFIG_DEBUG_UART_RAMOOPS_RECORD_SIZE=0x0
CONFIG_DEBUG_UART_RAMOOPS_PMSG_SIZE=0x200000
CONFIG_DEBUG_UART_SKIP_INIT=n
```

## configs/qcom_sdm636_x00qd_defconfig
```kconfig
# Configuration for building U-Boot as 2nd stage
# bootloader to be flashed as part of boot.img to
# boot partition on Asus Zenfone 5 phones.

#include "qcom_sdm660_defconfig"

# x00qd device tree is not upstream yet
CONFIG_OF_UPSTREAM=n
CONFIG_DEFAULT_DEVICE_TREE="qcom/sdm636-asus-x00qd"

# asus-x00qd is built with no real serial debug uart available,
# (or it has not been found yet)
# it is using ramoops logging instead

# CONFIG_REQUIRE_SERIAL_CONSOLE is not set
# CONFIG_SERIAL_PRESENT is not set
# ^^ reason to disable because both debug-uart and bluetooth-uart nodes in dts

CONFIG_DEBUG_UART_RAMOOPS=y
# Values from asus-x00qd downstream 4.19 kernel device tree
CONFIG_DEBUG_UART_RAMOOPS_BASE=0x94b00000
CONFIG_DEBUG_UART_RAMOOPS_SIZE=0x400000
CONFIG_DEBUG_UART_RAMOOPS_CONSOLE_SIZE=0x200000
CONFIG_DEBUG_UART_RAMOOPS_FTRACE_SIZE=0x0
CONFIG_DEBUG_UART_RAMOOPS_RECORD_SIZE=0x0
CONFIG_DEBUG_UART_RAMOOPS_PMSG_SIZE=0x200000
CONFIG_DEBUG_UART_SKIP_INIT=n

CONFIG_USB_GADGET_VENDOR_NUM=0x0b05
CONFIG_USB_GADGET_PRODUCT_NUM=0x4daf
```

## configs/qcom_sdm636_x00td_defconfig
```kconfig
# Configuration for building U-Boot as 2nd stage
# bootloader to be flashed as part of boot.img to
# boot partition on Asus Zenfone Max Pro M1 phones.

#include "qcom_sdm660_defconfig"

# x00td device tree is not upstream
CONFIG_OF_UPSTREAM=n
CONFIG_DEFAULT_DEVICE_TREE="qcom/sdm636-asus-x00td"

# asus-x00td is built with no real serial debug uart available,
# it is using ramoops logging instead

# CONFIG_REQUIRE_SERIAL_CONSOLE is not set
# CONFIG_SERIAL_PRESENT is not set
# ^^ reason to disable both debug-uart and bluetooth-uart nodes in dts

CONFIG_DEBUG_UART_RAMOOPS=y
# Values from asus-x00td downstream TWRP recovery device tree
#     /sys/module/ramoops/parameters/ *
CONFIG_DEBUG_UART_RAMOOPS_BASE=0xa0000000
CONFIG_DEBUG_UART_RAMOOPS_SIZE=0x400000
CONFIG_DEBUG_UART_RAMOOPS_CONSOLE_SIZE=0x20000
CONFIG_DEBUG_UART_RAMOOPS_FTRACE_SIZE=0x0
CONFIG_DEBUG_UART_RAMOOPS_RECORD_SIZE=0x20000
CONFIG_DEBUG_UART_RAMOOPS_PMSG_SIZE=0x20000
CONFIG_DEBUG_UART_SKIP_INIT=n
```

## configs/qcom_sdm660_clover_defconfig
```kconfig
# Configuration for building U-Boot as 2nd stage
# bootloader to be flashed as part of boot.img to
# boot partition on Xiaomi Redmi Note 7 phones.

#include "qcom_sdm660_defconfig"

# clover device tree is not upstream
CONFIG_OF_UPSTREAM=n
CONFIG_DEFAULT_DEVICE_TREE="qcom/sdm660-xiaomi-clover"

# xiaomi-clover is built with no real serial debug uart available,
# it is using ramoops logging instead
# and with pre_console_buffer

# CONFIG_REQUIRE_SERIAL_CONSOLE is not set
# CONFIG_SERIAL_PRESENT is not set
# ^^ reason to disable both debug-uart and bluetooth-uart nodes in dts

CONFIG_DEBUG_UART_RAMOOPS=y
# Values from xiaomi-clover downstream TWRP recovery device tree
CONFIG_DEBUG_UART_RAMOOPS_BASE=0x9fe00000
CONFIG_DEBUG_UART_RAMOOPS_SIZE=0x100000
CONFIG_DEBUG_UART_RAMOOPS_CONSOLE_SIZE=0x80000
CONFIG_DEBUG_UART_RAMOOPS_FTRACE_SIZE=0x1000
CONFIG_DEBUG_UART_RAMOOPS_RECORD_SIZE=0x1000
CONFIG_DEBUG_UART_RAMOOPS_PMSG_SIZE=0x8000
CONFIG_DEBUG_UART_SKIP_INIT=n

CONFIG_PRE_CONSOLE_BUFFER=y
CONFIG_PRE_CON_BUF_ADDR=0x95100000
CONFIG_PRE_CON_BUF_SZ=16384
```

## configs/qcom_sdm660_lavender_defconfig
```kconfig
# Configuration for building U-Boot as 2nd stage
# bootloader to be flashed as part of boot.img to
# boot partition on Xiaomi Redmi Note 7 phones.

#include "qcom_sdm660_defconfig"

# lavender is a bit special, it's device tree is upstream
CONFIG_OF_UPSTREAM=y
CONFIG_DEFAULT_DEVICE_TREE="qcom/sdm660-xiaomi-lavender"
```

## configs/qcs9100_defconfig
```kconfig
# Configuration for building U-Boot to be flashed
# to the uefi partition of QCS9100 based dev boards with
# the "Linux Embedded" partition layout (which have
# a dedicated "uefi" partition for edk2/U-Boot)

#include "qcom_defconfig"

CONFIG_DEBUG_UART=y
CONFIG_DEBUG_UART_ANNOUNCE=y
CONFIG_DEBUG_UART_BASE=0xA8C000
CONFIG_DEBUG_UART_MSM_GENI=y
CONFIG_DEBUG_UART_CLOCK=14745600

# Address where U-Boot will be loaded
CONFIG_TEXT_BASE=0xaf000000
CONFIG_REMAKE_ELF=y
CONFIG_DEFAULT_DEVICE_TREE="qcom/qcs9100-ride-r3"
CONFIG_ENV_IS_IN_SCSI=y
CONFIG_SCSI_ENV_PART_UUID="71cb9cd0-acf1-b6cb-ad91-be9572fe11a9"
# CONFIG_ENV_IS_DEFAULT is not set
# CONFIG_ENV_IS_NOWHERE is not set
```

## configs/qemu-arm-sbsa_defconfig
```kconfig
CONFIG_ARM=y
CONFIG_ARCH_QEMU=y
CONFIG_BLOBLIST_SIZE_RELOC=0x20000
CONFIG_TARGET_QEMU_ARM_SBSA=y
CONFIG_EFI_VARIABLE_NO_STORE=y
CONFIG_USE_BOOTCOMMAND=y
CONFIG_BOOTCOMMAND="bootflow scan"
# CONFIG_BOARD_INIT is not set
CONFIG_EFI_PARTITION=y
CONFIG_PARTITION_TYPE_GUID=y
CONFIG_EFI_MEDIA=y
CONFIG_FS_FAT=y
CONFIG_UNIT_TEST=y
```

## configs/qemu-loongarch64_defconfig
```kconfig
CONFIG_LOONGARCH=y
CONFIG_SYS_MALLOC_LEN=0x800000
CONFIG_SYS_MALLOC_F_LEN=0x4000
CONFIG_NR_DRAM_BANKS=8
CONFIG_ENV_SIZE=0x20000
CONFIG_DEFAULT_DEVICE_TREE="qemu-loongarch64"
CONFIG_DM_RESET=y
CONFIG_SYS_LOAD_ADDR=0x02000000
CONFIG_SHOW_REGS=y
# CONFIG_OF_BOARD_FIXUP is not set
CONFIG_SYS_PCI_64BIT=y
CONFIG_FIT=y
CONFIG_BOOTSTD_FULL=y
CONFIG_SYS_BOOTM_LEN=0x4000000
CONFIG_USE_BOOTARGS=y
CONFIG_BOOTARGS_SUBST=y
CONFIG_DISPLAY_CPUINFO=y
CONFIG_DISPLAY_BOARDINFO=y
# CONFIG_CMD_MII is not set
CONFIG_CMD_2048=y
CONFIG_CMD_RTC=y
CONFIG_CMD_TIME=y
CONFIG_CMD_SYSBOOT=y
CONFIG_CMD_QFW=y
CONFIG_PARTITION_TYPE_GUID=y
CONFIG_SYS_RELOC_GD_ENV_ADDR=y
CONFIG_BLKMAP=y
CONFIG_EFI_MEDIA=y
CONFIG_DM_MMC=y
CONFIG_DM_MTD=y
CONFIG_FLASH_SHOW_PROGRESS=0
CONFIG_SYS_MAX_FLASH_BANKS=2
CONFIG_PCI_REGION_MULTI_ENTRY=y
CONFIG_DM_REBOOT_MODE=y
CONFIG_RESET_SYSCON=y
CONFIG_HEXDUMP=y
```
