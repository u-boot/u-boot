## configs/spear310_pnor_defconfig
```kconfig
CONFIG_ARM=y
CONFIG_TARGET_SPEAR310=y
CONFIG_SYS_EXTRA_OPTIONS="spear310,FLASH_PNOR"
CONFIG_CMD_I2C=y
# CONFIG_CMD_SETEXPR is not set
CONFIG_CMD_DHCP=y
CONFIG_CMD_MII=y
CONFIG_CMD_PING=y
CONFIG_NETDEVICES=y
CONFIG_ETH_DESIGNWARE=y
```

## configs/spear310_usbtty_defconfig
```kconfig
CONFIG_ARM=y
CONFIG_TARGET_SPEAR310=y
CONFIG_NETDEVICES=y
CONFIG_SYS_EXTRA_OPTIONS="spear310,usbtty"
CONFIG_CMD_NET=y
CONFIG_ETH_DESIGNWARE=y
```

## configs/spear310_usbtty_nand_defconfig
```kconfig
CONFIG_ARM=y
CONFIG_TARGET_SPEAR310=y
CONFIG_NETDEVICES=y
CONFIG_SYS_EXTRA_OPTIONS="spear310,usbtty,nand"
CONFIG_CMD_NET=y
CONFIG_ETH_DESIGNWARE=y
```

## configs/spear310_usbtty_pnor_defconfig
```kconfig
CONFIG_SYS_EXTRA_OPTIONS="spear310,usbtty,FLASH_PNOR"
CONFIG_ARM=y
CONFIG_TARGET_SPEAR310=y
CONFIG_ETH_DESIGNWARE=y
CONFIG_NETDEVICES=y
CONFIG_NET=y
```

## configs/spear320_defconfig
```kconfig
CONFIG_ARM=y
CONFIG_TARGET_SPEAR320=y
CONFIG_SYS_EXTRA_OPTIONS="spear320"
CONFIG_CMD_I2C=y
# CONFIG_CMD_SETEXPR is not set
CONFIG_CMD_DHCP=y
CONFIG_CMD_MII=y
CONFIG_CMD_PING=y
CONFIG_NETDEVICES=y
CONFIG_ETH_DESIGNWARE=y
```

## configs/spear320_nand_defconfig
```kconfig
CONFIG_ARM=y
CONFIG_TARGET_SPEAR320=y
CONFIG_SYS_EXTRA_OPTIONS="spear320,nand"
# CONFIG_CMD_SETEXPR is not set
CONFIG_NETDEVICES=y
CONFIG_ETH_DESIGNWARE=y
```

## configs/spear320_pnor_defconfig
```kconfig
CONFIG_ARM=y
CONFIG_TARGET_SPEAR320=y
CONFIG_IDENT_STRING="-SPEAr"
CONFIG_SYS_EXTRA_OPTIONS="SPEAR320,FLASH_PNOR"
CONFIG_BOOTDELAY=1
CONFIG_SYS_CONSOLE_INFO_QUIET=y
# CONFIG_DISPLAY_BOARDINFO is not set
CONFIG_CMD_I2C=y
# CONFIG_CMD_SETEXPR is not set
CONFIG_CMD_DHCP=y
CONFIG_CMD_MII=y
CONFIG_CMD_PING=y
CONFIG_SYS_I2C_DW=y
CONFIG_NETDEVICES=y
CONFIG_ETH_DESIGNWARE=y
```

## configs/spear320_usbtty_defconfig
```kconfig
CONFIG_SYS_EXTRA_OPTIONS="spear320,usbtty"
CONFIG_ARM=y
CONFIG_TARGET_SPEAR320=y
```
