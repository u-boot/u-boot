## drivers/Kconfig
```kconfig
menu "Device Drivers"

source "drivers/core/Kconfig"

source "drivers/demo/Kconfig"

source "drivers/pci/Kconfig"

source "drivers/pcmcia/Kconfig"

source "drivers/mtd/Kconfig"

source "drivers/block/Kconfig"

source "drivers/misc/Kconfig"

source "drivers/net/Kconfig"

source "drivers/input/Kconfig"

source "drivers/serial/Kconfig"

source "drivers/tpm/Kconfig"

source "drivers/i2c/Kconfig"

source "drivers/spi/Kconfig"

source "drivers/gpio/Kconfig"

source "drivers/power/Kconfig"

source "drivers/hwmon/Kconfig"

source "drivers/watchdog/Kconfig"

source "drivers/video/Kconfig"

source "drivers/sound/Kconfig"

source "drivers/usb/Kconfig"

source "drivers/dfu/Kconfig"

source "drivers/mmc/Kconfig"

source "drivers/rtc/Kconfig"

source "drivers/dma/Kconfig"

source "drivers/crypto/Kconfig"

source "drivers/thermal/Kconfig"

endmenu
```

## drivers/adc/Kconfig
```kconfig
config ADC
	bool "Enable ADC drivers using Driver Model"
	help
	  This enables ADC API for drivers, which allows driving ADC features
	  by single and multi-channel methods for:
	  - start/stop/get data for conversion of a single-channel selected by
	    a number or multi-channels selected by a bitmask
	  - get data mask (ADC resolution)
	  ADC reference Voltage supply options:
	  - methods for get Vdd/Vss reference Voltage values with polarity
	  - support supply's phandle with auto-enable
	  - supply polarity setting in fdt

config ADC_EXYNOS
	bool "Enable Exynos 54xx ADC driver"
	help
	  This enables basic driver for Exynos ADC compatible with Exynos54xx.
	  It provides:
	  - 10 analog input channels
	  - 12-bit resolution
	  - 600 KSPS of sample rate
```

## drivers/ata/Kconfig
```kconfig
config AHCI
	bool "Support SATA controllers with driver model"
	depends on DM
	help
	  This enables a uclass for disk controllers in U-Boot. Various driver
	  types can use this, such as AHCI/SATA. It does not provide any standard
	  operations at present. The block device interface has not been converted
	  to driver model.

config SATA
	bool "Support SATA controllers"
	help
	  This enables support for SATA (Serial Advanced Technology
	  Attachment), a serial bus standard for connecting to hard drives and
	  other storage devices.

	  SATA replaces PATA (originally just ATA), which stands for Parallel AT
	  Attachment, where AT refers to an IBM AT (Advanced Technology)
	  computer released in 1984.

	  See also CMD_SATA which provides command-line support.

menu "SATA/SCSI device support"

config AHCI_PCI
	bool "Support for PCI-based AHCI controller"
	depends on DM_SCSI
	help
	  Enables support for the PCI-based AHCI controller.

config SATA_CEVA
	bool "Ceva Sata controller"
	depends on AHCI
	depends on DM_SCSI
	help
	  This option enables Ceva Sata controller hard IP available on Xilinx
	  ZynqMP. Support up to 2 external devices. Complient with SATA 3.1 and
	  AHCI 1.3 specifications with hot-plug detect feature.


config DWC_AHCI
	bool "Enable Synopsys DWC AHCI driver support"
	select SCSI_AHCI
	select PHY
	depends on DM_SCSI
	help
	  Enable this driver to support Sata devices through
	  Synopsys DWC AHCI module.

endmenu
```

## drivers/axi/Kconfig
```kconfig
menuconfig AXI
	bool "AXI bus drivers"
	help
	  Support AXI (Advanced eXtensible Interface) busses, a on-chip
	  interconnect specification for managing functional blocks in SoC
	  designs, which is also often used in designs involving FPGAs (e.g.
	  communication with IP cores in Xilinx FPGAs).

	  These types of busses expose a virtual address space that can be
	  accessed using different address widths (8, 16, and 32 are supported
	  for now).

	  Other similar bus architectures may be compatible as well.
```

## drivers/block/Kconfig
```kconfig
config BLK
	bool "Support block devices"
	depends on DM
	default y if DM_MMC || DM_USB
	help
	  Enable support for block devices, such as SCSI, MMC and USB
	  flash sticks. These provide a block-level interface which permits
	  reading, writing and (in some cases) erasing blocks. Block
	  devices often have a partition table which allows the device to
	  be partitioned into several areas, called 'partitions' in U-Boot.
	  A filesystem can be placed in each partition.

config HAVE_BLOCK_DEVICE
	bool "Enable Legacy Block Device"
	help
	  Some devices require block support whether or not DM is enabled

config SPL_BLK
	bool "Support block devices in SPL"
	depends on SPL_DM && BLK
	default y
	help
	  Enable support for block devices, such as SCSI, MMC and USB
	  flash sticks. These provide a block-level interface which permits
	  reading, writing and (in some cases) erasing blocks. Block
	  devices often have a partition table which allows the device to
	  be partitioned into several areas, called 'partitions' in U-Boot.
	  A filesystem can be placed in each partition.

config TPL_BLK
	bool "Support block devices in TPL"
	depends on TPL_DM && BLK
	default y
	help
	  Enable support for block devices, such as SCSI, MMC and USB
	  flash sticks. These provide a block-level interface which permits
	  reading, writing and (in some cases) erasing blocks. Block
	  devices often have a partition table which allows the device to
	  be partitioned into several areas, called 'partitions' in U-Boot.
	  A filesystem can be placed in each partition.

config BLOCK_CACHE
	bool "Use block device cache"
	depends on BLK
	default y
	help
	  This option enables a disk-block cache for all block devices.
	  This is most useful when accessing filesystems under U-Boot since
	  it will prevent repeated reads from directory structures and other
	  filesystem data structures.

config SPL_BLOCK_CACHE
	bool "Use block device cache in SPL"
	depends on SPL_BLK
	help
	  This option enables the disk-block cache in SPL

config TPL_BLOCK_CACHE
	bool "Use block device cache in TPL"
	depends on TPL_BLK
	help
	  This option enables the disk-block cache in TPL

config EFI_MEDIA
	bool "Support EFI media drivers"
	default y if EFI || SANDBOX
	help
	  Enable this to support media devices on top of UEFI. This enables
	  just the uclass so you also need a specific driver to make this do
	  anything.

	  For sandbox there is a test driver.

if EFI_MEDIA

config EFI_MEDIA_SANDBOX
	bool "Sandbox EFI media driver"
	depends on SANDBOX
	default y
	help
	  Enables a simple sandbox media driver, used for testing just the
	  EFI_MEDIA uclass. It does not do anything useful, since sandbox does
	  not actually support running on top of UEFI.

config EFI_MEDIA_BLK
	bool "EFI media block driver"
	depends on EFI_APP
	default y
	help
	  Enables a block driver for providing access to UEFI devices. This
	  allows use of block devices detected by the underlying UEFI
	  implementation. With this it is possible to use filesystems on these
	  devices, for example.

endif  # EFI_MEDIA

config IDE
	bool "Support IDE controllers"
	select HAVE_BLOCK_DEVICE
	help
	  Enables support for IDE (Integrated Drive Electronics) hard drives.
	  This allows access to raw blocks and filesystems on an IDE drive
	  from U-Boot. See also CMD_IDE which provides an 'ide' command for
	  performing various IDE operations.
```

## drivers/board/Kconfig
```kconfig
menuconfig BOARD
	bool "Device Information"
	help
	  Support methods to query hardware configurations from internal
	  mechanisms (e.g. reading GPIO values, determining the presence of
	  devices on busses, etc.). This enables the usage of U-Boot with
	  modular board architectures.

if BOARD


config BOARD_GAZERBEAM
	bool "Enable device information for the Gazerbeam board"
	help
	  Support querying device information for the gdsys Gazerbeam board.

endif
```

## drivers/bootcount/Kconfig
```kconfig
#
# Boot count configuration
#

menuconfig BOOTCOUNT_LIMIT
	bool "Enable support for checking boot count limit"
	help
	  Enable checking for exceeding the boot count limit.
	  More information: http://www.denx.de/wiki/DULG/UBootBootCountLimit

if BOOTCOUNT_LIMIT

choice
	prompt "Boot count device"
	default BOOTCOUNT_AM33XX if AM33XX || SOC_DA8XX

config BOOTCOUNT_EXT
	bool "Boot counter on EXT filesystem"
	help
	  Add support for maintaining boot count in a file on an EXT
	  filesystem.

config BOOTCOUNT_AM33XX
	bool "Boot counter in AM33XX RTC IP block"
	depends on AM33XX || SOC_DA8XX
	help
	  A bootcount driver for the RTC IP block found on many TI platforms.
	  This requires the RTC clocks, etc, to be enabled prior to use and
	  not all boards with this IP block on it will have the RTC in use.

config BOOTCOUNT_ENV
	bool "Boot counter in environment"
	help
	  If no softreset save registers are found on the hardware
	  "bootcount" is stored in the environment. To prevent a
	  saveenv on all reboots, the environment variable
	  "upgrade_available" is used. If "upgrade_available" is
	  0, "bootcount" is always 0, if "upgrade_available" is
	  1 "bootcount" is incremented in the environment.
	  So the Userspace Application must set the "upgrade_available"
	  and "bootcount" variable to 0, if a boot was successfully.

config BOOTCOUNT_RAM
	bool "Boot counter in RAM"
	help
	  Store the bootcount in DRAM protected against against bit errors
	  due to short power loss or holding a system in RESET.

config BOOTCOUNT_I2C
	bool "Boot counter on I2C device"
	help
	  Enable support for the bootcounter on an i2c (like RTC) device.
	  CONFIG_SYS_I2C_RTC_ADDR = i2c chip address
	  CONFIG_SYS_BOOTCOUNT_ADDR = i2c addr which is used for
	                              the bootcounter.
	  CONFIG_BOOTCOUNT_ALEN = address len

endchoice

config SYS_BOOTCOUNT_SINGLEWORD
	bool "Use single word to pack boot count and magic value"
	help
	  This option enables packing boot count magic value and boot count
	  into single word (32 bits).

config SYS_BOOTCOUNT_EXT_INTERFACE
	string "Interface on which to find boot counter EXT filesystem"
	default "mmc"
	depends on BOOTCOUNT_EXT
	help
	  Set the interface to use when locating the filesystem to use for the
	  boot counter.

config SYS_BOOTCOUNT_EXT_DEVPART
	string "Partition of the boot counter EXT filesystem"
	default "0:1"
	depends on BOOTCOUNT_EXT
	help
	  Set the partition to use when locating the filesystem to use for the
	  boot counter.

config SYS_BOOTCOUNT_EXT_NAME
	string "Path and filename of the EXT filesystem based boot counter"
	default "/boot/failures"
	depends on BOOTCOUNT_EXT
	help
	  Set the filename and path of the file used to store the boot counter.

config SYS_BOOTCOUNT_ADDR
	hex "RAM address used for reading and writing the boot counter"
	default 0x7000A000
	depends on BOOTCOUNT_EXT
	help
	  Set the address used for reading and writing the boot counter.

endif
```

## drivers/bus/Kconfig
```kconfig
# SPDX-License-Identifier: GPL-2.0
#
# Bus Devices
#

menu "Bus devices"

config UNIPHIER_SYSTEM_BUS
	bool "UniPhier System Bus driver"
	depends on ARCH_UNIPHIER
	default y
	help
	  Support for UniPhier System Bus, a simple external bus.  This is
	  needed to use on-board devices connected to UniPhier SoCs.

endmenu
```

## drivers/button/Kconfig
```kconfig
menu "Button Support"

config BUTTON
	bool "Enable button support"
	depends on DM
	help
	  Many boards have buttons which can be used to change behaviour (reset, ...).
	  U-Boot provides a uclass API to implement this feature. Button drivers
	  can provide access to board-specific buttons. Use of the device tree
	  for configuration is encouraged.

config BUTTON_ADC
	bool "Button adc"
	depends on BUTTON
	help
	  Enable support for buttons which are connected to Analog to Digital
	  Converter device. The ADC driver must use driver model. Buttons are
	  configured using the device tree.

config BUTTON_GPIO
	bool "Button gpio"
	depends on BUTTON
	help
	  Enable support for buttons which are connected to GPIO lines. These
	  GPIOs may be on the SoC or some other device which provides GPIOs.
	  The GPIO driver must used driver model. Buttons are configured using
	  the device tree.

endmenu
```

## drivers/cache/Kconfig
```kconfig
#
# Cache controllers
#

menu "Cache Controller drivers"

config CACHE
	bool "Enable Driver Model for Cache controllers"
	depends on DM
	help
	  Enable driver model for cache controllers that are found on
	  most CPU's. Cache is memory that the CPU can access directly and
	  is usually located on the same chip. This uclass can be used for
	  configuring settings that be found from a device tree file.

config L2X0_CACHE
	tristate "PL310 cache driver"
	select CACHE
	depends on ARM
	help
	  This driver is for the PL310 cache controller commonly found on
	  ARMv7(32-bit) devices. The driver configures the cache settings
	  found in the device tree.

config V5L2_CACHE
	bool "Andes V5L2 cache driver"
	select CACHE
	depends on RISCV_NDS_CACHE
	help
	  Support Andes V5L2 cache controller in AE350 platform.
	  It will configure tag and data ram timing control from the
	  device tree and enable L2 cache.

config NCORE_CACHE
	bool "Arteris Ncore cache coherent unit driver"
	select CACHE
	help
	  This driver is for the Arteris Ncore cache coherent unit (CCU)
	  controller. The driver initializes cache directories and coherent
	  agent interfaces.

config SIFIVE_CCACHE
	bool "SiFive composable cache"
	select CACHE
	help
	  This driver is for SiFive Composable L2/L3 cache. It enables cache
	  ways of composable cache.

endmenu
```
