## drivers/clk/qcom/Kconfig
```kconfig
if ARCH_SNAPDRAGON || ARCH_IPQ40XX

config CLK_QCOM
	bool
	depends on CLK && DM_RESET && POWER_DOMAIN
	def_bool n

menu "Qualcomm clock drivers"

config CLK_QCOM_APQ8016
	bool "Qualcomm APQ8016 GCC"
	select CLK_QCOM
	help
	  Say Y here to enable support for the Global Clock Controller
	  on the Snapdragon APQ8016 SoC. This driver supports the clocks
	  and resets exposed by the GCC hardware block.

config CLK_QCOM_APQ8096
	bool "Qualcomm APQ8096 GCC"
	select CLK_QCOM
	help
	  Say Y here to enable support for the Global Clock Controller
	  on the Snapdragon APQ8096 SoC. This driver supports the clocks
	  and resets exposed by the GCC hardware block.

config CLK_QCOM_IPQ4019
	bool "Qualcomm IPQ4019 GCC"
	select CLK_QCOM
	help
	  Say Y here to enable support for the Global Clock Controller
	  on the Snapdragon IPQ4019 SoC. This driver supports the clocks
	  and resets exposed by the GCC hardware block.

config CLK_QCOM_IPQ5424
	bool "Qualcomm IPQ5424 GCC"
	select CLK_QCOM
	help
	  Say Y here to enable support for the Global Clock Controller
	  on the Qualcomm IPQ5424 SoC. This driver supports the clocks
	  and resets exposed by the GCC hardware block.

config CLK_QCOM_IPQ9574
	bool "Qualcomm IPQ9574 GCC"
	select CLK_QCOM
	help
	  Say Y here to enable support for the Global Clock Controller
	  on the Snapdragon IPQ9574 SoC. This driver supports the clocks
	  and resets exposed by the GCC hardware block.

config CLK_QCOM_QCM2290
	bool "Qualcomm QCM2290 GCC"
	select CLK_QCOM
	help
	  Say Y here to enable support for the Global Clock Controller
	  on the Snapdragon QCM2290 SoC. This driver supports the clocks
	  and resets exposed by the GCC hardware block.

config CLK_QCOM_QCS404
	bool "Qualcomm QCS404 GCC"
	select CLK_QCOM
	help
	  Say Y here to enable support for the Global Clock Controller
	  on the Snapdragon QCS404 SoC. This driver supports the clocks
	  and resets exposed by the GCC hardware block.

config CLK_QCOM_QCS615
	bool "Qualcomm QCS615 GCC"
	select CLK_QCOM
	help
	  Say Y here to enable support for the Global Clock Controller
	  on the Snapdragon QCS615 SoC. This driver supports the clocks
	  and resets exposed by the GCC hardware block.

config CLK_QCOM_QCS8300
	bool "Qualcomm QCS8300 GCC"
	select CLK_QCOM
	help
	  Say Y here to enable support for the Global Clock Controller
	  on the Snapdragon QCS8300 SoC. This driver supports the clocks
	  and resets exposed by the GCC hardware block.

config CLK_QCOM_SA8775P
	bool "Qualcomm SA8775 GCC"
	select CLK_QCOM
	help
	  Say Y here to enable support for the Global Clock Controller
	  on the Snapdragon SA8775 SoC. This driver supports the clocks
	  and resets exposed by the GCC hardware block.

config CLK_QCOM_SDM845
	bool "Qualcomm SDM845 GCC"
	select CLK_QCOM
	help
	  Say Y here to enable support for the Global Clock Controller
	  on the Snapdragon 845 SoC. This driver supports the clocks
	  and resets exposed by the GCC hardware block.

config CLK_QCOM_SM6115
	bool "Qualcomm SM6115 GCC"
	select CLK_QCOM
	help
	  Say Y here to enable support for the Global Clock Controller
	  on the Snapdragon SM6115 SoC. This driver supports the clocks
	  and resets exposed by the GCC hardware block.

config CLK_QCOM_SM8150
	bool "Qualcomm SM8150 GCC"
	select CLK_QCOM
	help
	  Say Y here to enable support for the Global Clock Controller
	  on the Snapdragon 8150 SoC. This driver supports the clocks
	  and resets exposed by the GCC hardware block.

config CLK_QCOM_SM8250
	bool "Qualcomm SM8250 GCC"
	select CLK_QCOM
	help
	  Say Y here to enable support for the Global Clock Controller
	  on the Snapdragon SM8250 SoC. This driver supports the clocks
	  and resets exposed by the GCC hardware block.

config CLK_QCOM_SM8550
	bool "Qualcomm SM8550 GCC"
	select CLK_QCOM
	help
	  Say Y here to enable support for the Global Clock Controller
	  on the Snapdragon SM8550 SoC. This driver supports the clocks
	  and resets exposed by the GCC hardware block.

config CLK_QCOM_SM8650
	bool "Qualcomm SM8650 GCC"
	select CLK_QCOM
	help
	  Say Y here to enable support for the Global Clock Controller
	  on the Snapdragon SM8650 SoC. This driver supports the clocks
	  and resets exposed by the GCC hardware block.

config CLK_QCOM_SC7280
	bool "Qualcomm SC7280 GCC"
	select CLK_QCOM
	help
	  Say Y here to enable support for the Global Clock Controller
	  on the Snapdragon SC7280 SoC. This driver supports the clocks
	  and resets exposed by the GCC hardware block.

config CLK_QCOM_X1E80100
	bool "Qualcomm X1E80100 GCC"
	select CLK_QCOM
	help
	  Say Y here to enable support for the Global Clock Controller
	  on the Snapdragon X1E80100 SoC. This driver supports the clocks
	  and resets exposed by the GCC hardware block.

endmenu

endif
```

## drivers/clk/renesas/Kconfig
```kconfig
config CLK_RENESAS
	bool "Renesas clock drivers"
	depends on CLK && ARCH_RMOBILE
	help
	  Enable support for clock present on Renesas RCar SoCs.

config CLK_RCAR_GEN2
	bool "Renesas RCar Gen2 clock driver"
	def_bool y if RCAR_32
	depends on CLK_RENESAS
	help
	  Enable this to support the clocks on Renesas RCar Gen2 SoC.

config CLK_R8A7790
	bool "Renesas R8A7790 clock driver"
	def_bool y if R8A7790
	depends on CLK_RCAR_GEN2
	help
	  Enable this to support the clocks on Renesas R8A7790 SoC.

config CLK_R8A7791
	bool "Renesas R8A7791 clock driver"
	def_bool y if R8A7791
	depends on CLK_RCAR_GEN2
	help
	  Enable this to support the clocks on Renesas R8A7791 SoC.

config CLK_R8A7792
	bool "Renesas R8A7792 clock driver"
	def_bool y if R8A7792
	depends on CLK_RCAR_GEN2
	help
	  Enable this to support the clocks on Renesas R8A7792 SoC.

config CLK_R8A7793
	bool "Renesas R8A7793 clock driver"
	def_bool y if R8A7793
	depends on CLK_RCAR_GEN2
	help
	  Enable this to support the clocks on Renesas R8A7793 SoC.

config CLK_R8A7794
	bool "Renesas R8A7794 clock driver"
	def_bool y if R8A7794
	depends on CLK_RCAR_GEN2
	help
	  Enable this to support the clocks on Renesas R8A7794 SoC.

config CLK_RCAR_GEN3
	bool "Renesas RCar Gen3 clock driver"
	def_bool y if RCAR_GEN3
	depends on CLK_RENESAS
	help
	  Enable this to support the clocks on Renesas RCar Gen3 SoC.

config CLK_R8A7795
	bool "Renesas R8A7795 clock driver"
	def_bool y if R8A7795
	depends on CLK_RCAR_GEN3
	help
	  Enable this to support the clocks on Renesas R8A7795 SoC.

config CLK_R8A7796
	bool "Renesas R8A7796 clock driver"
	def_bool y if R8A7796
	depends on CLK_RCAR_GEN3
	help
	  Enable this to support the clocks on Renesas R8A7796 SoC.

config CLK_R8A77970
	bool "Renesas R8A77970 clock driver"
	def_bool y if R8A77970
	depends on CLK_RCAR_GEN3
	help
	  Enable this to support the clocks on Renesas R8A77970 SoC.

config CLK_R8A77995
	bool "Renesas R8A77995 clock driver"
	def_bool y if R8A77995
	depends on CLK_RCAR_GEN3
	help
	  Enable this to support the clocks on Renesas R8A77995 SoC.
```

## drivers/clk/sophgo/Kconfig
```kconfig
# SPDX-License-Identifier: GPL-2.0+
#
# Copyright (c) 2024, Kongyang Liu <seashell11234455@gmail.com>

config CLK_SOPHGO
	bool

config CLK_SOPHGO_CV1800B
	bool "Sophgo CV1800B clock support"
	depends on CLK
	select CLK_CCF
	select CLK_SOPHGO
	help
	  This enables support clock driver for Sophgo CV1800B SoC.
```

## drivers/clk/spacemit/Kconfig
```kconfig
# SPDX-License-Identifier: GPL-2.0-or-later
#
# Copyright (c) 2025, Junhui Liu <junhui.liu@pigmoral.tech>

config CLK_SPACEMIT
	bool "Clock support for SpacemiT SoCs"
	depends on CLK
	select REGMAP
	help
	  This enables support clock driver for Spacemit SoC
	  family.

if CLK_SPACEMIT

config CLK_SPACEMIT_K1
	bool "SpacemiT K1 clock support"
	select CLK_CCF
	help
	  This enables support clock driver for Spacemit K1 SoC.
	  It's based on Common Clock Framework.

endif
```

## drivers/clk/stm32/Kconfig
```kconfig
config CLK_STM32F
	bool "Enable clock driver support for STM32F family"
	depends on CLK && (STM32F7 || STM32F4)
	default y
	help
	  This clock driver adds support for RCC clock management
	  for STM32F4 and STM32F7 SoCs.

config CLK_STM32H7
	bool "Enable clock driver support for STM32H7 family"
	depends on CLK && STM32H7
	default y
	help
	  This clock driver adds support for RCC clock management
	  for STM32H7 SoCs.

config CLK_STM32MP1
	bool "Enable RCC clock driver for STM32MP15"
	depends on ARCH_STM32MP && CLK
	default y if STM32MP15x
	help
	  Enable the STM32 clock (RCC) driver. Enable support for
	  manipulating STM32MP15's on-SoC clocks.
```

## drivers/clk/sunxi/Kconfig
```kconfig
config CLK_SUNXI
	bool "Clock support for Allwinner SoCs"
	depends on CLK && ARCH_SUNXI
	select DM_RESET
	default y
	help
	  This enables support for common clock driver API on Allwinner
	  SoCs.

if CLK_SUNXI

config CLK_SUN4I_A10
	bool "Clock driver for Allwinner A10/A20"
	default MACH_SUN4I || MACH_SUN7I
	help
	  This enables common clock driver support for platforms based
	  on Allwinner A10/A20 SoC.

config CLK_SUN5I_A10S
	bool "Clock driver for Allwinner A10s/A13"
	default MACH_SUN5I
	help
	  This enables common clock driver support for platforms based
	  on Allwinner A10s/A13 SoC.

config CLK_SUN8I_H3
	bool "Clock driver for Allwinner H3/H5"
	default MACH_SUNXI_H3_H5
	help
	  This enables common clock driver support for platforms based
	  on Allwinner H3/H5 SoC.

config CLK_SUN50I_A64
	bool "Clock driver for Allwinner A64"
	default MACH_SUN50I
	help
	  This enables common clock driver support for platforms based
	  on Allwinner A64 SoC.

endif # CLK_SUNXI
```

## drivers/clk/tegra/Kconfig
```kconfig
config TEGRA186_CLOCK
	bool "Enable Tegra186 BPMP-based clock driver"
	depends on TEGRA186_BPMP
	help
	  Enable support for manipulating Tegra's on-SoC clocks via IPC
	  requests to the BPMP (Boot and Power Management Processor).
```

## drivers/clk/thead/Kconfig
```kconfig
# SPDX-License-Identifier: GPL-2.0-or-later
#
# Copyright (c) 2025, Yao Zi <ziyao@disroot.org>

config CLK_THEAD
	bool "Clock support for T-Head SoCs"
	depends on CLK

if CLK_THEAD

config CLK_THEAD_TH1520_AP
	bool "T-Head TH1520 AP clock support"
	select CLK_CCF
	default THEAD_TH1520
	help
	  This enables support clock driver for T-Head TH1520 Application
	  processor.

endif
```

## drivers/clk/ti/Kconfig
```kconfig
# SPDX-License-Identifier: GPL-2.0+
#
# Copyright (C) 2020 Dario Binacchi <dariobin@libero.it>
#

config CLK_TI_AM3_DPLL
	bool "TI AM33XX Digital Phase-Locked Loop (DPLL) clock drivers"
	depends on CLK && OF_CONTROL
	help
	  This enables the DPLL clock drivers support on AM33XX SoCs. The DPLL
	  provides all interface clocks and functional clocks to the processor.

config CLK_TI_CTRL
	bool "TI OMAP4 clock controller"
	depends on CLK && OF_CONTROL
	help
	  This enables the clock controller driver support on TI's SoCs.

config CLK_TI_DIVIDER
	bool "TI divider clock driver"
	depends on CLK && OF_CONTROL && CLK_CCF
	help
	  This enables the divider clock driver support on TI's SoCs.

config CLK_TI_GATE
	bool "TI gate clock driver"
	depends on CLK && OF_CONTROL
	help
	  This enables the gate clock driver support on TI's SoCs.

config CLK_TI_MUX
	bool "TI mux clock driver"
	depends on CLK && OF_CONTROL && CLK_CCF
	help
	  This enables the mux clock driver support on TI's SoCs.

config CLK_TI_SCI
	bool "TI System Control Interface (TI SCI) clock driver"
	depends on CLK && TI_SCI_PROTOCOL && OF_CONTROL
	help
	  This enables the clock driver support over TI System Control Interface
	  available on some new TI's SoCs. If you wish to use clock resources
	  managed by the TI System Controller, say Y here. Otherwise, say N.
```

## drivers/clk/uniphier/Kconfig
```kconfig
config CLK_UNIPHIER
	bool "Clock driver for UniPhier SoCs"
	depends on ARCH_UNIPHIER
	select CLK
	select SPL_CLK
	default y
	help
	  Support for clock controllers on UniPhier SoCs.
	  Say Y if you want to control clocks provided by System Control
	  block, Media I/O block, Peripheral Block.
```
