## drivers/i3c/Kconfig
```kconfig
menuconfig I3C
	tristate "I3C support"
	select I2C
	help
	  I3C is a serial protocol standardized by the MIPI alliance.

	  It's supposed to be backward compatible with I2C while providing
	  support for high speed transfers and native interrupt support
	  without the need for extra pins.

	  The I3C protocol also standardizes the slave device types and is
	  mainly designed to communicate with sensors.

	  If you want I3C support, you should say Y here and also to the
	  specific driver for your bus adapter(s) below.

config I3C_SANDBOX
	bool "Enable support for the sandbox I3C"
	help
	  This is a sandbox I3C used for testing. It provides 2 interfaces and
	  records the settings passed into it.

if I3C

source "drivers/i3c/master/Kconfig"

endif # I3C
```

## drivers/i3c/master/Kconfig
```kconfig
config DW_I3C_MASTER
	tristate "Synopsys DesignWare I3C master driver"
	depends on I3C
	help
	  Support for Synopsys DesignWare MIPI I3C Controller.

	  For details please see
	  https://www.synopsys.com/dw/ipdir.php?ds=mipi_i3c

	  This driver can also be built as a module.  If so, the module
	  will be called dw-i3c-master.
```

## drivers/input/Kconfig
```kconfig
config DM_KEYBOARD
	bool "Enable driver model keyboard support"
	depends on DM
	help
	  This adds a uclass for keyboards and implements keyboard support
	  using driver model. The API is implemented by keyboard.h and
	  includes methods to start/stop the device, check for available
	  input and update LEDs if the keyboard has them.

config CROS_EC_KEYB
	bool "Enable Chrome OS EC keyboard support"
	help
	  Most ARM Chromebooks use an EC to provide access to the keyboard.
	  Messages are used to request key scans from the EC and these are
	  then decoded into keys by this driver.

config I8042_KEYB
	bool "Enable Intel i8042 keyboard support"
	depends on DM_KEYBOARD
	default X86
	help
	  This adds a driver for the i8042 keyboard controller, allowing the
	  keyboard to be used on devices which support this controller. The
	  driver handles English and German keyboards - set the environment
	  variable 'keymap' to "de" to select German. Keyboard repeat is
	  handled by the keyboard itself.
```

## drivers/interconnect/Kconfig
```kconfig
menu "Interconnect Support"

config INTERCONNECT
	bool "Enable interconnect support using Driver Model"
	depends on DM && OF_CONTROL
	help
	  Enable support for the interconnect driver class. Many SoCs allow
	  bandwidth to be tuned on busses within the SoC.

if INTERCONNECT

config INTERCONNECT_SANDBOX
	bool "Enable interconnect sandbox driver"
	depends on SANDBOX
	help
	  Enable support for the interconnect sandbox drivers.

source "drivers/interconnect/qcom/Kconfig"

endif

endmenu
```

## drivers/iommu/Kconfig
```kconfig
#
# IOMMU devices
#

menu "IOMMU device drivers"

config IOMMU
	bool "Enable Driver Model for IOMMU drivers"
	depends on DM
	help
	  Enable driver model for IOMMU devices. An IOMMU maps device
	  virtiual memory addresses to physical addresses. Devices
	  that sit behind an IOMMU can typically only access physical
	  memory if the IOMMU has been programmed to allow access to
	  that memory.

config APPLE_DART
	bool "Apple DART support"
	depends on IOMMU && ARCH_APPLE
	default y
	help
	  Enable support for the DART on Apple SoCs.  The DART is Apple's
	  IOMMU implementation.  The driver performs the necessary
	  configuration to put the DART into bypass mode such that it can
	  be used transparently by U-Boot.

endmenu
```

## drivers/led/Kconfig
```kconfig
menu "LED Support"

config LED
	bool "Enable LED support"
	depends on DM
	help
	  Many boards have LEDs which can be used to signal status or alerts.
	  U-Boot provides a uclass API to implement this feature. LED drivers
	  can provide access to board-specific LEDs. Use of the device tree
	  for configuration is encouraged.

config LED_BOOT
	bool "Enable LED boot support"
	depends on LED
	help
	  Enable LED boot support.

	  LED boot is a specific LED assigned to signal boot operation status.
	  Defined in Device Tree /options/u-boot node. Refer here for the supported
	  options [1].

	  [1] dtschema/schemas/options/u-boot.yaml

config LED_ACTIVITY
	bool "Enable LED activity support"
	depends on LED
	help
	  Enable LED activity support.

	  LED activity is a specific LED assigned to signal activity operation
	  like file trasnfer, flash write/erase...

	  Defined in Device Tree /options/u-boot node. Refer here for the supported
	  options [1].

	  [1] dtschema/schemas/options/u-boot.yaml

config LED_BCM6328
	bool "LED Support for BCM6328"
	depends on LED && ARCH_BMIPS
	help
	  This option enables support for LEDs connected to the BCM6328
	  LED HW controller accessed via MMIO registers.
	  HW blinking is supported and up to 24 LEDs can be controlled.
	  All LEDs can blink at the same time but the delay is shared, which
	  means that if one LED is set to blink at 100ms and then a different
	  LED is set to blink at 200ms, both will blink at 200ms.

config LED_BCM6358
	bool "LED Support for BCM6358"
	depends on LED && ARCH_BMIPS
	help
	  This option enables support for LEDs connected to the BCM6358
	  LED HW controller accessed via MMIO registers.
	  HW has no blinking capabilities and up to 32 LEDs can be controlled.

config LED_BCM6753
	bool "LED Support for BCM6753"
	depends on LED && BCM6855
	help
	  This option enables support for LEDs connected to the BCM6753
	  HW has blinking and fading capabilities and up to 32 LEDs can be controlled.

config LED_BCM6858
	bool "LED Support for BCM6858"
	depends on LED && (BCM6856 || BCM6858 || BCM63158)
	help
	  This option enables support for LEDs connected to the BCM6858
	  HW has blinking capabilities and up to 32 LEDs can be controlled.

config LED_CORTINA
	bool "LED Support for Cortina Access CAxxxx SoCs"
	depends on LED && (CORTINA_PLATFORM)
	help
	  This option enables support for LEDs connected to the Cortina
	  Access CAxxxx SOCs.

config LED_LP5562
	bool "LED Support for LP5562"
	depends on LED && DM_I2C
	help
	  This option enables support for LEDs connected to the TI LP5562
	  4 channel I2C LED controller.  Driver fully supports blink on the
	  B/G/R LEDs.  White LED can blink, but re-uses the period from blue.

config LED_PWM
	bool "LED PWM"
	depends on LED && DM_PWM
	help
	  Enable support for LEDs connected to PWM.
	  Linux compatible ofdata.

config LED_BLINK
	bool "Support hardware LED blinking"
	depends on LED
	help
	  Some drivers can support automatic blinking of LEDs with a given
	  period, without needing timers or extra code to handle the timing.
	  This option enables support for this which adds slightly to the
	  code size.

config LED_SW_BLINK
	bool "Support software LED blinking"
	depends on LED
	select CYCLIC
	help
	  Turns on led blinking implemented in the software, useful when
	  the hardware doesn't support led blinking. Half of the period
	  led will be ON and the rest time it will be OFF. Standard
	  led commands can be used to configure blinking. Does nothing
	  if driver supports hardware blinking.
	  WARNING: Blinking may be inaccurate during execution of time
	  consuming commands (ex. flash reading). Also it completely
	  stops during OS booting.

config SPL_LED
	bool "Enable LED support in SPL"
	depends on SPL_DM
	help
	  The LED subsystem adds a small amount of overhead to the image.
	  If this is acceptable and you have a need to use LEDs in SPL,
	  enable this option. You will need to enable device tree in SPL
	  for this to work.

config LED_GPIO
	bool "LED support for GPIO-connected LEDs"
	depends on LED && DM_GPIO
	help
	  Enable support for LEDs which are connected to GPIO lines. These
	  GPIOs may be on the SoC or some other device which provides GPIOs.
	  The GPIO driver must used driver model. LEDs are configured using
	  the device tree.

config SPL_LED_GPIO
	bool "LED support for GPIO-connected LEDs in SPL"
        depends on SPL_LED && SPL_DM_GPIO
	help
	  This option is an SPL-variant of the LED_GPIO option.
	  See the help of LED_GPIO for details.

endmenu
```

## drivers/mailbox/Kconfig
```kconfig
menu "Mailbox Controller Support"

config DM_MAILBOX
	bool "Enable mailbox controllers using Driver Model"
	depends on DM && OF_CONTROL
	help
	  Enable support for the mailbox driver class. Mailboxes provide the
	  ability to transfer small messages and/or notifications from one
	  CPU to another CPU, or sometimes to dedicated HW modules. They form
	  the basis of a variety of inter-process/inter-CPU communication
	  protocols.

config SANDBOX_MBOX
	bool "Enable the sandbox mailbox test driver"
	depends on DM_MAILBOX && SANDBOX
	help
	  Enable support for a test mailbox implementation, which simply echos
	  back a modified version of any message that is sent.

config TEGRA_HSP
	bool "Enable Tegra HSP controller support"
	depends on DM_MAILBOX && TEGRA
	help
	  This enables support for the NVIDIA Tegra HSP Hw module, which
	  implements doorbells, mailboxes, semaphores, and shared interrupts.

endmenu
```

## drivers/memory/Kconfig
```kconfig
#
# Memory devices
#

menu "Memory Controller drivers"

config MEMORY
	bool "Enable Driver Model for Memory Controller drivers"
	depends on DM
	help
	  Enable driver model for Memory Controller devices.
	  These devices provide Memory bus interface to various devices like
	  SRAM, Ethernet adapters, FPGAs, etc.
	  For now this uclass has no methods yet.

config ATMEL_EBI
	bool
	help
	  Driver for Atmel EBI controller. This is a dummy
	  driver. Doesn't provide an access to EBI controller. Select
	  this option to enable the NAND flash controller driver

config SANDBOX_MEMORY
	bool "Enable Sandbox Memory Controller driver"
	depends on SANDBOX && MEMORY
	help
	  This is a driver model based Memory Controller driver for sandbox.
	  Currently it is a stub only, as there are no usable uclass methods
	  yet.

config STM32_FMC2_EBI
	bool "Support for FMC2 External Bus Interface on STM32MP SoCs"
	depends on ARCH_STM32MP
	help
	  Select this option to enable the STM32 FMC2 External Bus Interface
	  controller. This driver configures the transactions with external
	  devices (like SRAM, ethernet adapters, FPGAs, LCD displays, ...) on
	  SOCs containing the FMC2 External Bus Interface.

config STM32_OMM
	bool "STM32 Octo Memory Manager"
	depends on ARCH_STM32MP
	help
	  This driver manages the muxing between the 2 OSPI busses and
	  the 2 output ports. There are 4 possible muxing configurations:
	  - direct mode (no multiplexing): OSPI1 output is on port 1 and OSPI2
	       output is on port 2
	  - OSPI1 and OSPI2 are multiplexed over the same output port 1
	  - swapped mode (no multiplexing), OSPI1 output is on port 2,
	       OSPI2 output is on port 1
	  - OSPI1 and OSPI2 are multiplexed over the same output port 2
	  It also manages :
	    - the split of the memory area shared between the 2 OSPI instances.
	    - chip select selection override.
	    - the time between 2 transactions in multiplexed mode.

config TI_AEMIF
	tristate "Texas Instruments AEMIF driver"
	depends on ARCH_KEYSTONE || ARCH_DAVINCI
	help
	  This driver is for the AEMIF module available in Texas Instruments
	  SoCs. AEMIF stands for Asynchronous External Memory Interface and
	  is intended to provide a glue-less interface to a variety of
	  asynchronuous memory devices like ASRAM, NOR and NAND memory. A total
	  of 256M bytes of any of these memories can be accessed at a given
	  time via four chip selects with 64M byte access per chip select.

config TI_GPMC
	bool "Texas Instruments GPMC driver"
	depends on ARCH_OMAP2PLUS || ARCH_KEYSTONE || ARCH_K3
	depends on MEMORY && CLK && OF_CONTROL
	help
	  This driver is for the General Purpose Memory Controller (GPMC)
          present on Texas Instruments SoCs (e.g. OMAP2+). GPMC allows
          interfacing to a variety of asynchronous as well as synchronous
          memory drives like NOR, NAND, OneNAND, SRAM.

if TI_GPMC
config TI_GPMC_DEBUG
	bool "Debug Texas Instruments GPMC timings"
	help
	  Enable this to print GPMC timings before and after the GPMC registers
	  are programmed. This should not be left enabled on production systems.
endif

endmenu
```
