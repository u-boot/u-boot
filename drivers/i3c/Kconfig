## drivers/net/airoha/Kconfig
```kconfig
# SPDX-License-Identifier: GPL-2.0-only

config PCS_AIROHA
	bool
	select MISC

config PCS_AIROHA_AN7581
	bool "Airoha AN7581 PCS driver"
	depends on ARCH_AIROHA
	select PCS_AIROHA
	help
	  This module provides helper to phylink for managing the Airoha
	  AN7581 PCS for SoC Ethernet and PON SERDES.
```

## drivers/net/bnxt/Kconfig
```kconfig
config BNXT_ETH
	bool "BNXT PCI support"
	depends on PCI
	help
	  This driver implements support for bnxt pci controller
	  driver of ethernet class.
```

## drivers/net/fsl-mc/Kconfig
```kconfig
#
# NXP Management Complex
#

menuconfig FSL_MC_ENET
	bool "NXP Management Complex"
	depends on ARCH_LS2080A || ARCH_LS1088A || ARCH_LX2160A
	default y
	select RESV_RAM
	help
	  Enable Management Complex (MC) network
	  This is NXP Management Complex menuconfig
	  that contains all MC related config options

if FSL_MC_ENET

config SYS_MC_RSV_MEM_ALIGN
	hex "Management Complex reserved memory alignment"
	depends on RESV_RAM
	default 0x20000000 if ARCH_LS2080A || ARCH_LS1088A || ARCH_LX2160A
	help
	  Reserved memory needs to be aligned for MC to use. Default value
	  is 512MB.

endif # FSL_MC_ENET
```

## drivers/net/mscc_eswitch/Kconfig
```kconfig
# SPDX-License-Identifier: GPL-2.0+
#
# Copyright (c) 2019 Microsemi Corporation

config MSCC_OCELOT_SWITCH
	bool "Ocelot switch driver"
	depends on DM_ETH && ARCH_MSCC
	select PHYLIB
	help
	  This driver supports the Ocelot network switch device.

config MSCC_LUTON_SWITCH
	bool "Luton switch driver"
	depends on DM_ETH && ARCH_MSCC
	select PHYLIB
	help
	  This driver supports the Luton network switch device.
```

## drivers/net/mtk_eth/Kconfig
```kconfig
config MEDIATEK_ETH
	bool "MediaTek Ethernet GMAC Driver"
	select PHYLIB
	select DM_GPIO
	select DM_RESET
	help
	  This Driver support MediaTek Ethernet GMAC
	  Say Y to enable support for the MediaTek Ethernet GMAC.

if MEDIATEK_ETH

config MTK_ETH_SGMII
	bool
	default y if ARCH_MEDIATEK && !TARGET_MT7623

config MTK_ETH_XGMII
	bool
	default y if TARGET_MT7987 || TARGET_MT7988

config MTK_ETH_SWITCH_MT7530
	bool "Support for MediaTek MT7530 ethernet switch"
	default y if TARGET_MT7623 || SOC_MT7621

config MTK_ETH_SWITCH_MT7531
	bool "Support for MediaTek MT7531 ethernet switch"
	default y if TARGET_MT7622 || TARGET_MT7629 || TARGET_MT7981 || \
		     TARGET_MT7986 || TARGET_MT7987

config MTK_ETH_SWITCH_MT7988
	bool "Support for MediaTek MT7988 built-in ethernet switch"
	depends on TARGET_MT7988
	default y

config MTK_ETH_SWITCH_AN8855
	bool "Support for Airoha AN8855 ethernet switch"
	default y if TARGET_MT7981 || TARGET_MT7987

endif # MEDIATEK_ETH
```

## drivers/net/phy/Kconfig
```kconfig
config BITBANGMII
	bool "Bit-banged ethernet MII management channel support"

config MV88E6352_SWITCH
	bool "Marvell 88E6352 switch support"

menuconfig PHYLIB
	bool "Ethernet PHY (physical media interface) support"
	depends on NET
	help
	  Enable Ethernet PHY (physical media interface) support.

if PHYLIB

config MV88E61XX_SWITCH
	bool "Marvel MV88E61xx Ethernet switch PHY support."

if MV88E61XX_SWITCH

config MV88E61XX_CPU_PORT
	int "CPU Port"

config MV88E61XX_PHY_PORTS
	hex "Bitmask of PHY Ports"

config MV88E61XX_FIXED_PORTS
	hex "Bitmask of PHYless serdes Ports"

endif # MV88E61XX_SWITCH

config PHYLIB_10G
	bool "Generic 10G PHY support"

config PHY_AQUANTIA
	bool "Aquantia Ethernet PHYs support"

config PHY_ATHEROS
	bool "Atheros Ethernet PHYs support"

config PHY_BROADCOM
	bool "Broadcom Ethernet PHYs support"

config PHY_CORTINA
	bool "Cortina Ethernet PHYs support"

config PHY_DAVICOM
	bool "Davicom Ethernet PHYs support"

config PHY_ET1011C
	bool "LSI TruePHY ET1011C support"

config PHY_LXT
	bool "LXT971 Ethernet PHY support"

config PHY_MARVELL
	bool "Marvell Ethernet PHYs support"

config PHY_MESON_GXL
	bool "Amlogic Meson GXL Internal PHY support"

config PHY_MICREL
	bool "Micrel Ethernet PHYs support"
	help
	  Enable support for the GbE PHYs manufactured by Micrel (now
	  a part of Microchip). This includes drivers for the KSZ804,
	  KSZ8031, KSZ8051, KSZ8081, KSZ8895, KSZ886x, KSZ8721
	  either/or KSZ9021 (see the "Micrel KSZ9021 family support"
	  config option for details), and KSZ9031 (if configured).

if PHY_MICREL

config PHY_MICREL_KSZ9021
	bool
	select PHY_GIGE
	select PHY_MICREL_KSZ90X1

config PHY_MICREL_KSZ9031
	bool
	select PHY_GIGE
	select PHY_MICREL_KSZ90X1

config PHY_MICREL_KSZ90X1
	bool "Micrel KSZ90x1 family support"
	select PHY_GIGE
	help
	  Enable support for the Micrel KSZ9021 and KSZ9031 GbE PHYs. If
	  enabled, the extended register read/write for KSZ90x1 PHYs
	  is supported through the 'mdio' command and any RGMII signal
	  delays configured in the device tree will be applied to the
	  PHY during initialization.

	  This should not be enabled at the same time with PHY_MICREL_KSZ8XXX
	  as the KSZ9021 and KS8721 share the same ID.

config PHY_MICREL_KSZ8XXX
	bool "Micrel KSZ8xxx family support"
	default y if !PHY_MICREL_KSZ90X1
	help
	  Enable support for the 8000 series GbE PHYs manufactured by Micrel
	  (now a part of Microchip). This includes drivers for the KSZ804,
	  KSZ8031, KSZ8051, KSZ8081, KSZ8895, KSZ886x, and KSZ8721.

	  This should not be enabled at the same time with PHY_MICREL_KSZ90X1
	  as the KSZ9021 and KS8721 share the same ID.

endif # PHY_MICREL

config PHY_MSCC
	bool "Microsemi Corp Ethernet PHYs support"

config PHY_NATSEMI
	bool "National Semiconductor Ethernet PHYs support"

config PHY_REALTEK
	bool "Realtek Ethernet PHYs support"

config RTL8211X_PHY_FORCE_MASTER
	bool "Ethernet PHY RTL8211x: force 1000BASE-T master mode"
	depends on PHY_REALTEK
	help
	  Force master mode for 1000BASE-T on RTl8211x PHYs (except for RTL8211F).
	  This can work around link stability and data corruption issues on gigabit
	  links which can occur in slave mode on certain PHYs, e.g. on the
	  RTL8211C(L).

	  Please note that two directly connected devices (i.e. via crossover cable)
	  will not be able to establish a link between each other if they both force
	  master mode. Multiple devices forcing master mode when connected by a
	  network switch do not pose a problem as the switch configures its affected
	  ports into slave mode.

	  This option only affects gigabit links. If you must establish a direct
	  connection between two devices which both force master mode, try forcing
	  the link speed to 100MBit/s.

	  If unsure, say N.

config PHY_SMSC
	bool  "Microchip(SMSC) Ethernet PHYs support"

config PHY_TERANETICS
	bool "Teranetics Ethernet PHYs support"

config PHY_TI
	bool "Texas Instruments Ethernet PHYs support"

config PHY_VITESSE
	bool "Vitesse Ethernet PHYs support"

config PHY_XILINX
	bool "Xilinx Ethernet PHYs support"

config PHY_FIXED
	bool "Fixed-Link PHY"
	depends on DM_ETH
	help
	  Fixed PHY is used for having a 'fixed-link' to another MAC with a direct
	  connection (MII, RGMII, ...).
	  There is nothing like autoneogation and so
	  on, the link is always up with fixed speed and fixed duplex-setting.
	  More information: doc/device-tree-bindings/net/fixed-link.txt

endif #PHYLIB
```

## drivers/net/phy/airoha/Kconfig
```kconfig
# SPDX-License-Identifier: GPL-2.0-only
menuconfig PHY_AIROHA
	bool "Airoha Ethernet PHYs support"

config PHY_AIROHA_EN8811
	bool "Airoha Ethernet EN8811H support"
	depends on PHY_AIROHA
	select FW_LOADER
	help
	  AIROHA EN8811H supported.
```

## drivers/net/phy/mediatek/Kconfig
```kconfig
# SPDX-License-Identifier: GPL-2.0-only

config MTK_NET_PHYLIB
	bool

config PHY_MEDIATEK_2P5GE
	bool "MediaTek built-in 2.5Gb ethernet PHYs"
	depends on OF_CONTROL && (TARGET_MT7987 || TARGET_MT7988)
	select FW_LOADER
	select MTK_NET_PHYLIB
	help
	  Supports MediaTek SoC built-in 2.5Gb ethernet PHYs.

	  This driver requires firmware download for PHY to enable its
	  functionality. The board can override certian firmware downloading
	  function to provide the firmware data.
```

## drivers/net/qe/Kconfig
```kconfig
# SPDX-License-Identifier: GPL-2.0+
#
# Copyright (C) 2020 Heiko Schocher <hs@denx.de>

config QE_UEC
	bool "NXP QE UEC Ethernet controller"
	depends on DM_ETH
	help
	  This driver supports the NXP QE UEC ethernet controller
```

## drivers/nvme/Kconfig
```kconfig
# SPDX-License-Identifier: GPL-2.0+
#
# Copyright (C) 2017, Bin Meng <bmeng.cn@gmail.com>

config NVME
	bool "NVM Express device support"
	depends on BLK
	select HAVE_BLOCK_DEVICE
	help
	  This option enables support for NVM Express devices.
	  It supports basic functions of NVMe (read/write).

config NVME_PCI
	bool "NVM Express PCI device support"
	depends on PCI
	select NVME
	help
	  This option enables support for NVM Express PCI
	  devices.
```
