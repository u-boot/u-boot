## drivers/pci/Kconfig
```kconfig
menuconfig PCI
	bool "PCI support"
	default y if PPC
	help
	  Enable support for PCI (Peripheral Interconnect Bus), a type of bus
	  used on some devices to allow the CPU to communicate with its
	  peripherals.

if PCI

config DM_PCI
	bool "Enable driver model for PCI"
	depends on DM
	help
	  Use driver model for PCI. Driver model is the new method for
	  orgnising devices in U-Boot. For PCI, driver model keeps track of
	  available PCI devices, allows scanning of PCI buses and provides
	  device configuration support.

config DM_PCI_COMPAT
	bool "Enable compatible functions for PCI"
	depends on DM_PCI
	help
	  Enable compatibility functions for PCI so that old code can be used
	  with CONFIG_DM_PCI enabled. This should be used as an interim
	  measure when porting a board to use driver model for PCI. Once the
	  board is fully supported, this option should be disabled.

config PCI_AARDVARK
	bool "Enable Aardvark PCIe driver"
	default n
	depends on DM_PCI
	depends on ARMADA_3700
	help
	  Say Y here if you want to enable PCIe controller support on
	  Armada37x0 SoCs. The PCIe controller on Armada37x0 is based on
	  Aardvark hardware.

config PCI_PNP
	bool "Enable Plug & Play support for PCI"
	depends on PCI || DM_PCI
	default y
	help
	  Enable PCI memory and I/O space resource allocation and assignment.

config PCIE_ECAM_GENERIC
	bool "Generic ECAM-based PCI host controller support"
	default n
	depends on DM_PCI
	help
	  Say Y here if you want to enable support for generic ECAM-based
	  PCIe host controllers, such as the one emulated by QEMU.

config PCI_PHYTIUM
	bool "Phytium PCIe support"
	depends on DM_PCI
	help
	  Say Y here if you want to enable PCIe controller support on
	  Phytium SoCs.

config PCIE_DW_MVEBU
	bool "Enable Armada-8K PCIe driver (DesignWare core)"
	depends on DM_PCI
	depends on ARMADA_8K
	help
	  Say Y here if you want to enable PCIe controller support on
	  Armada-8K SoCs. The PCIe controller on Armada-8K is based on
	  DesignWare hardware.

config PCIE_FSL
	bool "FSL PowerPC PCIe support"
	depends on DM_PCI
	help
	  Say Y here if you want to enable PCIe controller support on FSL
	  PowerPC MPC85xx, MPC86xx, B series, P series and T series SoCs.
	  This driver does not support SRIO_PCIE_BOOT feature.

config PCI_MPC85XX
	bool "MPC85XX PowerPC PCI support"
	depends on DM_PCI
	help
	  Say Y here if you want to enable PCI controller support on FSL
	  PowerPC MPC85xx SoC.

config PCI_RCAR_GEN2
	bool "Renesas RCar Gen2 PCIe driver"
	depends on DM_PCI
	depends on RCAR_32
	help
	  Say Y here if you want to enable PCIe controller support on
	  Renesas RCar Gen2 SoCs. The PCIe controller on RCar Gen2 is
	  also used to access EHCI USB controller on the SoC.

config PCI_RCAR_GEN3
	bool "Renesas RCar Gen3 PCIe driver"
	depends on DM_PCI
	depends on RCAR_GEN3
	help
	  Say Y here if you want to enable PCIe controller support on
	  Renesas RCar Gen3 SoCs.

config PCI_SANDBOX
	bool "Sandbox PCI support"
	depends on SANDBOX && DM_PCI
	help
	  Support PCI on sandbox, as an emulated bus. This permits testing of
	  PCI feature such as bus scanning, device configuration and device
	  access. The available (emulated) devices are defined statically in
	  the device tree but the normal PCI scan technique is used to find
	  then.

config PCI_TEGRA
	bool "Tegra PCI support"
	depends on ARCH_TEGRA
	depends on (TEGRA186 && POWER_DOMAIN) || (!TEGRA186)
	help
	  Enable support for the PCIe controller found on some generations of
	  Tegra. Tegra20 has 2 root ports with a total of 4 lanes, Tegra30 has
	  3 root ports with a total of 6 lanes and Tegra124 has 2 root ports
	  with a total of 5 lanes. Some boards require this for Ethernet
	  support to work (e.g. beaver, jetson-tk1).

config PCI_XILINX
	bool "Xilinx AXI Bridge for PCI Express"
	depends on DM_PCI
	help
	  Enable support for the Xilinx AXI bridge for PCI express, an IP block
	  which can be used on some generations of Xilinx FPGAs.

config PCIE_LAYERSCAPE
	bool "Layerscape PCIe support"
	depends on DM_PCI
	help
	  Support Layerscape PCIe. The Layerscape SoC may have one or several
	  PCIe controllers. The PCIe may works in RC or EP mode according to
	  RCW[HOST_AGT_PEX] setting.

config PCIE_LAYERSCAPE_GEN4
	bool "Layerscape Gen4 PCIe support"
	depends on DM_PCI
	help
	  Support PCIe Gen4 on NXP Layerscape SoCs, which may have one or
	  several PCIe controllers. The PCIe controller can work in RC or
	  EP mode according to RCW[HOST_AGT_PEX] setting.

config FSL_PCIE_COMPAT
	string "PCIe compatible of Kernel DT"
	depends on PCIE_LAYERSCAPE || PCIE_LAYERSCAPE_GEN4
	default "fsl,ls1012a-pcie" if ARCH_LS1012A
	default "fsl,ls1028a-pcie" if ARCH_LS1028A
	default "fsl,ls1043a-pcie" if ARCH_LS1043A
	default "fsl,ls1046a-pcie" if ARCH_LS1046A
	default "fsl,ls2080a-pcie" if ARCH_LS2080A
	default "fsl,ls1088a-pcie" if ARCH_LS1088A
	default "fsl,lx2160a-pcie" if ARCH_LX2160A
	default "fsl,ls1021a-pcie" if ARCH_LS1021A
	help
	  This compatible is used to find pci controller node in Kernel DT
	  to complete fixup.

config FSL_PCIE_EP_COMPAT
	string "PCIe EP compatible of Kernel DT"
	depends on PCIE_LAYERSCAPE || PCIE_LAYERSCAPE_GEN4
	default "fsl,lx2160a-pcie-ep" if ARCH_LX2160A
	default "fsl,ls-pcie-ep"
	help
	  This compatible is used to find pci controller ep node in Kernel DT
	  to complete fixup.

config PCIE_INTEL_FPGA
	bool "Intel FPGA PCIe support"
	depends on DM_PCI
	help
	  Say Y here if you want to enable PCIe controller support on Intel
	  FPGA, example Stratix 10.

config PCI_MVEBU
	bool "Enable Armada XP/38x PCIe driver"
	depends on ARCH_MVEBU
	select DM_PCI
	select MISC
	help
	  Say Y here if you want to enable PCIe controller support on
	  Armada XP/38x SoCs.

config PCI_KEYSTONE
	bool "TI Keystone PCIe controller"
	depends on DM_PCI
	help
	  Say Y here if you want to enable PCI controller support on AM654 SoC.

config PCIE_MEDIATEK
	bool "MediaTek PCIe Gen2 controller"
	depends on DM_PCI
	depends on ARCH_MEDIATEK
	help
	  Say Y here if you want to enable Gen2 PCIe controller,
	  which could be found on MT7623 SoC family.

config PCIE_ROCKCHIP
	bool "Enable Rockchip PCIe driver"
	select DM_PCI
	default y if ROCKCHIP_RK3399
	help
	  Say Y here if you want to enable PCIe controller support on
	  Rockchip SoCs.

endif
```

## drivers/pci_endpoint/Kconfig
```kconfig
# SPDX-License-Identifier: GPL-2.0
#
# PCI Endpoint Support
#

menu "PCI Endpoint"

config PCI_ENDPOINT
	bool "PCI Endpoint Support"
	depends on DM
	help
	   Enable this configuration option to support configurable PCI
	   endpoints. This should be enabled if the platform has a PCI
	   controllers that can operate in endpoint mode (as a device
	   connected to PCI host or bridge).

config PCIE_CADENCE_EP
	bool "Cadence PCIe endpoint controller"
	depends on PCI_ENDPOINT
	help
	  Say Y here if you want to support the Cadence PCIe controller in
	  endpoint mode. This PCIe controller may be embedded into many
	  different vendors SoCs.

config PCIE_CDNS_TI_EP
	bool "TI K3 PCIe EP support"
	help
	  Say Y here to enable support for the Canence PCIe Controller
	  in Endpoint Mode on TI's K3 Socs.

config PCI_SANDBOX_EP
	bool "Sandbox PCIe endpoint controller"
	depends on PCI_ENDPOINT
	help
	  Say Y here if you want to support the Sandbox PCIe controller in
	  endpoint mode.
	  The sandbox driver act as a dummy driver which stores and
	  retrieves PCIe endpoint configuration as is.

endmenu
```

## drivers/phy/Kconfig
```kconfig
menu "PHY Subsystem"

config PHY
	bool "PHY Core"
	depends on DM
	help
	  PHY support.

	  This framework is designed to provide a generic interface for PHY
	  devices. PHY devices are dedicated hardware that handle the physical
	  layer of the protocols in the OSI model.
	  PHYs are commonly used for high speed interfaces such as Serial-ATA
	  or PCI express.
	  The API provides functions to initialize/deinitialize the
	  PHY, power on/off the PHY, and reset the PHY. It's meant to be as
	  compatible as possible with the equivalent framework found in the
	  linux kernel.

config SPL_PHY
	bool "PHY Core in SPL"
	depends on DM
	help
	  PHY support in SPL.

	  This framework is designed to provide a generic interface for PHY
	  devices. PHY devices are dedicated hardware that handle the physical
	  layer of the protocols (https://en.wikipedia.org/wiki/OSI_model).
	  PHYs are commonly used for high speed interfaces such as Serial-ATA
	  or PCI express.
	  The API provides functions to initialize/deinitialize the
	  PHY, power on/off the PHY, and reset the PHY. It's meant to be as
	  compatible as possible with the equivalent framework found in the
	  linux kernel.

config PHY_SANDBOX
	bool "Sandbox PHY support"
	depends on SANDBOX
	depends on PHY
	help
	  This select a dummy sandbox PHY driver. It used only to implement
	  the unit tests for the phy framework

config NOP_PHY
	bool "NOP PHY driver"
	depends on PHY
	help
	  Support for a no-op PHY driver (stubbed PHY driver).

	  This is useful when a driver uses the PHY framework but no real PHY
	  hardware exists.

config SPL_NOP_PHY
	bool "NOP PHY driver in SPL"
	depends on SPL_PHY
	help
	  Support for a no-op PHY driver (stubbed PHY driver) in the SPL.

	  This is useful when a driver uses the PHY framework but no real PHY
	  hardware exists.

config PIPE3_PHY
	bool "Support omap's PIPE3 PHY"
	depends on PHY && ARCH_OMAP2PLUS
	help
	  Support for the omap PIPE3 phy for sata

	  This PHY is found on omap devices supporting SATA such as dra7, am57x
	  and omap5

config SPL_PIPE3_PHY
	bool "Support omap's PIPE3 PHY in SPL"
	depends on SPL_PHY && ARCH_OMAP2PLUS
	help
	  Support for the omap PIPE3 phy for sata in SPL

	  This PHY is found on omap devices supporting SATA such as dra7, am57x
	  and omap5

config STI_USB_PHY
	bool "STMicroelectronics USB2 picoPHY driver for STiH407 family"
	depends on PHY && ARCH_STI
	help
	  This is the generic phy driver for the picoPHY ports
	  used by USB2 and USB3 Host controllers available on
	  STiH407 SoC families.

endmenu
```

## drivers/phy/allwinner/Kconfig
```kconfig
#
# Phy drivers for Allwinner platforms
#
config PHY_SUN4I_USB
	bool "Allwinner Sun4I USB PHY driver"
	depends on ARCH_SUNXI
	select PHY
	help
	  Enable this to support the transceiver that is part of Allwinner
	  sunxi SoCs.

	  This driver controls the entire USB PHY block, both the USB OTG
	  parts, as well as the 2 regular USB 2 host PHYs.

config PHY_SUN50I_USB3
	bool "Allwinner sun50i USB3 PHY driver"
	depends on ARCH_SUNXI
	select PHY
	help
	  Enable this to support the USB3 transceiver that is part of
	  Allwinner sun50i SoCs.
```

## drivers/phy/marvell/Kconfig
```kconfig
config MVEBU_COMPHY_SUPPORT
	bool "ComPhy SerDes driver"
	depends on ARMADA_3700 || ARMADA_8K
	help
	  Choose this option to add support
	  for Comphy driver.
	  This driver passes over the lanes
	  and initialize the lane depends on the
	  type and speed.
```

## drivers/phy/qcom/Kconfig
```kconfig
config MSM8916_USB_PHY
	bool "Qualcomm MSM8916 USB PHY support"
	depends on PHY
	help
          Support the USB PHY in msm8916

	  This PHY is found on qualcomm dragonboard410c development board.

config PHY_QCOM_IPQ4019_USB
	tristate "Qualcomm IPQ4019 USB PHY driver"
	depends on PHY && ARCH_IPQ40XX
	help
	  Support for the USB PHY-s on Qualcomm IPQ40xx SoC-s.

config PHY_QCOM_QMP_PCIE
	tristate "Qualcomm QMP PCIe PHY driver"
	depends on PHY && ARCH_SNAPDRAGON
	help
	  Enable this to support the PCIe QMP PHY on various Qualcomm chipsets.

config PHY_QCOM_QMP_UFS
	tristate "Qualcomm QMP UFS PHY driver"
	depends on PHY && ARCH_SNAPDRAGON
	help
	  Enable this to support the UFS QMP PHY on various Qualcomm chipsets.

config PHY_QCOM_QUSB2
	tristate "Qualcomm USB QUSB2 PHY driver"
	depends on PHY && ARCH_SNAPDRAGON
	help
	  Enable this to support the Super-Speed USB transceiver on various
	  Qualcomm chipsets.

config PHY_QCOM_USB_SNPS_FEMTO_V2
	tristate "Qualcomm SNPS FEMTO USB HS PHY v2"
	depends on PHY && ARCH_SNAPDRAGON
	help
	  Enable this to support the Qualcomm Synopsys DesignWare Core 7nm
	  High-Speed PHY driver. This driver supports the Hi-Speed PHY which
	  is usually paired with Synopsys DWC3 USB IPs on MSM SOCs.

config PHY_QCOM_SNPS_EUSB2
	tristate "Qualcomm Synopsys eUSB2 High-Speed PHY"
	depends on PHY && ARCH_SNAPDRAGON
	help
	  Enable this to support the Qualcomm Synopsys DesignWare eUSB2
	  High-Speed PHY driver. This driver supports the Hi-Speed PHY which
	  is usually paired with Synopsys DWC3 USB IPs on MSM SOCs.

config PHY_QCOM_USB_HS_28NM
	tristate "Qualcomm 28nm High-Speed PHY"
	depends on PHY && ARCH_SNAPDRAGON
	help
	  Enable this to support the Qualcomm Synopsys DesignWare Core 28nm
	  High-Speed PHY driver. This driver supports the Hi-Speed PHY which
	  is usually paired with either the ChipIdea or Synopsys DWC3 USB
	  IPs on MSM SOCs.

config PHY_QCOM_USB_SS
	tristate "Qualcomm USB Super-Speed PHY driver"
	depends on PHY && ARCH_SNAPDRAGON
	help
	  Enable this to support the Super-Speed USB transceiver on various
	  Qualcomm chipsets.
```

## drivers/phy/renesas/Kconfig
```kconfig
# SPDX-License-Identifier: GPL-2.0
#
# Phy drivers for Renesas platforms

config PHY_R8A779F0_ETHERNET_SERDES
	bool "Renesas R-Car S4-8 Ethernet SERDES driver"
	depends on RCAR_64 && PHY
	help
	  Support for Ethernet SERDES found on Renesas R-Car S4-8 SoCs.

config PHY_R8A78000_ETHERNET_PCS
	bool "Renesas R-Car X5H Ethernet PCS driver"
	depends on RCAR_64 && PHY
	help
	  Support for Ethernet PCS found on Renesas R-Car X5H SoCs.

config PHY_R8A78000_MP_PHY
	bool "Renesas R-Car X5H Multi-Protocol PHY driver"
	depends on RCAR_64 && PHY
	help
	  Support for Multi-Protocol PHY on Renesas R-Car X5H SoCs.
```

## drivers/phy/rockchip/Kconfig
```kconfig
#
# Phy drivers for Rockchip platforms
#

menu "Rockchip PHY driver"

config PHY_ROCKCHIP_INNO_USB2
	bool "Rockchip INNO USB2PHY Driver"
	depends on ARCH_ROCKCHIP
	select PHY
	help
	  Support for Rockchip USB2.0 PHY with Innosilicon IP block.

config PHY_ROCKCHIP_PCIE
	bool "Rockchip PCIe PHY Driver"
	depends on ARCH_ROCKCHIP
	select PHY
	help
	  Enable this to support the Rockchip PCIe PHY.

config PHY_ROCKCHIP_TYPEC
	bool "Rockchip TYPEC PHY Driver"
	depends on ARCH_ROCKCHIP
	select PHY
	help
	  Enable this to support the Rockchip USB TYPEC PHY.

endmenu
```

## drivers/phy/starfive/Kconfig
```kconfig
#
# PHY drivers for Starfive platforms
#

menu "Starfive PHY driver"

config PHY_STARFIVE_JH7110_PCIE
	bool "Starfive JH7110 PCIe 2.0 PHY driver"
	depends on PHY
	help
	  Enable this to support the Starfive JH7110 PCIE 2.0/USB 3.0 PHY.
	  Generic PHY driver JH7110 USB 3.0/ PCIe 2.0.

config PHY_STARFIVE_JH7110_USB2
	bool "Starfive JH7110 USB 2.0 PHY driver"
	depends on PHY
	help
	  Enable this to support the Starfive JH7110 USB 2.0 PHY.
	  Generic PHY driver JH7110 USB 2.0.

endmenu
```
