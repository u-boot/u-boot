## drivers/pinctrl/renesas/Kconfig
```kconfig
if ARCH_RMOBILE

config PINCTRL_PFC
	bool "Renesas pin control drivers"
	depends on DM && ARCH_RMOBILE
	default n if CPU_RZA1
	help
	  Support pin multiplexing control on Renesas SoCs.

	  These drivers are controlled by a device tree node which contains
	  both the GPIO definitions and pin control functions for each
	  available multiplex function.

config PINCTRL_PFC_R8A7790
	bool "Renesas RCar Gen2 R8A7790 pin control driver"
	depends on PINCTRL_PFC
	help
	  Support pin multiplexing control on Renesas RCar Gen2 R8A7790 SoCs.

config PINCTRL_PFC_R8A7791
	bool "Renesas RCar Gen2 R8A7791 pin control driver"
	depends on PINCTRL_PFC
	help
	  Support pin multiplexing control on Renesas RCar Gen2 R8A7791 SoCs.

config PINCTRL_PFC_R8A7792
	bool "Renesas RCar Gen2 R8A7792 pin control driver"
	depends on PINCTRL_PFC
	help
	  Support pin multiplexing control on Renesas RCar Gen2 R8A7792 SoCs.

config PINCTRL_PFC_R8A7793
	bool "Renesas RCar Gen2 R8A7793 pin control driver"
	depends on PINCTRL_PFC
	help
	  Support pin multiplexing control on Renesas RCar Gen2 R8A7793 SoCs.

config PINCTRL_PFC_R8A7794
	bool "Renesas RCar Gen2 R8A7794 pin control driver"
	depends on PINCTRL_PFC
	help
	  Support pin multiplexing control on Renesas RCar Gen2 R8A7794 SoCs.

config PINCTRL_PFC_R8A774A1
        bool "Renesas RZ/G2 R8A774A1 pin control driver"
        depends on PINCTRL_PFC
        help
          Support pin multiplexing control on Renesas RZ/G2M R8A774A1 SoCs.

config PINCTRL_PFC_R8A774B1
        bool "Renesas RZ/G2 R8A774B1 pin control driver"
        depends on PINCTRL_PFC
        help
          Support pin multiplexing control on Renesas RZ/G2N R8A774B1 SoCs.

config PINCTRL_PFC_R8A774C0
        bool "Renesas RZ/G2 R8A774C0 pin control driver"
        depends on PINCTRL_PFC
        help
          Support pin multiplexing control on Renesas RZ/G2E R8A774C0 SoCs.

config PINCTRL_PFC_R8A774E1
        bool "Renesas RZ/G2 R8A774E1 pin control driver"
        depends on PINCTRL_PFC
        help
          Support pin multiplexing control on Renesas RZ/G2H R8A774E1 SoCs.

config PINCTRL_PFC_R8A7795
	bool "Renesas RCar Gen3 R8A7795 pin control driver"
	depends on PINCTRL_PFC
	help
	  Support pin multiplexing control on Renesas RCar Gen3 R8A7795 SoCs.

config PINCTRL_PFC_R8A7796
	bool "Renesas RCar Gen3 R8A7796 pin control driver"
	depends on PINCTRL_PFC
	help
	  Support pin multiplexing control on Renesas RCar Gen3 R8A7796 SoCs.

config PINCTRL_PFC_R8A77965
	bool "Renesas RCar Gen3 R8A77965 pin control driver"
	depends on PINCTRL_PFC
	help
	  Support pin multiplexing control on Renesas RCar Gen3 R8A77965 SoCs.

config PINCTRL_PFC_R8A77970
	bool "Renesas RCar Gen3 R8A77970 pin control driver"
	depends on PINCTRL_PFC
	help
	  Support pin multiplexing control on Renesas RCar Gen3 R8A77970 SoCs.

config PINCTRL_PFC_R8A77980
	bool "Renesas RCar Gen3 R8A77980 pin control driver"
	depends on PINCTRL_PFC
	help
	  Support pin multiplexing control on Renesas RCar Gen3 R8A77980 SoCs.

config PINCTRL_PFC_R8A77990
	bool "Renesas RCar Gen3 R8A77990 pin control driver"
	depends on PINCTRL_PFC
	help
	  Support pin multiplexing control on Renesas RCar Gen3 R8A77990 SoCs.

config PINCTRL_PFC_R8A77995
	bool "Renesas RCar Gen3 R8A77995 pin control driver"
	depends on PINCTRL_PFC
	help
	  Support pin multiplexing control on Renesas RCar Gen3 R8A77995 SoCs.

config PINCTRL_PFC_R8A779A0
	bool "Renesas RCar Gen3 R8A779A0 pin control driver"
	depends on PINCTRL_PFC
	help
	  Support pin multiplexing control on Renesas RCar Gen3 R8A779A0 SoCs.

config PINCTRL_PFC_R7S72100
	bool "Renesas RZ/A1 R7S72100 pin control driver"
	depends on CPU_RZA1
	default y if CPU_RZA1
	help
	  Support pin multiplexing control on Renesas RZ/A1 R7S72100 SoCs.

endif
```

## drivers/pinctrl/spacemit/Kconfig
```kconfig
config PINCTRL_SPACEMIT_K1
	bool "Spacemit K1 SoC pinctrl driver"
	depends on PINCTRL_GENERIC && DM
	help
	  Supports pin multiplexing control on Spacemit K1 SoCs.

	  The driver is controlled by a device tree node which contains both
	  the GPIO definitions and pin control functions for each available
	  multiplex function.
```

## drivers/pinctrl/uniphier/Kconfig
```kconfig
if ARCH_UNIPHIER

config PINCTRL_UNIPHIER
	bool

config PINCTRL_UNIPHIER_LD4
	bool "UniPhier PH1-LD4 SoC pinctrl driver"
	depends on ARCH_UNIPHIER_LD4
	default y
	select PINCTRL_UNIPHIER

config PINCTRL_UNIPHIER_PRO4
	bool "UniPhier PH1-Pro4 SoC pinctrl driver"
	depends on ARCH_UNIPHIER_PRO4
	default y
	select PINCTRL_UNIPHIER

config PINCTRL_UNIPHIER_SLD8
	bool "UniPhier PH1-sLD8 SoC pinctrl driver"
	depends on ARCH_UNIPHIER_SLD8
	default y
	select PINCTRL_UNIPHIER

config PINCTRL_UNIPHIER_PRO5
	bool "UniPhier PH1-Pro5 SoC pinctrl driver"
	depends on ARCH_UNIPHIER_PRO5
	default y
	select PINCTRL_UNIPHIER

config PINCTRL_UNIPHIER_PXS2
	bool "UniPhier ProXstream2 SoC pinctrl driver"
	depends on ARCH_UNIPHIER_PXS2
	default y
	select PINCTRL_UNIPHIER

config PINCTRL_UNIPHIER_LD6B
	bool "UniPhier PH1-LD6b SoC pinctrl driver"
	depends on ARCH_UNIPHIER_LD6B
	default y
	select PINCTRL_UNIPHIER

config PINCTRL_UNIPHIER_LD11
	bool "UniPhier PH1-LD11 SoC pinctrl driver"
	depends on ARCH_UNIPHIER_LD11
	default y
	select PINCTRL_UNIPHIER

config PINCTRL_UNIPHIER_LD20
	bool "UniPhier PH1-LD20 SoC pinctrl driver"
	depends on ARCH_UNIPHIER_LD20
	default y
	select PINCTRL_UNIPHIER

endif
```

## drivers/power/Kconfig
```kconfig
menu "Power"

source "drivers/power/pmic/Kconfig"

source "drivers/power/regulator/Kconfig"

choice
	prompt "Select Sunxi PMIC Variant"
	depends on ARCH_SUNXI
	default AXP209_POWER if MACH_SUN4I || MACH_SUN5I || MACH_SUN7I
	default AXP221_POWER if MACH_SUN6I || MACH_SUN8I

config SUNXI_NO_PMIC
	boolean "board without a pmic"
	---help---
	Select this for boards which do not use a PMIC.

config AXP152_POWER
	boolean "axp152 pmic support"
	depends on MACH_SUN5I
	---help---
	Select this to enable support for the axp152 pmic found on most
	A10s boards.

config AXP209_POWER
	boolean "axp209 pmic support"
	depends on MACH_SUN4I || MACH_SUN5I || MACH_SUN7I
	---help---
	Select this to enable support for the axp209 pmic found on most
	A10, A13 and A20 boards.

config AXP221_POWER
	boolean "axp221 / axp223 pmic support"
	depends on MACH_SUN6I || MACH_SUN8I
	---help---
	Select this to enable support for the axp221/axp223 pmic found on most
	A23 and A31 boards.

endchoice

config AXP221_DCDC1_VOLT
	int "axp221 dcdc1 voltage"
	depends on AXP221_POWER
	default 3000
	---help---
	Set the voltage (mV) to program the axp221 dcdc1 at, set to 0 to
	disable dcdc1. This is typically used as generic 3.3V IO voltage for
	things like GPIO-s, sdcard interfaces, etc. On most boards this is
	undervolted to 3.0V to safe battery.

config AXP221_DCDC2_VOLT
	int "axp221 dcdc2 voltage"
	depends on AXP221_POWER
	default 1200
	---help---
	Set the voltage (mV) to program the axp221 dcdc2 at, set to 0 to
	disable dcdc2. On A31 boards this is typically used for VDD-GPU,
	on A23/A33 for VDD-SYS, this should normally be set to 1.2V.

config AXP221_DLDO1_VOLT
	int "axp221 dldo1 voltage"
	depends on AXP221_POWER
	default 0
	---help---
	Set the voltage (mV) to program the axp221 dldo1 at, set to 0 to
	disable dldo1. On sun6i (A31) boards with ethernet this is often used
	to power the ethernet phy. On sun8i (A23) boards this is often used to
	power the wifi.

config AXP221_DLDO4_VOLT
	int "axp221 dldo4 voltage"
	depends on AXP221_POWER
	default 0
	---help---
	Set the voltage (mV) to program the axp221 dldo4 at, set to 0 to
	disable dldo4.

config AXP221_ALDO1_VOLT
	int "axp221 aldo1 voltage"
	depends on AXP221_POWER
	default 0
	---help---
	Set the voltage (mV) to program the axp221 aldo1 at, set to 0 to
	disable aldo1. On sun6i (A31) boards which have a wifi module this is
	often used to power the wifi module.

config AXP221_ALDO2_VOLT
	int "axp221 aldo2 voltage"
	depends on AXP221_POWER
	default 0 if MACH_SUN6I
	default 2500 if MACH_SUN8I
	---help---
	Set the voltage (mV) to program the axp221 aldo2 at, set to 0 to
	disable aldo2. On sun6i (A31) boards this is typically unused and
	should be disabled, if it is used for LPDDR2 it should be set to 1.8V.
	On sun8i (A23) this is typically connected to VDD-DLL and must be set
	to 2.5V.

config AXP221_ALDO3_VOLT
	int "axp221 aldo3 voltage"
	depends on AXP221_POWER
	default 3000
	---help---
	Set the voltage (mV) to program the axp221 aldo3 at, set to 0 to
	disable aldo3. This is typically connected to VCC-PLL and AVCC and
	must be set to 3V.

config AXP221_ELDO3_VOLT
	int "axp221 eldo3 voltage"
	depends on AXP221_POWER
	default 0
	---help---
	Set the voltage (mV) to program the axp221 eldo3 at, set to 0 to
	disable eldo3. On some A31(s) tablets it might be used to supply
	1.2V for the SSD2828 chip (converter of parallel LCD interface
	into MIPI DSI).

endmenu
```

## drivers/power/acpi_pmc/Kconfig
```kconfig
config ACPI_PMC
	bool "Power Manager (x86 PMC) support"
	help
	  Enable support for an x86-style power-management controller which
	  provides features including checking whether the system started from
	  resume, powering off the system and enabling/disabling the reset
	  mechanism.

config SPL_ACPI_PMC
	bool "Power Manager (x86 PMC) support in SPL"
	default y if ACPI_PMC
	help
	  Enable support for an x86-style power-management controller which
	  provides features including checking whether the system started from
	  resume, powering off the system and enabling/disabling the reset
	  mechanism.

config TPL_ACPI_PMC
	bool "Power Manager (x86 PMC) support in TPL"
	default y if ACPI_PMC
	help
	  Enable support for an x86-style power-management controller which
	  provides features including checking whether the system started from
	  resume, powering off the system and enabling/disabling the reset
	  mechanism.
```
