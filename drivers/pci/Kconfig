## drivers/pinctrl/Kconfig
```kconfig
#
# PINCTRL infrastructure and drivers
#

menu "Pin controllers"

config PINCTRL
	bool "Support pin controllers"
	depends on DM
	help
	  This enables the basic support for pinctrl framework.  You may want
	  to enable some more options depending on what you want to do.

config PINCTRL_FULL
	bool "Support full pin controllers"
	depends on PINCTRL && OF_CONTROL
	default y
	help
	  This provides Linux-compatible device tree interface for the pinctrl
	  subsystem.  This feature depends on device tree configuration because
	  it parses a device tree to look for the pinctrl device which the
	  peripheral device is associated with.

	  If this option is disabled (it is the only possible choice for non-DT
	  boards), the pinctrl core provides no systematic mechanism for
	  identifying peripheral devices, applying needed pinctrl settings.
	  It is totally up to the implementation of each low-level driver.
	  You can save memory footprint in return for some limitations.

config PINCTRL_GENERIC
	bool "Support generic pin controllers"
	depends on PINCTRL_FULL
	default y
	help
	  Say Y here if you want to use the pinctrl subsystem through the
	  generic DT interface.  If enabled, some functions become available
	  to parse common properties such as "pins", "groups", "functions" and
	  some pin configuration parameters.  It would be easier if you only
	  need the generic DT interface for pin muxing and pin configuration.
	  If you need to handle vendor-specific DT properties, you can disable
	  this option and implement your own set_state callback in the pinctrl
	  operations.

config PINMUX
	bool "Support pin multiplexing controllers"
	depends on PINCTRL_GENERIC
	default y
	help
	  This option enables pin multiplexing through the generic pinctrl
	  framework. Most SoCs have their own own multiplexing arrangement
	  where a single pin can be used for several functions. An SoC pinctrl
	  driver allows the required function to be selected for each pin.
	  The driver is typically controlled by the device tree.

config PINCONF
	bool "Support pin configuration controllers"
	depends on PINCTRL_GENERIC
	help
	  This option enables pin configuration through the generic pinctrl
	  framework.

config SPL_PINCTRL
	bool "Support pin controlloers in SPL"
	depends on SPL && SPL_DM
	help
	  This option is an SPL-variant of the PINCTRL option.
	  See the help of PINCTRL for details.

config SPL_PINCTRL_FULL
	bool "Support full pin controllers in SPL"
	depends on SPL_PINCTRL && SPL_OF_CONTROL
	default y
	help
	  This option is an SPL-variant of the PINCTRL_FULL option.
	  See the help of PINCTRL_FULL for details.

config SPL_PINCTRL_GENERIC
	bool "Support generic pin controllers in SPL"
	depends on SPL_PINCTRL_FULL
	default y
	help
	  This option is an SPL-variant of the PINCTRL_GENERIC option.
	  See the help of PINCTRL_GENERIC for details.

config SPL_PINMUX
	bool "Support pin multiplexing controllers in SPL"
	depends on SPL_PINCTRL_GENERIC
	default y
	help
	  This option is an SPL-variant of the PINMUX option.
	  See the help of PINMUX for details.
	  The pinctrl subsystem can add a substantial overhead to the SPL
	  image since it typically requires quite a few tables either in the
	  driver or in the device tree. If this is acceptable and you need
	  to adjust pin multiplexing in SPL in order to boot into U-Boot,
	  enable this option. You will need to enable device tree in SPL
	  for this to work.

config SPL_PINCONF
	bool "Support pin configuration controllers in SPL"
	depends on SPL_PINCTRL_GENERIC
	help
	  This option is an SPL-variant of the PINCONF option.
	  See the help of PINCONF for details.

if PINCTRL || SPL_PINCTRL

config ROCKCHIP_PINCTRL
	bool "Rockchip pin control driver"
	depends on DM
	help
	  Support pin multiplexing control on Rockchip SoCs. The driver is
	  controlled by a device tree node which contains both the GPIO
	  definitions and pin control functions for each available multiplex
	  function.

config ROCKCHIP_3036_PINCTRL
	bool "Rockchip rk3036 pin control driver"
	depends on DM
	help
	  Support pin multiplexing control on Rockchip rk3036 SoCs. The driver is
	  controlled by a device tree node which contains both the GPIO
	  definitions and pin control functions for each available multiplex
	  function.

config PINCTRL_SANDBOX
	bool "Sandbox pinctrl driver"
	depends on SANDBOX
	help
	  This enables pinctrl driver for sandbox.  Currently, this driver
	  actually does nothing but print debug messages when pinctrl
	  operations are invoked.

config PIC32_PINCTRL
	bool "Microchip PIC32 pin-control and pin-mux driver"
	depends on DM && MACH_PIC32
	default y
	help
	  Supports individual pin selection and configuration for each remappable
	  peripheral available on Microchip PIC32 SoCs. This driver is controlled
	  by a device tree node which contains both GPIO defintion and pin control
	  functions.

endif

source "drivers/pinctrl/nxp/Kconfig"
source "drivers/pinctrl/uniphier/Kconfig"

endmenu
```

## drivers/pinctrl/airoha/Kconfig
```kconfig
# SPDX-License-Identifier: GPL-2.0-only

config PINCTRL_AIROHA
	depends on ARCH_AIROHA
	select PINCTRL_FULL
	select PINCTRL_GENERIC
	select PINMUX
	select PINCONF
	select REGMAP
	select SYSCON
	bool

config PINCTRL_AIROHA_EN7523
	bool "Airoha EN7523 pin controller and gpio driver"
	depends on TARGET_EN7523
	select PINCTRL_AIROHA

config PINCTRL_AIROHA_AN7581
	bool "Airoha AN7581 pin controller and gpio driver"
	depends on TARGET_AN7581
	select PINCTRL_AIROHA

config PINCTRL_AIROHA_AN7583
	bool "Airoha AN7583 pin controller and gpio driver"
	depends on TARGET_AN7583
	select PINCTRL_AIROHA
```

## drivers/pinctrl/exynos/Kconfig
```kconfig
config PINCTRL_EXYNOS
	bool

config PINCTRL_EXYNOS7420
	bool "Samsung Exynos7420 pinctrl driver"
	depends on ARCH_EXYNOS && PINCTRL_FULL
	select PINCTRL_EXYNOS
	help
	  Support pin multiplexing and pin configuration control on
	  Samsung's Exynos7420 SoC.

config PINCTRL_EXYNOS4412
	bool "Samsung Exynos4412 pinctrl driver"
	depends on ARCH_EXYNOS && PINCTRL_FULL
	select PINCTRL_EXYNOS
	help
	  Support pin multiplexing and pin configuration control on
	  Samsung's Exynos4412 SoC.
```

## drivers/pinctrl/intel/Kconfig
```kconfig
#
# Intel PINCTRL drivers
#

if PINCTRL_INTEL

config INTEL_PINCTRL_DUAL_ROUTE_SUPPORT
	bool
	default y

config INTEL_PINCTRL_PADCFG_PADTOL
	bool n

config INTEL_PINCTRL_IOSTANDBY
	bool
	default y

config PINCTRL_INTEL_APL
	bool "Support Intel Apollo Lake (APL)"
	help
	  Add support for Intel Apollo Lake pin-control and pin-mux settings.
	  These are mostly read from the device tree, with the early-pads
	  property in the host bridge and the pads property in the fsp-s
	  subnode of the host bridge.

endif
```

## drivers/pinctrl/meson/Kconfig
```kconfig
if ARCH_MESON

config PINCTRL_MESON
	depends on PINCTRL_GENERIC
	bool

config PINCTRL_MESON_GX_PMX
	select PINCTRL_MESON
	bool

config PINCTRL_MESON_GXBB
	bool "Amlogic Meson GXBB SoC pinctrl driver"
	select PINCTRL_MESON_GX_PMX

config PINCTRL_MESON_GXL
	bool "Amlogic Meson GXL SoC pinctrl driver"
	select PINCTRL_MESON_GX_PMX

endif
```

## drivers/pinctrl/mscc/Kconfig
```kconfig
# SPDX-License-Identifier: (GPL-2.0+ OR MIT)

config PINCTRL_MSCC
	bool

config PINCTRL_MSCC_OCELOT
	depends on SOC_OCELOT && PINCTRL_FULL && OF_CONTROL
	select PINCTRL_MSCC
	default y
	bool "Microsemi ocelot family pin control driver"
	help
	   Support pin multiplexing and pin configuration control on
	   Microsemi ocelot SoCs.

config PINCTRL_MSCC_LUTON
	depends on SOC_LUTON && PINCTRL_FULL && OF_CONTROL
	select PINCTRL_MSCC
	default y
	bool "Microsemi luton family pin control driver"
	help
	   Support pin multiplexing and pin configuration control on
	   Microsemi luton SoCs.
```

## drivers/pinctrl/mtmips/Kconfig
```kconfig
config PINCTRL_MTMIPS
	depends on ARCH_MTMIPS
	bool

config PINCTRL_MT7628
	bool "MediaTek MT7628 pin control driver"
	select PINCTRL_MTMIPS
	depends on SOC_MT7628 && PINCTRL_GENERIC
	help
	  Support pin multiplexing control on MediaTek MT7628.
	  The driver is controlled by a device tree node which contains
	  the pin mux functions for each available pin groups.
```

## drivers/pinctrl/mvebu/Kconfig
```kconfig
config PINCTRL_MVEBU
	depends on ARCH_MVEBU
	bool
	default y
	help
	   Support pin multiplexing and pin configuration control on
	   Marvell's Armada-8K SoC.
```

## drivers/pinctrl/nuvoton/Kconfig
```kconfig
# SPDX-License-Identifier: GPL-2.0-only
config PINCTRL_NPCM7XX
	bool "Pinctrl and GPIO driver for Nuvoton NPCM7XX"
	depends on DM && PINCTRL_GENERIC && ARCH_NPCM7xx
	help
	  Say Y here to enable pin controller and GPIO support
	  for Nuvoton NPCM750/730/715/705 SoCs.
```

## drivers/pinctrl/nxp/Kconfig
```kconfig
config PINCTRL_IMX
	bool

config PINCTRL_IMX5
	bool "IMX5 pinctrl driver"
	depends on ARCH_MX5 && PINCTRL_FULL
	select DEVRES
	select PINCTRL_IMX
	help
	  Say Y here to enable the imx5 pinctrl driver

	  This provides a simple pinctrl driver for i.MX 53SoC familiy,
	  i.MX53. This feature depends on device tree
	  configuration. This driver is different from the linux one,
	  this is a simple implementation, only parses the 'fsl,pins'
	  property and configure related registers.

config PINCTRL_IMX6
	bool "IMX6 pinctrl driver"
	depends on ARCH_MX6 && PINCTRL_FULL
	select DEVRES
	select PINCTRL_IMX
	help
	  Say Y here to enable the imx6 pinctrl driver

	  This provides a simple pinctrl driver for i.MX6 SoC familiy,
	  i.MX6DQ/SL/SX/UL/DQP. This feature depends on device tree
	  configuration. This driver is different from the linux one,
	  this is a simple implementation, only parses the 'fsl,pins'
	  property and configure related registers.

config PINCTRL_IMX7
	bool "IMX7 pinctrl driver"
	depends on ARCH_MX7 && PINCTRL_FULL
	select DEVRES
	select PINCTRL_IMX
	help
	  Say Y here to enable the imx7 pinctrl driver

	  This provides a simple pinctrl driver for i.MX7 SoC familiy,
	  i.MX7D. This feature depends on device tree
	  configuration. This driver is different from the linux one,
	  this is a simple implementation, only parses the 'fsl,pins'
	  property and configure related registers.
```

## drivers/pinctrl/qcom/Kconfig
```kconfig
if ARCH_SNAPDRAGON || ARCH_IPQ40XX

config PINCTRL_QCOM
	depends on PINCTRL_GENERIC
	def_bool n

menu "Qualcomm pinctrl drivers"

config PINCTRL_QCOM_APQ8016
	bool "Qualcomm APQ8016 Pinctrl"
	select PINCTRL_QCOM
	help
	  Say Y here to enable support for pinctrl on the MSM8916 / APQ8016
	  Snapdragon 410 SoC, as well as the associated GPIO driver.

config PINCTRL_QCOM_APQ8096
	bool "Qualcomm APQ8096 Pinctrl"
	select PINCTRL_QCOM
	help
	  Say Y here to enable support for pinctrl on the MSM8996 / APQ8096
	  Snapdragon 820 SoC, as well as the associated GPIO driver.

config PINCTRL_QCOM_IPQ4019
	bool "Qualcomm IPQ4019 Pinctrl"
	select PINCTRL_QCOM
	help
	  Say Y here to enable support for pinctrl on the IPQ4019 SoC,
	  as well as the associated GPIO driver.

config PINCTRL_QCOM_IPQ5424
	bool "Qualcomm IPQ5424 Pinctrl"
	select PINCTRL_QCOM
	help
	  Say Y here to enable support for pinctrl on the IPQ5424 SoC,
	  as well as the associated GPIO driver.

config PINCTRL_QCOM_IPQ9574
	bool "Qualcomm IPQ9574 Pinctrl"
	select PINCTRL_QCOM
	help
	  Say Y here to enable support for pinctrl on the IPQ9574 SoC,
	  as well as the associated GPIO driver.

config PINCTRL_QCOM_QCM2290
	bool "Qualcomm QCM2290 Pinctrl"
	select PINCTRL_QCOM
	help
	  Say Y here to enable support for pinctrl on the Snapdragon QCM2290 SoC,
	  as well as the associated GPIO driver.

config PINCTRL_QCOM_QCS404
	bool "Qualcomm QCS404 Pinctrl"
	select PINCTRL_QCOM
	help
	  Say Y here to enable support for pinctrl on the Snapdragon QCS404 SoC,
	  as well as the associated GPIO driver.

config PINCTRL_QCOM_SA8775P
	bool "Qualcomm SA8775P Pinctrl"
	select PINCTRL_QCOM
	help
	  Say Y here to enable support for pinctrl on the Snapdragon SA8775P SoC,
	  as well as the associated GPIO driver.

config PINCTRL_QCOM_SC7280
	bool "Qualcomm SC7280/QCM6490 Pinctrl"
	select PINCTRL_QCOM
	help
	  Say Y here to enable support for pinctrl on the Snapdragon SC7280 SoC,

config PINCTRL_QCOM_SDM660
	bool "Qualcomm SDM630/660 Pinctrl"
	select PINCTRL_QCOM
	help
	  Say Y here to enable support for pinctrl on the Snapdragon 630/636/660
	  SoCs, as well as the associated GPIO driver.

config PINCTRL_QCOM_SDM845
	bool "Qualcomm SDM845 Pinctrl"
	select PINCTRL_QCOM
	help
	  Say Y here to enable support for pinctrl on the Snapdragon 845 SoC,
	  as well as the associated GPIO driver.

config PINCTRL_QCOM_SM6115
	bool "Qualcomm SM6115 Pinctrl"
	select PINCTRL_QCOM
	help
	  Say Y here to enable support for pinctrl on the Snapdragon SM6115 SoC,
	  as well as the associated GPIO driver.

config PINCTRL_QCOM_SM8150
	bool "Qualcomm SM8150 Pinctrl"
	select PINCTRL_QCOM
	help
	  Say Y here to enable support for pinctrl on the Snapdragon SM8150 SoC,
	  as well as the associated GPIO driver.

config PINCTRL_QCOM_SM8250
	bool "Qualcomm SM8250 Pinctrl"
	select PINCTRL_QCOM
	help
	  Say Y here to enable support for pinctrl on the Snapdragon SM8250 SoC,
	  as well as the associated GPIO driver.

config PINCTRL_QCOM_SM8550
	bool "Qualcomm SM8550 Pinctrl"
	select PINCTRL_QCOM
	help
	  Say Y here to enable support for pinctrl on the Snapdragon SM8550 SoC,
	  as well as the associated GPIO driver.

config PINCTRL_QCOM_SM8650
	bool "Qualcomm SM8650 Pinctrl"
	select PINCTRL_QCOM
	help
	  Say Y here to enable support for pinctrl on the Snapdragon SM8650 SoC,
	  as well as the associated GPIO driver.

config PINCTRL_QCOM_X1E80100
	bool "Qualcomm X1E80100 Pinctrl"
	select PINCTRL_QCOM
	help
	  Say Y here to enable support for pinctrl on the Snapdragon X1E80100 SoC,
	  as well as the associated GPIO driver.

endmenu

endif
```
