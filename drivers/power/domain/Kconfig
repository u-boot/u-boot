## drivers/power/domain/Kconfig
```kconfig
menu "Power Domain Support"

config POWER_DOMAIN
	bool "Enable power domain support using Driver Model"
	depends on DM && OF_CONTROL
	help
	  Enable support for the power domain driver class. Many SoCs allow
	  power to be applied to or removed from portions of the SoC (power
	  domains). This may be used to save power. This API provides the
	  means to control such power management hardware.

config BCM6328_POWER_DOMAIN
	bool "Enable the BCM6328 power domain driver"
	depends on POWER_DOMAIN && ARCH_BMIPS
	help
	  Enable support for manipulating BCM6345 power domains via MMIO
	  mapped registers.

config SANDBOX_POWER_DOMAIN
	bool "Enable the sandbox power domain test driver"
	depends on POWER_DOMAIN && SANDBOX
	help
	  Enable support for a test power domain driver implementation, which
	  simply accepts requests to power on/off various HW modules without
	  actually doing anything beyond a little error checking.

config TEGRA186_POWER_DOMAIN
	bool "Enable Tegra186 BPMP-based power domain driver"
	depends on TEGRA186_BPMP
	help
	  Enable support for manipulating Tegra's on-SoC power domains via IPC
	  requests to the BPMP (Boot and Power Management Processor).

endmenu
```

## drivers/power/pmic/Kconfig
```kconfig
config DM_PMIC
	bool "Enable Driver Model for PMIC drivers (UCLASS_PMIC)"
	depends on DM
	---help---
	This config enables the driver-model PMIC support.
	UCLASS_PMIC - designed to provide an I/O interface for PMIC devices.
	For the multi-function PMIC devices, this can be used as parent I/O
	device for each IC's interface. Then, each children uses its parent
	for read/write. For detailed description, please refer to the files:
	- 'drivers/power/pmic/pmic-uclass.c'
	- 'include/power/pmic.h'

config DM_PMIC_MAX77686
	bool "Enable Driver Model for PMIC MAX77686"
	depends on DM_PMIC
	---help---
	This config enables implementation of driver-model pmic uclass features
	for PMIC MAX77686. The driver implements read/write operations.

config DM_PMIC_SANDBOX
	bool "Enable Driver Model for emulated Sandbox PMIC "
	depends on DM_PMIC
	---help---
	Enable the driver for Sandbox PMIC emulation. The emulated PMIC device
	depends on two drivers:
	- sandbox PMIC I/O driver - implements dm pmic operations
	- sandbox PMIC i2c emul driver - emulates the PMIC's I2C transmission

	A detailed information can be found in header: '<power/sandbox_pmic.h>'

	The Sandbox PMIC info:
	* I/O interface:
	  - I2C chip address:       0x40
	  - first register address: 0x0
	  - register count:         0x10
	* Adjustable outputs:
	  - 2x LDO
	  - 2x BUCK
	  - Each, with a different operating conditions (header).
	* Reset values:
	  - set by i2c emul driver's probe() (defaults in header)

	Driver binding info: doc/device-tree-bindings/pmic/sandbox.txt
```

## drivers/power/regulator/Kconfig
```kconfig
config DM_REGULATOR
	bool "Enable Driver Model for REGULATOR drivers (UCLASS_REGULATOR)"
	depends on DM
	---help---
	This config enables the driver model regulator support.
	UCLASS_REGULATOR - designed to provide a common API for basic regulator's
	functions, like get/set Voltage or Current value, enable state, etc...
	Note:
	When enabling this, please read the description, found in the files:
	- 'include/power/pmic.h'
	- 'include/power/regulator.h'
	- 'drivers/power/pmic/pmic-uclass.c'
	- 'drivers/power/pmic/regulator-uclass.c'
	It's important to call the device_bind() with the proper node offset,
	when binding the regulator devices. The pmic_bind_childs() can be used
	for this purpose if PMIC I/O driver is implemented or dm_scan_fdt_dev()
	otherwise. Detailed information can be found in the header file.

config SPL_DM_REGULATOR
	bool "Enable regulators for SPL"
	depends on DM_REGULATOR
	---help---
	Regulators are seldom needed in SPL. Even if they are accessed, some
	code space can be saved by accessing the PMIC registers directly.
	Enable this option if you need regulators in SPL and can cope with
	the extra code size.

config REGULATOR_ACT8846
	bool "Enable driver for ACT8846 regulator"
	depends on DM_REGULATOR && PMIC_ACT8846
	---help---
	Enable support for the regulator functions of the ACT8846 PMIC. The
	driver implements get/set api for the various BUCKS and LDOS supported
	by the PMIC device. This driver is controlled by a device tree node
	which includes voltage limits.

config DM_REGULATOR_PFUZE100
	bool "Enable Driver Model for REGULATOR PFUZE100"
	depends on DM_REGULATOR && DM_PMIC_PFUZE100
	---help---
	This config enables implementation of driver-model regulator uclass
	features for REGULATOR PFUZE100. The driver implements get/set api for:
	value, enable and mode.

config DM_REGULATOR_MAX77686
	bool "Enable Driver Model for REGULATOR MAX77686"
	depends on DM_REGULATOR && DM_PMIC_MAX77686
	---help---
	This config enables implementation of driver-model regulator uclass
	features for REGULATOR MAX77686. The driver implements get/set api for:
	value, enable and mode.

config DM_REGULATOR_FIXED
	bool "Enable Driver Model for REGULATOR Fixed value"
	depends on DM_REGULATOR
	---help---
	This config enables implementation of driver-model regulator uclass
	features for fixed value regulators. The driver implements get/set api
	for enable and get only for voltage value.

config REGULATOR_RK808
	bool "Enable driver for RK808 regulators"
	depends on DM_REGULATOR && PMIC_RK808
	---help---
	Enable support for the regulator functions of the RK808 PMIC. The
	driver implements get/set api for the various BUCKS and LDOs supported
	by the PMIC device. This driver is controlled by a device tree node
	which includes voltage limits.

config REGULATOR_S5M8767
	bool "Enable support for S5M8767 regulator"
	depends on DM_REGULATOR && PMIC_S5M8767
	---help---
	This enables the regulator features of the S5M8767, allowing voltages
	to be set, etc. The driver is not fully complete but supports most
	common requirements, including all LDOs and BUCKs. This allows many
	supplies to be set automatically using the device tree values.

config DM_REGULATOR_SANDBOX
	bool "Enable Driver Model for Sandbox PMIC regulator"
	depends on DM_REGULATOR && DM_PMIC_SANDBOX
	---help---
	Enable the regulator driver for emulated Sandbox PMIC.
	The emulated PMIC device depends on two drivers:
	- sandbox PMIC I/O driver - implements dm pmic operations
	- sandbox PMIC regulator driver - implements dm regulator operations
	- sandbox PMIC i2c emul driver - emulates the PMIC's I2C transmission

	The regulator driver provides uclass operations for sandbox PMIC's
	regulators. The driver implements get/set api for: voltage, current,
	operation mode and enable state.
	The driver supports LDO and BUCK regulators.

	The Sandbox PMIC info:
	* I/O interface:
	  - I2C chip address:       0x40
	  - first register address: 0x0
	  - register count:         0x10
	* Adjustable outputs:
	  - 2x LDO
	  - 2x BUCK
	  - Each, with a different operating conditions (header).
	* Reset values:
	  - set by i2c emul driver's probe() (defaults in header)

	A detailed information can be found in header: '<power/sandbox_pmic.h>'
	Binding info: 'doc/device-tree-bindings/pmic/max77686.txt'

config REGULATOR_TPS65090
	bool "Enable driver for TPS65090 PMIC regulators"
	depends on PMIC_TPS65090
	---help---
	The TPS65090 provides several FETs (Field-effect Transistors,
	effectively switches) which are supported by this driver as
	regulators, one for each FET. The standard regulator interface is
	supported, but it is only possible to turn the regulators on or off.
	There is no voltage/current control.
```

## drivers/pwm/Kconfig
```kconfig
config DM_PWM
	bool "Enable support for pulse-width modulation devices (PWM)"
	depends on DM
	help
	  A pulse-width modulator emits a pulse of varying width and provides
	  control over the duty cycle (high and low time) of the signal. This
	  is often used to control a voltage level. The more time the PWM
	  spends in the 'high' state, the higher the voltage. The PWM's
	  frequency/period can be controlled along with the proportion of that
	  time that the signal is high.

config PWM_CROS_EC
	bool "Enable support for the Chrome OS EC PWM"
	depends on DM_PWM
	help
	  This PWM is found on several Chrome OS devices and controlled by
	  the Chrome OS embedded controller. It may be used to control the
	  screen brightness and/or the keyboard backlight depending on the
	  device.

config PWM_EXYNOS
	bool "Enable support for the Exynos PWM"
	depends on DM_PWM
	help
	  This PWM is found on Samsung Exynos 5250 and other Samsung SoCs. It
	  supports a programmable period and duty cycle. A 32-bit counter is
	  used. It provides 5 channels which can be independently
	  programmed. Channel 4 (the last) is normally used as a timer.

config PWM_IMX
	bool "Enable support for i.MX27 and later PWM"
	help
	  This PWM is found i.MX27 and later i.MX SoCs.

config PWM_MESON
	bool "Enable support for Amlogic Meson SoCs PWM"
	depends on DM_PWM
	help
	  This PWM is found on Amlogic Meson SoCs. It supports a
	  programmable period and duty cycle for 2 independant channels.

config PWM_MTK
	bool "Enable support for MediaTek PWM"
	depends on DM_PWM
	help
	  This PWM is found on MT7622, MT7623, and MT7629. It supports a
	  programmable period and duty cycle.

config PWM_ROCKCHIP
	bool "Enable support for the Rockchip PWM"
	depends on DM_PWM
	help
	  This PWM is found on RK3288 and other Rockchip SoCs. It supports a
	  programmable period and duty cycle. A 32-bit counter is used.
	  Various options provided in the hardware (such as capture mode and
	  continuous/single-shot) are not supported by the driver.

config PWM_SANDBOX
	bool "Enable support for the sandbox PWM"
	help
	  This is a sandbox PWM used for testing. It provides 3 channels and
	  records the settings passed into it, but otherwise does nothing
	  useful. The PWM can be enabled but is not connected to any outputs
	  so this is not very useful.

config PWM_SIFIVE
	bool "Enable support for SiFive PWM"
	depends on DM_PWM
	help
	  This PWM is found SiFive's FU540 and other SoCs.

config PWM_TEGRA
	bool "Enable support for the Tegra PWM"
	depends on DM_PWM
	help
	  This PWM is found on Tegra 20 and other Nvidia SoCs. It supports
	  four channels with a programmable period and duty cycle. Only a
	  32KHz clock is supported by the driver but the duty cycle is
	  configurable.

config PWM_SUNXI
	bool "Enable support for the Allwinner Sunxi PWM"
	depends on DM_PWM
	help
	  This PWM is found on H3, A64 and other Allwinner SoCs. It supports a
	  programmable period and duty cycle. A 16-bit counter is used.

config PWM_TI_EHRPWM
	bool "Enable support for EHRPWM PWM"
	depends on DM_PWM && ARCH_OMAP2PLUS
	default y
	help
	  PWM driver support for the EHRPWM controller found on TI SOCs.
```

## drivers/pwrap/Kconfig
```kconfig
menu "PWRAP support"

config PWRAP
	bool "Enable PWRAP support"
	depends on DM
	---help---
	  Select this to enable to support PWRAP.
	  PWRAP (PMIC Wrapper) bus is used
	  to connect PMIC devices on MediaTek SoCs.

config MT6735_PWRAP
	bool "Support PWRAP on MT6735"
	depends on PWRAP
	---help---
	  Support PWRAP implementation found on MediaTek MT6735 SoCs.

endmenu
```

## drivers/qe/Kconfig
```kconfig
#
# QUICC Engine Drivers
#
config U_QE
	bool "Enable support for U QUICC Engine"
	default y if (ARCH_LS1021A && !SD_BOOT && !NAND_BOOT && !QSPI_BOOT) \
		|| (TARGET_T1024QDS) \
		|| (TARGET_T1024RDB) \
		|| (TARGET_T1040QDS && !NOBQFMAN) \
		|| (TARGET_LS1043ARDB && !SPL_NO_QE && !NAND_BOOT && !QSPI_BOOT)
	help
	  Choose this option to add support for U QUICC Engine.
```

## drivers/ram/Kconfig
```kconfig
config RAM
	bool "Enable RAM drivers using Driver Model"
	depends on DM
	help
	  This allows drivers to be provided for SDRAM and other RAM
	  controllers and their type to be specified in the board's device
	  tree. Generally some parameters are required to set up the RAM and
	  the RAM size can either be statically defined or dynamically
	  detected.

config SPL_RAM
	bool "Enable RAM support in SPL"
	depends on RAM
	help
	  The RAM subsystem adds a small amount of overhead to the image.
	  If this is acceptable and you have a need to use RAM drivers in
	  SPL, enable this option. It might provide a cleaner interface to
	  setting up RAM (e.g. SDRAM / DDR) within SPL.

config STM32_SDRAM
	bool "Enable STM32 SDRAM support"
	depends on RAM
	help
	  STM32F7 family devices support flexible memory controller(FMC) to
	  support external memories like sdram, psram & nand.
	  This driver is for the sdram memory interface with the FMC.
```

## drivers/ram/aspeed/Kconfig
```kconfig
if RAM || SPL_RAM

config ASPEED_DDR4_DUALX8
	bool "Enable Dual X8 DDR4 die"
	depends on DM && OF_CONTROL && ARCH_ASPEED
	default n
	help
		Say Y if dual X8 DDR4 die is used on the board.  The aspeed ddr sdram
		controller needs to know if the memory chip mounted on the board is dual
		 x8 die or not.  Or it may get the wrong size of the memory space.

if ASPEED_AST2600

choice
	prompt "DDR4 target date rate"
	default ASPEED_DDR4_1600

config ASPEED_DDR4_400
	bool "DDR4 targets at 400Mbps"
	depends on DM && OF_CONTROL && ARCH_ASPEED
	help
	  select DDR4 target data rate at 400M

config ASPEED_DDR4_800
	bool "DDR4 targets at 800Mbps"
	depends on DM && OF_CONTROL && ARCH_ASPEED
	help
	  select DDR4 target data rate at 800M

config ASPEED_DDR4_1333
	bool "DDR4 targets at 1333Mbps"
	depends on DM && OF_CONTROL && ARCH_ASPEED
	help
	  select DDR4 target data rate at 1333M

config ASPEED_DDR4_1600
	bool "DDR4 targets at 1600Mbps"
	depends on DM && OF_CONTROL && ARCH_ASPEED
	help
	  select DDR4 target data rate at 1600M
endchoice

config ASPEED_BYPASS_SELFTEST
	bool "bypass self test during DRAM initialization"
	default n
	help
	  Say Y here to bypass DRAM self test to speed up the boot time

config ASPEED_ECC
	bool "aspeed SDRAM error correcting code"
	depends on DM && OF_CONTROL && ARCH_ASPEED
	default n
	help
	  enable SDRAM ECC function

if ASPEED_ECC
config ASPEED_ECC_SIZE
	int "ECC size: 0=driver auto-caluated"
	depends on ASPEED_ECC
	default 0
	help
	  SDRAM size with the error correcting code enabled. The unit is
	  in Megabytes.  Noted that only the 8/9 of the configured size
	  can be used by the system.  The remaining 1/9 will be used by
	  the ECC engine.  If the size is set to 0, the sdram driver will
	  calculate the SDRAM size and set the whole range be ECC enabled.
endif # end of ASPEED_ECC
endif # end of ASPEED_AST2600
endif # end of RAM || SPL_RAM
```

## drivers/ram/renesas/Kconfig
```kconfig
config RAM_RENESAS_DBSC5
	bool "Renesas R-Car V4H/V4M DBSC5 controller driver"
	depends on SPL && RAM && (R8A779G0 || R8A779H0)
	default n
	help
	  Enable this to support the DBSC5 DRAM controller initialization
	  on Renesas R8A779G0/R8A779H0 SoCs.
```
