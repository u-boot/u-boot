## drivers/ram/rockchip/Kconfig
```kconfig
config RAM_ROCKCHIP
	bool "Ram drivers support for Rockchip SoCs"
	depends on RAM && ARCH_ROCKCHIP
	default y
	help
	  This enables support for ram drivers Rockchip SoCs.

config ROCKCHIP_SDRAM_COMMON
	bool "Enable rockchip sdram common driver"
	depends on TPL_RAM || SPL_RAM
	help
	  This enable sdram common driver

config RAM_ROCKCHIP_DEBUG
	bool "Rockchip ram drivers debugging"
	depends on RAM_ROCKCHIP
	default y
	help
	  This enables debugging ram driver API's for the platforms
	  based on Rockchip SoCs.

	  This is an option for developers to understand the ram drivers
	  initialization, configurations and etc.

config RAM_PX30_DDR4
	bool "DDR3 support for Rockchip PX30"
	depends on RAM_ROCKCHIP && ROCKCHIP_PX30
	help
	  This enables DDR4 sdram support instead of the default DDR3 support
	  on Rockchip PC30 SoCs.

config RAM_PX30_LPDDR2
	bool "LPDDR2 support for Rockchip PX30"
	depends on RAM_ROCKCHIP && ROCKCHIP_PX30
	help
	  This enables LPDDR2 sdram support instead of the default DDR3 support
	  on Rockchip PC30 SoCs.

config RAM_PX30_LPDDR3
	bool "LPDDR3 support for Rockchip PX30"
	depends on RAM_ROCKCHIP && ROCKCHIP_PX30
	help
	  This enables LPDDR3 sdram support instead of the default DDR3 support
	  on Rockchip PC30 SoCs.

config RAM_RK3399_LPDDR4
	bool "LPDDR4 support for Rockchip RK3399"
	depends on RAM_ROCKCHIP && ROCKCHIP_RK3399
	help
	  This enables LPDDR4 sdram code support for the platforms based
	  on Rockchip RK3399 SoC.
```

## drivers/ram/sifive/Kconfig
```kconfig
config RAM_SIFIVE
	bool "Ram drivers support for SiFive SoCs"
	depends on RAM && RISCV
	default y
	help
	  This enables support for ram drivers of SiFive SoCs.

config SIFIVE_FU540_DDR
	bool "SiFive FU540 DDR driver"
	depends on RAM_SIFIVE
	default y if TARGET_SIFIVE_FU540
	help
	  This enables DDR support for the platforms based on SiFive FU540 SoC.
```

## drivers/ram/stm32mp1/Kconfig
```kconfig
config STM32MP1_DDR
	bool "STM32MP1 DDR driver"
	depends on DM && OF_CONTROL && ARCH_STM32MP
	select RAM
	select SPL_RAM if SPL
	default y
	help
		activate STM32MP1 DDR controller driver for STM32MP1 soc
		family:	support for LPDDR2, LPDDR3 and DDR3
		the SDRAM parameters for controleur and phy need to be provided
		in device tree (computed by DDR tuning tools)
```

## drivers/ram/sunxi/Kconfig
```kconfig
config DRAM_SUN20I_D1
	bool
	depends on ARCH_SUNXI
	help
	  This enables support for the DRAM controller driver covering
	  the Allwinner D1/R528/T113s SoCs.
```

## drivers/ram/thead/Kconfig
```kconfig
config SPL_THEAD_TH1520_DDR
	bool "T-Head TH1520 DDR driver in SPL"
	depends on SPL_RAM && THEAD_TH1520
	help
	  This enables DDR support for T-Head TH1520 platforms.
```

## drivers/reboot-mode/Kconfig
```kconfig
#
# SPDX-License-Identifier: GPL-2.0+
#
# Copyright (c), Vaisala Oyj
#

menu "Reboot Mode Support"

config DM_REBOOT_MODE
	bool "Enable reboot mode using Driver Model"
	depends on DM
	default n
	help
		Enable support for reboot mode control. This will allow users to
		adjust the boot process based on reboot mode parameter
		passed to U-Boot.

endmenu
```

## drivers/remoteproc/Kconfig
```kconfig
# SPDX-License-Identifier: GPL-2.0+
#
# (C) Copyright 2015
# Texas Instruments Incorporated - https://www.ti.com/
#

menu "Remote Processor drivers"

# REMOTEPROC gets selected by drivers as needed
# All users should depend on DM
config REMOTEPROC
	bool
	depends on DM

# Please keep the configuration alphabetically sorted.

config K3_SYSTEM_CONTROLLER
	bool "Support for TI' K3 System Controller"
	select REMOTEPROC
	depends on DM
	depends on ARCH_K3
	depends on OF_CONTROL
	help
	  Say 'y' here to add support for TI' K3 System Controller.

config REMOTEPROC_ADI_SC5XX
	bool "Support for ADI SC5xx SHARC cores"
	select REMOTEPROC
	depends on DM
	depends on ARCH_SC5XX
	depends on SYSCON
	help
	  Say 'y' here to add support for loading code onto SHARC cores in
	  an ADSP-SC5xx SoC from Analog Devices

config REMOTEPROC_RENESAS_APMU
	bool "Support for Renesas R-Car Gen4 APMU start of CR52 processor"
	select REMOTEPROC
	depends on ARCH_RENESAS && RCAR_GEN4 && DM && OF_CONTROL
	help
	  Say 'y' here to add support for Renesas R-Car Gen4 Cortex-A52
	  processor via the remoteproc framework.

config REMOTEPROC_SANDBOX
	bool "Support for Test processor for Sandbox"
	select REMOTEPROC
	depends on DM
	depends on SANDBOX
	help
	  Say 'y' here to add support for test processor which does dummy
	  operations for sandbox platform.

config REMOTEPROC_STM32_COPRO
	bool "Support for STM32 coprocessor"
	select REMOTEPROC
	depends on DM
	depends on ARCH_STM32MP
	depends on OF_CONTROL
	help
	  Say 'y' here to add support for STM32 Cortex-M4 coprocessors via the
	  remoteproc framework.

config REMOTEPROC_TI_K3_ARM64
	bool "Support for TI's K3 based ARM64 remoteproc driver"
	select REMOTEPROC
	depends on DM
	depends on ARCH_K3
	depends on OF_CONTROL
	default y if SYS_K3_SPL_ATF
	help
	  Say y here to support TI's ARM64 processor subsystems
	  on various TI K3 family of SoCs through the remote processor
	  framework.

config REMOTEPROC_TI_K3_DSP
	bool "TI K3 C66 and C71 remoteproc support"
	select REMOTEPROC
	depends on ARCH_K3
	depends on TI_SCI_PROTOCOL
	help
	  Say y here to support TI's C66/C71 remote processor subsystems
	  on various TI K3 family of SoCs through the remote processor
	  framework.

config REMOTEPROC_TI_K3_M4F
	bool "TI K3 M4F remoteproc support"
	select REMOTEPROC
	depends on ARCH_K3
	depends on TI_SCI_PROTOCOL
	help
	  Say y here to support TI's M4F remote processor subsystems
	  on various TI K3 family of SoCs through the remote processor
	  framework.

config REMOTEPROC_TI_K3_R5F
	bool "TI K3 R5F remoteproc support"
	select REMOTEPROC
	depends on ARCH_K3
	depends on TI_SCI_PROTOCOL
	help
	  Say y here to support TI's R5F remote processor subsystems
	  on various TI K3 family of SoCs through the remote processor
	  framework.

config REMOTEPROC_TI_POWER
	bool "Support for TI Power processor"
	select REMOTEPROC
	depends on DM
	depends on ARCH_KEYSTONE
	depends on OF_CONTROL
	help
	  Say 'y' here to add support for TI power processors such as those
	  found on certain TI keystone and OMAP generation SoCs.

config REMOTEPROC_TI_PRU
	bool "Support for TI's K3 based PRU remoteproc driver"
	select REMOTEPROC
	depends on DM
	depends on TI_PRUSS
	depends on ARCH_K3
	depends on OF_CONTROL
	help
	  Say 'y' here to add support for TI' K3 remoteproc driver.

config REMOTEPROC_TI_IPU
	bool "Support for TI's K3 based IPU remoteproc driver"
	select REMOTEPROC
	depends on DM
	depends on SPL_DRIVERS_MISC
	depends on SPL_FS_LOADER
	depends on OF_CONTROL
	help
	  Say 'y' here to add support for TI' K3 remoteproc driver.

config REMOTEPROC_MAX_FW_SIZE
	hex "Maximum size of firmware file that needs to be loaded to the remote processor"
	default 0x10000
	help
	  Maximum size of the firmware file (elf, binary) that needs to be
	  loaded to the remote processor.

endmenu
```

## drivers/reset/Kconfig
```kconfig
menu "Reset Controller Support"

config DM_RESET
	bool "Enable reset controllers using Driver Model"
	depends on DM && OF_CONTROL
	help
	  Enable support for the reset controller driver class. Many hardware
	  modules are equipped with a reset signal, typically driven by some
	  reset controller hardware module within the chip. In U-Boot, reset
	  controller drivers allow control over these reset signals. In some
	  cases this API is applicable to chips outside the CPU as well,
	  although driving such reset isgnals using GPIOs may be more
	  appropriate in this case.

config SANDBOX_RESET
	bool "Enable the sandbox reset test driver"
	depends on DM_MAILBOX && SANDBOX
	help
	  Enable support for a test reset controller implementation, which
	  simply accepts requests to reset various HW modules without actually
	  doing anything beyond a little error checking.

config TEGRA_CAR_RESET
	bool "Enable Tegra CAR-based reset driver"
	depends on TEGRA_CAR
	help
	  Enable support for manipulating Tegra's on-SoC reset signals via
	  direct register access to the Tegra CAR (Clock And Reset controller).

config TEGRA186_RESET
	bool "Enable Tegra186 BPMP-based reset driver"
	depends on TEGRA186_BPMP
	help
	  Enable support for manipulating Tegra's on-SoC reset signals via IPC
	  requests to the BPMP (Boot and Power Management Processor).

config RESET_UNIPHIER
	bool "Reset controller driver for UniPhier SoCs"
	depends on ARCH_UNIPHIER
	default y
	help
	  Support for reset controllers on UniPhier SoCs.
	  Say Y if you want to control reset signals provided by System Control
	  block, Media I/O block, Peripheral Block.

endmenu
```

## drivers/reset/stm32/Kconfig
```kconfig
config RESET_STM32
	bool "Enable the STM32 reset"
	depends on ARCH_STM32
	default y
	help
	  Support for reset controllers on STMicroelectronics STM32 family SoCs.
	  This reset driver is compatible with STM32 F4/F7 and H7 SoCs.

config RESET_STM32MP1
	bool "Enable the STM32MP1 reset"
	depends on STM32MP13X || STM32MP15X
	default y
	help
	  Support for reset controllers on STMicroelectronics STM32MP1 family SoCs.
	  This reset driver is compatible with STM32MP13 and STM32MP15 SoCs.

config RESET_STM32MP25
	bool "Enable the STM32MP25 reset"
	depends on STM32MP23X || STM32MP25X
	default y
	help
	  Support for reset controllers on STMicroelectronics STM32MP2 family SoCs.
	  This reset driver is compatible with STM32MP25 SoCs.
```

## drivers/rng/Kconfig
```kconfig
config DM_RNG
	bool "Driver support for Random Number Generator devices"
	depends on DM
	help
	  Enable driver model for random number generator(rng) devices.
	  This interface is used to initialise the rng device and to
	  read the random seed from the device.

config SPL_DM_RNG
	bool "Driver support for Random Number Generator devices in SPL"
	depends on SPL_DM
	help
	  This option is an SPL-variant of the DM_RNG option.
	  See the help of DM_RNG for details.

if DM_RNG

config RNG_MESON
	bool "Amlogic Meson Random Number Generator support"
	depends on ARCH_MESON
	default y
	help
	  Enable support for hardware random number generator
	  of Amlogic Meson SoCs.

config RNG_SANDBOX
	bool "Sandbox random number generator"
	depends on SANDBOX
	default y
	help
	  Enable random number generator for sandbox. This is an
	  emulation of a rng device.

config RNG_MSM
	bool "Qualcomm SoCs Random Number Generator support"
	depends on DM_RNG
	help
	  This driver provides support for the Random Number
	  Generator hardware found on Qualcomm SoCs.

config RNG_NPCM
	bool "Nuvoton NPCM SoCs Random Number Generator support"
	depends on DM_RNG
	help
	  Enable random number generator on NPCM SoCs.
	  This unit can provide 750 to 1000 random bits per second

config RNG_OPTEE
	bool "OP-TEE based Random Number Generator support"
	depends on DM_RNG && OPTEE
	default y if OPTEE_SERVICE_DISCOVERY
	help
	  This driver provides support for the OP-TEE based Random Number
	  Generator on ARM SoCs where hardware entropy sources are not
	  accessible to normal world but reserved and used by the OP-TEE
	  to avoid the weakness of a software PRNG.

config RNG_RISCV_ZKR
	bool "RISC-V Zkr random number generator"
	depends on RISCV_SMODE
	help
	  This driver provides a Random Number Generator based on the
	  Zkr RISC-V ISA extension which provides an interface to an
	  NIST SP 800-90B or BSI AIS-31 compliant physical entropy source.

config RNG_STM32
	bool "Enable random number generator for STM32"
	depends on ARCH_STM32 || ARCH_STM32MP
	help
	  Enable STM32 rng driver.

config RNG_ROCKCHIP
	bool "Enable random number generator for rockchip crypto rng"
	depends on ARCH_ROCKCHIP && DM_RNG
	help
	  Enable random number generator for rockchip. This driver
	  supports the rng module of crypto v1, crypto v2, and the
	  trng module of the rk3588 series.

config RNG_IPROC200
	bool "Broadcom iProc RNG200 random number generator"
	depends on DM_RNG
	help
	  Enable random number generator for RPI4.

config RNG_SMCCC_TRNG
	bool "Arm SMCCC TRNG interface"
	depends on DM_RNG && ARM_PSCI_FW
	default y if ARM_SMCCC_FEATURES
	help
	  Enable random number generator for platforms that support Arm
	  SMCCC TRNG interface.

config RNG_ARM_RNDR
	bool "Generic ARMv8.5 RNDR register"
	depends on DM_RNG && ARM64
	help
	  Use the ARMv8.5 RNDR register to provide random numbers.

config TPM_RNG
	bool "Enable random number generator on TPM device"
	depends on TPM
	default y
	help
	  The TPM device has an inbuilt random number generator
	  functionality. Enable random number generator on TPM
	  devices.

config RNG_JH7110
	bool "StarFive JH7110 Random Number Generator support"
	depends on DM_RNG && STARFIVE_JH7110
	help
	  Enable True Random Number Generator in StarFive JH7110 SoCs.

config RNG_TURRIS_RWTM
	bool "Turris Mox TRNG in Secure Processor"
	depends on DM_RNG && ARMADA_3700
	help
	  Use TRNG in Turris Mox Secure Processor Firmware. Can be used
	  on other Armada-3700 devices (like EspressoBin) if Secure
	  Firmware from CZ.NIC is used.

config RNG_EXYNOS
	bool "Samsung Exynos True Random Number Generator support"
	depends on DM_RNG
	help
	  Enable support for True Random Number Generator (TRNG) available on
	  Exynos SoCs.

	  On some chips (like Exynos850) TRNG registers are protected with TZPC
	  (TrustZone Protection Control). For such chips the driver provides an
	  implementation based on SMC calls to EL3 monitor program. In that
	  case the LDFW (Loadable Firmware) has to be loaded first, as it
	  actually implements TRNG SMC calls.

endif
```
