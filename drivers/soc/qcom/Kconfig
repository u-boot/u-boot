## drivers/soc/qcom/Kconfig
```kconfig
# SPDX-License-Identifier: GPL-2.0-only
#
# QCOM Soc drivers
#
menuconfig SOC_QCOM
	bool "Qualcomm SOC drivers support"
	depends on ARM64
	help
	  Say Y here if you want to enable Qualcomm SOC drivers support.

if SOC_QCOM

config QCOM_COMMAND_DB
	bool "Qualcomm Command DB"
	help
	  Command DB queries shared memory by key string for shared system
	  resources. Platform drivers that require to set state of a shared
	  resource on a RPM-hardened platform must use this database to get
	  SoC specific identifier and information for the shared resources.

config QCOM_RPMH
	bool "Qualcomm RPMh support"
	depends on QCOM_COMMAND_DB
	help
	  Say y here to support the Qualcomm RPMh (resource peripheral manager)
	  if you need to control regulators on Qualcomm platforms, say y here.

config QCOM_SMEM
	bool "Qualcomm SMEM support"
	help
	  Say y here to support the Qualcomm SMEM (shared memory) client driver.
	  SMEM is a shared memory region that is used to pass information about
	  the hardware (e.g. DRAM layout, PMIC configuration, etc) between bootloader
	  staged and the OS. If in doubt, say y.

endif # SOC_QCOM
```

## drivers/sound/Kconfig
```kconfig
menu "Sound support"

config SOUND
	bool "Enable sound support"
	help
	  Support making sounds through an audio codec. This is normally a
	  beep at a chosen frequency for a selected length of time. However
	  the drivers support playing arbitrary sound samples using a
	  PCM interface.

	  Note: At present the sound setup is somewhat tangled up in that the
	  audio codecs are called from the sound-i2s code. This could be
	  converted to driver model.

config I2S
	bool "Enable I2S support"
	depends on SOUND
	help
	  I2S is a serial bus often used to transmit audio data from the
	  SoC to the audio codec. This option enables sound support using
	  I2S. It calls either of the two supported codecs (no use is made
	  of driver model at present).

config I2S_SAMSUNG
	bool "Enable I2C support for Samsung SoCs"
	depends on SOUND
	help
	  Samsung Exynos SoCs support an I2S interface for sending audio
	  data to an audio codec. This option enables support for this,
	  using one of the available audio codec drivers. Enabling this
	  option provides an implementation for sound_init() and
	  sound_play().

config SOUND_MAX98090
	bool "Support Maxim max98090 audio codec"
	depends on I2S_SAMSUNG
	help
	  Enable the max98090 audio codec. This is connected via I2S for
	  audio data and I2C for codec control. At present it only works
	  with the Samsung I2S driver.

config SOUND_MAX98095
	bool "Support Maxim max98095 audio codec"
	depends on I2S_SAMSUNG
	help
	  Enable the max98095 audio codec. This is connected via I2S for
	  audio data and I2C for codec control. At present it only works
	  with the Samsung I2S driver.

config SOUND_SANDBOX
	bool "Support sandbox emulated audio codec"
	depends on SANDBOX && SOUND
	help
	  U-Boot sandbox can emulate a sound device using SDL, playing the
	  sound on the host machine. This option implements the sound_init()
	  and sound_play() functions for sandbox. Note that you must install
	  the SDL libraries for this to work.

config SOUND_WM8994
	bool "Support Wolfson Micro wm8994 audio codec"
	depends on I2S_SAMSUNG
	help
	  Enable the wm8994 audio codec. This is connected via I2S for
	  audio data and I2C for codec control. At present it only works
	  with the Samsung I2S driver.

endmenu
```

## drivers/spi/Kconfig
```kconfig
menu "SPI Support"

config DM_SPI
	bool "Enable Driver Model for SPI drivers"
	depends on DM
	help
	  Enable driver model for SPI. The SPI slave interface
	  (spi_setup_slave(), spi_xfer(), etc.) is then implemented by
	  the SPI uclass. Drivers provide methods to access the SPI
	  buses that they control. The uclass interface is defined in
	  include/spi.h. The existing spi_slave structure is attached
	  as 'parent data' to every slave on each bus. Slaves
	  typically use driver-private data instead of extending the
	  spi_slave structure.

if DM_SPI

config ALTERA_SPI
	bool "Altera SPI driver"
	help
	  Enable the Altera SPI driver. This driver can be used to
	  access the SPI NOR flash on platforms embedding this Altera
	  IP core. Please find details on the "Embedded Peripherals IP
	  User Guide" of Altera.

config ATH79_SPI
	bool "Atheros SPI driver"
	depends on ARCH_ATH79
	help
	  Enable the Atheros ar7xxx/ar9xxx SoC SPI driver, it was used
	  to access SPI NOR flash and other SPI peripherals. This driver
	  uses driver model and requires a device tree binding to operate.
	  please refer to doc/device-tree-bindings/spi/spi-ath79.txt.

config ATMEL_SPI
	bool "Atmel SPI driver"
	depends on ARCH_AT91
	help
	  This enables driver for the Atmel SPI Controller, present on
	  many AT91 (ARM) chips. This driver can be used to access
	  the SPI Flash, such as AT25DF321.

config CADENCE_QSPI
	bool "Cadence QSPI driver"
	help
	  Enable the Cadence Quad-SPI (QSPI) driver. This driver can be
	  used to access the SPI NOR flash on platforms embedding this
	  Cadence IP core.

config DESIGNWARE_SPI
	bool "Designware SPI driver"
	help
	  Enable the Designware SPI driver. This driver can be used to
	  access the SPI NOR flash on platforms embedding this Designware
	  IP core.

config EXYNOS_SPI
	bool "Samsung Exynos SPI driver"
	help
	  Enable the Samsung Exynos SPI driver. This driver can be used to
	  access the SPI NOR flash on platforms embedding this Samsung
	  Exynos IP core.

config FSL_DSPI
	bool "Freescale DSPI driver"
	help
	  Enable the Freescale DSPI driver. This driver can be used to
	  access the SPI NOR flash and SPI Data flash on platforms embedding
	  this Freescale DSPI IP core. LS102xA and Colibri VF50/VF61 platforms
	  use this driver.

config ICH_SPI
	bool "Intel ICH SPI driver"
	help
	  Enable the Intel ICH SPI driver. This driver can be used to
	  access the SPI NOR flash on platforms embedding this Intel
	  ICH IP core.

config MVEBU_A3700_SPI
	bool "Marvell Armada 3700 SPI driver"
	help
	  Enable the Marvell Armada 3700 SPI driver. This driver can be
	  used to access the SPI NOR flash on platforms embedding this
	  Marvell IP core.

config PIC32_SPI
	bool "Microchip PIC32 SPI driver"
	depends on MACH_PIC32
	help
	  Enable the Microchip PIC32 SPI driver. This driver can be used
	  to access the SPI NOR flash, MMC-over-SPI on platforms based on
	  Microchip PIC32 family devices.

config ROCKCHIP_SPI
	bool "Rockchip SPI driver"
	help
	  Enable the Rockchip SPI driver, used to access SPI NOR flash and
	  other SPI peripherals (such as the Chrome OS EC) on Rockchip SoCs.
	  This uses driver model and requires a device tree binding to
	  operate.

config SANDBOX_SPI
	bool "Sandbox SPI driver"
	depends on SANDBOX && DM
	help
	  Enable SPI support for sandbox. This is an emulation of a real SPI
	  bus. Devices can be attached to the bus using the device tree
	  which specifies the driver to use. As an example, see this device
	  tree fragment from sandbox.dts. It shows that the SPI bus has a
	  single flash device on chip select 0 which is emulated by the driver
	  for "sandbox,spi-flash", which is in drivers/mtd/spi/sandbox.c.

	  spi@0 {
		#address-cells = <1>;
		#size-cells = <0>;
		reg = <0>;
		compatible = "sandbox,spi";
		cs-gpios = <0>, <&gpio_a 0>;
		flash@0 {
			reg = <0>;
			compatible = "spansion,m25p16", "sandbox,spi-flash";
			spi-max-frequency = <40000000>;
			sandbox,filename = "spi.bin";
		};
	  };

config STM32_QSPI
	bool "STM32F7 QSPI driver"
	depends on STM32F7
	help
	  Enable the STM32F7 Quad-SPI (QSPI) driver. This driver can be
	  used to access the SPI NOR flash chips on platforms embedding
	  this ST IP core.

config TEGRA114_SPI
	bool "nVidia Tegra114 SPI driver"
	help
	  Enable the nVidia Tegra114 SPI driver. This driver can be used to
	  access the SPI NOR flash on platforms embedding this nVidia Tegra114
	  IP core.

	  This controller is different than the older SoCs SPI controller and
	  also register interface get changed with this controller.

config TEGRA20_SFLASH
	bool "nVidia Tegra20 Serial Flash controller driver"
	help
	  Enable the nVidia Tegra20 Serial Flash controller driver. This driver
	  can be used to access the SPI NOR flash on platforms embedding this
	  nVidia Tegra20 IP core.

config TEGRA20_SLINK
	bool "nVidia Tegra20/Tegra30 SLINK driver"
	help
	  Enable the nVidia Tegra20/Tegra30 SLINK driver. This driver can
	  be used to access the SPI NOR flash on platforms embedding this
	  nVidia Tegra20/Tegra30 IP cores.

config TEGRA210_QSPI
	bool "nVidia Tegra210 QSPI driver"
	help
	  Enable the Tegra Quad-SPI (QSPI) driver for T210. This driver
	  be used to access SPI chips on platforms embedding this
	  NVIDIA Tegra210 IP core.

config XILINX_SPI
	bool "Xilinx SPI driver"
	help
	  Enable the Xilinx SPI driver from the Xilinx EDK. This SPI
	  controller support 8 bit SPI transfers only, with or w/o FIFO.
	  For more info on Xilinx SPI Register Definitions and Overview
	  see driver file - drivers/spi/xilinx_spi.c

config ZYNQ_SPI
	bool "Zynq SPI driver"
	depends on ARCH_ZYNQ || ARCH_ZYNQMP
	help
	  Enable the Zynq SPI driver. This driver can be used to
	  access the SPI NOR flash on platforms embedding this Zynq
	  SPI IP core.

config ZYNQ_QSPI
	bool "Zynq QSPI driver"
	depends on ARCH_ZYNQ
	help
	  Enable the Zynq Quad-SPI (QSPI) driver. This driver can be
	  used to access the SPI NOR flash on platforms embedding this
	  Zynq QSPI IP core. This IP is used to connect the flash in
	  4-bit qspi, 8-bit dual stacked and shared 4-bit dual parallel.

config OMAP3_SPI
	bool "McSPI driver for OMAP"
	help
	  SPI master controller for OMAP24XX and later Multichannel SPI
	  (McSPI). This driver be used to access SPI chips on platforms
	  embedding this OMAP3 McSPI IP core.

endif # if DM_SPI

config SOFT_SPI
	bool "Soft SPI driver"
	help
	 Enable Soft SPI driver. This driver is to use GPIO simulate
	 the SPI protocol.

config FSL_ESPI
	bool "Freescale eSPI driver"
	help
	  Enable the Freescale eSPI driver. This driver can be used to
	  access the SPI interface and SPI NOR flash on platforms embedding
	  this Freescale eSPI IP core.

config FSL_QSPI
	bool "Freescale QSPI driver"
	help
	  Enable the Freescale Quad-SPI (QSPI) driver. This driver can be
	  used to access the SPI NOR flash on platforms embedding this
	  Freescale IP core.

config TI_QSPI
	bool "TI QSPI driver"
	help
	  Enable the TI Quad-SPI (QSPI) driver for DRA7xx and AM43xx evms.
	  This driver support spi flash single, quad and memory reads.

config MPC8XX_SPI
	bool "MPC8XX SPI Driver"
	depends on 8xx
	help
	  Enable support for SPI on MPC8XX

endmenu # menu "SPI Support"
```

## drivers/spmi/Kconfig
```kconfig
menu "SPMI support"

config SPMI
	bool "Enable SPMI bus support"
	depends on DM
	---help---
	  Select this to enable to support SPMI bus.
	  SPMI (System Power Management Interface) bus is used
	  to connect PMIC devices on various SoCs.

config SPL_SPMI
	bool "Enable SPMI bus support in SPL"
	depends on SPL_DM
	help
	  Select this to enable SPMI bus support in SPL

config SPMI_MSM
	bool "Support Qualcomm SPMI bus"
	depends on SPMI
	---help---
	  Support SPMI bus implementation found on Qualcomm Snapdragon SoCs.

config SPL_SPMI_MSM
	bool "Support Qualcomm SPMI bus"
	depends on SPL_SPMI
	help
	  Support SPMI bus implementation found on Qualcomm Snapdragon SoCs
	  in SPL.

config SPMI_SANDBOX
	bool "Support for Sandbox SPMI bus"
	depends on SPMI
	---help---
	  Demo SPMI bus implementation. Emulates part of PM8916 as single
          slave (0) on bus. It has 4 GPIO peripherals, pid 0xC0-0xC3.
endmenu
```

## drivers/sysinfo/Kconfig
```kconfig
menuconfig SYSINFO
	bool "Device System Information"
	help
	  Support methods to query hardware configurations from internal
	  mechanisms (e.g. reading GPIO values, determining the presence of
	  devices on busses, etc.). This enables the usage of U-Boot with
	  modular board architectures.

if SYSINFO

config SPL_SYSINFO
	depends on SPL_DM
	bool "Enable board driver support in SPL"

config SYSINFO_GAZERBEAM
	bool "Enable sysinfo driver for the Gazerbeam board"
	help
	  Support querying device information for the gdsys Gazerbeam board.

config SYSINFO_SANDBOX
	bool "Enable sysinfo driver for the Sandbox board"
	help
	  Support querying device information for the Sandbox boards.

config SYSINFO_SMBIOS
	bool "Provide a default sysinfo driver for SMBIOS information"
	help
	  Some boards want to specify the manufacturer or product name but do
	  not need to have their own sysinfo driver. This includes a default
	  one which provides a way to specify this SMBIOS information in the
	  devicetree, without needing any board-specific functionality.

endif
```

## drivers/sysreset/Kconfig
```kconfig
#
# System reset devices
#

menu "System reset device drivers"

config SYSRESET
	bool "Enable support for system reset drivers"
	depends on DM
	help
	  Enable system reset drivers which can be used to reset the CPU or
	  board. Each driver can provide a reset method which will be called
	  to effect a reset. The uclass will try all available drivers when
	  reset_walk() is called.

if SYSRESET

config SYSRESET_PSCI
	bool "Enable support for PSCI System Reset"
	depends on ARM_PSCI_FW
	help
	  Enable PSCI SYSTEM_RESET function call.  To use this, PSCI firmware
	  must be running on your system.

endif

config SYSRESET_SYSCON
	bool "Enable support for mfd syscon reboot driver"
	select REGMAP
	select SYSCON
	help
	  Reboot support for generic SYSCON mapped register reset.

config SYSRESET_WATCHDOG
	bool "Enable support for watchdog reboot driver"
	select WDT
	help
	  Reboot support for generic watchdog reset.

endmenu
```

## drivers/tee/Kconfig
```kconfig
# Generic Trusted Execution Environment Configuration
config TEE
	bool "Trusted Execution Environment support"
	depends on ARM && (ARM64 || CPU_V7A)
	select ARM_SMCCC
	help
	  This implements a generic interface towards a Trusted Execution
	  Environment (TEE). A TEE is a trusted OS running in some secure
	  environment, for example, TrustZone on ARM cpus, or a separate
	  secure co-processor etc. See also:
	  https://en.wikipedia.org/wiki/Trusted_execution_environment

if TEE

menu "TEE drivers"

source "drivers/tee/optee/Kconfig"

endmenu

endif
```

## drivers/tee/optee/Kconfig
```kconfig
# OP-TEE Trusted Execution Environment Configuration
config OPTEE
	bool "OP-TEE"
	depends on ARM_SMCCC
	help
	  This implements the OP-TEE Trusted Execution Environment (TEE)
	  driver. OP-TEE is a Trusted OS designed primarily to rely on the
	  ARM TrustZone(R) technology as the underlying hardware isolation
	  mechanism. This driver can request services from OP-TEE, but also
	  handle Remote Procedure Calls (RPC) from OP-TEE needed to
	  execute a service. For more information see: https://www.op-tee.org
```
