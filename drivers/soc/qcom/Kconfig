## drivers/thermal/Kconfig
```kconfig
config DM_THERMAL
	bool "Driver support for thermal devices"
	help
	  Enable support for temperature-sensing devices. Some SoCs have on-chip
	  temperature sensors to permit warnings, speed throttling or even
	  automatic power-off when the temperature gets too high or low. Other
	  devices may be discrete but connected on a suitable bus.

if DM_THERMAL

config IMX_THERMAL
	bool "Temperature sensor driver for Freescale i.MX SoCs"
	depends on MX6 || MX7
	help
	  Support for Temperature Monitor (TEMPMON) found on Freescale i.MX SoCs.
	  It supports one critical trip point and one passive trip point.  The
	  cpufreq is used as the cooling device to throttle CPUs when the
	  passive trip is crossed.

config IMX_SCU_THERMAL
	bool "Temperature sensor driver for NXP i.MX8"
	depends on ARCH_IMX8
	help
	  Support for Temperature sensors on NXP i.MX8.
	  It supports one critical trip point and one passive trip point. The
	  boot is hold to the cool device to throttle CPUs when the passive
	  trip is crossed

config IMX_TMU
	bool "Thermal Management Unit driver for NXP i.MX8M / i.MX93 and QorIQ"
	depends on ARCH_IMX8M || IMX93 || FSL_LAYERSCAPE
	help
	  Support for the NXP Thermal Management Unit (TMU) sensors on
	  i.MX8M, i.MX93 and on QorIQ/Layerscape SoCs (LX2160A,
	  LS1028A, LS1088A, ...).
	  The boot is hold to the cool device to throttle CPUs when the
	  passive trip is crossed

config RCAR_GEN3_THERMAL
	bool "Renesas R-Car Gen3/Gen4 and RZ/G2 thermal driver"
	depends on ARCH_RENESAS
	depends on RCAR_64
	help
	  Enable this to plug the R-Car Gen3/Gen4 or RZ/G2 thermal sensor
	  driver into the U-Boot thermal framework.

config TI_DRA7_THERMAL
	bool "Temperature sensor driver for TI dra7xx SOCs"
	help
	  Enable thermal support for the Texas Instruments DRA752 SoC family.
	  The driver supports reading CPU temperature.

config TI_LM74_THERMAL
	bool "Temperature sensor driver for TI LM74 chip"
	help
	  Enable thermal support for the Texas Instruments LM74 chip.
	  The driver supports reading CPU temperature.

config DM_THERMAL_JC42
	bool "JEDEC JC-42.4/TSE2004av SPD temperature sensor"
	depends on DM_I2C
	help
	  Enable support for the JEDEC JC-42.4 temperature sensor found
	  on the SPD bus of DDR3 and DDR4 DIMMs (TSE2004av and compatible).

config PMBUS_THERMAL
	bool "Generic PMBus temperature"
	depends on DM_REGULATOR_PMBUS_HELPER
	help
	  Expose the die-temperature reading of any PMBus voltage
	  regulator bound by a pmbus_helper based chip driver
	  as a UCLASS_THERMAL device.

endif # if DM_THERMAL
```

## drivers/timer/Kconfig
```kconfig
menu "Timer Support"

config TIMER
	bool "Enable driver model for timer drivers"
	depends on DM
	help
	  Enable driver model for timer access. It uses the same API as
	  lib/time.c, but now implemented by the uclass. The first timer
	  will be used. The timer is usually a 32 bits free-running up
	  counter. There may be no real tick, and no timer interrupt.

config TIMER_EARLY
	bool "Allow timer to be used early in U-Boot"
	depends on TIMER
	help
	  In some cases the timer must be accessible before driver model is
	  active. Examples include when using CONFIG_TRACE to trace U-Boot's
	  execution before driver model is set up. Enable this option to
	  use an early timer. These functions must be supported by your timer
	  driver: timer_early_get_count() and timer_early_get_rate().

config ALTERA_TIMER
	bool "Altera timer support"
	depends on TIMER
	help
	  Select this to enable a timer for Altera devices. Please find
	  details on the "Embedded Peripherals IP User Guide" of Altera.

config SANDBOX_TIMER
	bool "Sandbox timer support"
	depends on SANDBOX && TIMER
	help
	  Select this to enable an emulated timer for sandbox. It gets
	  time from host os.

config X86_TSC_TIMER
	bool "x86 Time-Stamp Counter (TSC) timer support"
	depends on TIMER && X86
	default y if X86
	help
	  Select this to enable Time-Stamp Counter (TSC) timer for x86.

config OMAP_TIMER
	bool "Omap timer support"
	depends on TIMER
	help
	  Select this to enable an timer for Omap devices.

config AST_TIMER
	bool "Aspeed ast2400/ast2500 timer support"
	depends on TIMER
	default y if ARCH_ASPEED
	help
	  Select this to enable timer for Aspeed ast2400/ast2500 devices.
	  This is a simple sys timer driver, it is compatible with lib/time.c,
	  but does not support any interrupts. Even though SoC has 8 hardware
	  counters, they are all treated as a single device by this driver.
	  This is mostly because they all share several registers which
	  makes it difficult to completely separate them.

config STI_TIMER
	bool "STi timer support"
	depends on TIMER
	default y if ARCH_STI
	help
	  Select this to enable a timer for STi devices.

config ARC_TIMER
	bool "ARC timer support"
	depends on TIMER && ARC && CLK
	help
	  Select this to enable built-in ARC timers.
	  ARC cores may have up to 2 built-in timers: timer0 and timer1,
	  usually at least one of them exists. Either of them is supported
	  in U-Boot.

endmenu
```

## drivers/tpm/Kconfig
```kconfig
#
# TPM subsystem configuration
#

menu "TPM support"

config TPM_TIS_SANDBOX
	bool "Enable sandbox TPM driver"
	depends on SANDBOX
	help
	  This driver emulates a TPM, providing access to base functions
	  such as reading and writing TPM private data. This is enough to
	  support Chrome OS verified boot. Extend functionality is not
	  implemented.

config TPM_ATMEL_TWI
	bool "Enable Atmel TWI TPM device driver"
	depends on TPM
	help
	  This driver supports an Atmel TPM device connected on the I2C bus.
	  The usual tpm operations and the 'tpm' command can be used to talk
	  to the device using the standard TPM Interface Specification (TIS)
	  protocol

config TPM_TIS_INFINEON
	bool "Enable support for Infineon SLB9635/45 TPMs on I2C"
	depends on TPM && DM_I2C
	help
	  This driver supports Infineon TPM devices connected on the I2C bus.
	  The usual tpm operations and the 'tpm' command can be used to talk
	  to the device using the standard TPM Interface Specification (TIS)
	  protocol

config TPM_TIS_I2C_BURST_LIMITATION
	bool "Enable I2C burst length limitation"
	depends on TPM_TIS_INFINEON
	help
	  Some broken TPMs have a limitation on the number of bytes they can
	  receive in one message. Enable this option to allow you to set this
	  option. The can allow a broken TPM to be used by splitting messages
	  into separate pieces.

config TPM_TIS_I2C_BURST_LIMITATION_LEN
	int "Length"
	depends on TPM_TIS_I2C_BURST_LIMITATION
	help
	  Use this to set the burst limitation length

config TPM_TIS_LPC
	bool "Enable support for Infineon SLB9635/45 TPMs on LPC"
	depends on TPM && X86
	help
	  This driver supports Infineon TPM devices connected on the LPC bus.
	  The usual tpm operations and the 'tpm' command can be used to talk
	  to the device using the standard TPM Interface Specification (TIS)
	  protocol

config TPM_AUTH_SESSIONS
	bool "Enable TPM authentication session support"
	depends on TPM
	help
	  Enable support for authorised (AUTH1) commands as specified in the
	  TCG Main Specification 1.2. OIAP-authorised versions of the commands
	  TPM_LoadKey2 and TPM_GetPubKey are provided. Both features are
	  available using the 'tpm' command, too.

config TPM_ST33ZP24_I2C
	bool "STMicroelectronics ST33ZP24 I2C TPM"
	depends on TPM && DM_I2C
	---help---
	  This driver supports STMicroelectronics TPM devices connected on the I2C bus.
	  The usual tpm operations and the 'tpm' command can be used to talk
	  to the device using the standard TPM Interface Specification (TIS)
	  protocol

config TPM_ST33ZP24_SPI
	bool "STMicroelectronics ST33ZP24 SPI TPM"
	depends on TPM && DM_SPI
	---help---
	  This driver supports STMicroelectronics TPM devices connected on the SPI bus.
	  The usual tpm operations and the 'tpm' command can be used to talk
	  to the device using the standard TPM Interface Specification (TIS)
	  protocol

config TPM_FLUSH_RESOURCES
	bool "Enable TPM resource flushing support"
	depends on TPM
	help
	  Enable support to flush specific resources (e.g. keys) from the TPM.
	  The functionality is available via the 'tpm' command as well.

config TPM_LOAD_KEY_BY_SHA1
	bool "Enable TPM key loading by SHA1 support"
	depends on TPM
	help
	  Enable support to load keys into the TPM by identifying
	  their parent via the public key's SHA1 hash.
	  The functionality is available via the 'tpm' command as well.

config TPM_LIST_RESOURCES
	bool "Enable TPM resource listing support"
	depends on TPM
	help
	  Enable support to list specific resources (e.g. keys) within the TPM.
	  The functionality is available via the 'tpm' command as well.
endmenu
```

## drivers/ufs/Kconfig
```kconfig
menu "UFS Host Controller Support"

config UFS
	bool "Support UFS controllers"
	depends on SCSI
	select CHARSET
	help
	  This selects support for Universal Flash Subsystem (UFS).
	  Say Y here if you want UFS Support.

config UFS_AMD_VERSAL2
	bool "AMD Versal Gen 2 UFS controller platform driver"
	depends on UFS && ZYNQMP_FIRMWARE
	help
	  This selects the AMD specific additions to UFSHCD platform driver.
	  UFS host on AMD needs some vendor specific configuration before accessing
	  the hardware.

config UFS_CADENCE
	bool "Cadence platform driver for UFS"
	depends on UFS
        help
	  This selects the platform driver for the Cadence UFS host
	  controller present on present TI's J721e devices.

config UFS_MEDIATEK
	tristate "MediaTek UFS Host Controller Driver"
	depends on UFS && ARCH_MEDIATEK
	select PHY_MTK_UFS
	help
	  This selects the MediaTek specific additions to UFSHCD platform driver.
	  UFS host on Mediatek needs some vendor specific configuration before
	  accessing the hardware which includes PHY configuration and vendor
	  specific registers.

	  Select this if you have UFS controller on MediaTek chipset.

	  If unsure, say N.

config UFS_PCI
	bool "PCI bus based UFS Controller support"
	depends on PCI && UFS
	help
	  This selects the PCI UFS Host Controller Interface. Select this if
	  you have UFS Host Controller with PCI Interface.

	  If you have a controller with this interface, say Y here.

	  If unsure, say N.

config UFS_QCOM
	bool "Qualcomm Host Controller driver for UFS"
	depends on UFS && ARCH_SNAPDRAGON
        help
	  This selects the platform driver for the UFS host
	  controller present on Qualcomm Snapdragon SoCs.

config UFS_RENESAS
	bool "Renesas R-Car S4 UFS Controller support"
	depends on UFS
	select BOUNCE_BUFFER
	help
	  This selects the Renesas S4 specific additions to UFSHCD
	  platform driver. UFS host on Renesas needs some vendor
	  specific configuration before accessing the hardware.

config UFS_RENESAS_GEN5
	bool "Renesas R-Car X5H UFS Controller support"
	depends on UFS
	select BOUNCE_BUFFER
	help
	  This selects the Renesas X5H specific additions to UFSHCD
	  platform driver. UFS host on Renesas needs some vendor
	  specific configuration before accessing the hardware.

config UFS_ROCKCHIP
	bool "Rockchip specific hooks to UFS controller platform driver"
	depends on UFS
	help
	  This selects the Rockchip specific additions to UFSHCD platform driver.

	  Select this if you have UFS controller on Rockchip chipset.
	  If unsure, say N.

config UFS_TI_J721E
	bool "Glue Layer driver for UFS on TI J721E devices"
	help
	  This selects the glue layer driver for Cadence controller
	  present on TI's J721E devices.

endmenu
```

## drivers/usb/Kconfig
```kconfig
config USB_ARCH_HAS_HCD
	def_bool y

config USB
	bool "Support for Host-side USB"
	depends on USB_ARCH_HAS_HCD
	---help---
	  Universal Serial Bus (USB) is a specification for a serial bus
	  subsystem which offers higher speeds and more features than the
	  traditional PC serial port.  The bus supplies power to peripherals
	  and allows for hot swapping.  Up to 127 USB peripherals can be
	  connected to a single USB host in a tree structure.

	  The USB host is the root of the tree, the peripherals are the
	  leaves and the inner nodes are special USB devices called hubs.
	  Most PCs now have USB host ports, used to connect peripherals
	  such as scanners, keyboards, mice, modems, cameras, disks,
	  flash memory, network links, and printers to the PC.

	  Say Y here if your computer has a host-side USB port and you want
	  to use USB devices.  You then need to say Y to at least one of the
	  Host Controller Driver (HCD) options below.  Choose a USB 1.1
	  controller, such as "UHCI HCD support" or "OHCI HCD support",
	  and "EHCI HCD (USB 2.0) support" except for older systems that
	  do not have USB 2.0 support.  It doesn't normally hurt to select
	  them all if you are not certain.

	  If your system has a device-side USB port, used in the peripheral
	  side of the USB protocol, see the "USB Gadget" framework instead.

	  After choosing your HCD, then select drivers for the USB peripherals
	  you'll be using.  You may want to check out the information provided
	  in <file:Documentation/usb/> and especially the links given in
	  <file:Documentation/usb/usb-help.txt>.

if USB

config DM_USB
	bool "Enable driver model for USB"
	depends on USB && DM
	help
	  Enable driver model for USB. The USB interface is then implemented
	  by the USB uclass. Multiple USB controllers of different types
	  (XHCI, EHCI) can be attached and used. The 'usb' command works as
	  normal. OCHI is not supported at present.

	  Much of the code is shared but with this option enabled the USB
	  uclass takes care of device enumeration. USB devices can be
	  declared with the USB_DEVICE() macro and will be automatically
	  probed when found on the bus.

source "drivers/usb/host/Kconfig"

source "drivers/usb/emul/Kconfig"

config USB_STORAGE
	bool "USB Mass Storage support"
	---help---
	  Say Y here if you want to connect USB mass storage devices to your
	  board's USB port.

endif
```

## drivers/usb/dwc3/Kconfig
```kconfig
config USB_DWC3
	bool "DesignWare USB3 DRD Core Support"
	depends on (USB && USB_GADGET)
	select USB_GADGET_DUALSPEED
	help
	  Say Y here if your system has a Dual Role SuperSpeed
	  USB controller based on the DesignWare USB3 IP Core.

if USB_DWC3

choice
	bool "DWC3 Mode Selection"

config USB_DWC3_HOST
	bool "Host only mode"
	depends on USB
	help
	  Select this when you want to use DWC3 in host mode only,
	  thereby the gadget feature will be regressed.

config USB_DWC3_GADGET
	bool "Gadget only mode"
	depends on USB_GADGET
	help
	  Select this when you want to use DWC3 in gadget mode only,
	  thereby the host feature will be regressed.

endchoice

comment "Platform Glue Driver Support"

config USB_DWC3_OMAP
	bool "Texas Instruments OMAP5 and similar Platforms"
	help
	  Some platforms from Texas Instruments like OMAP5, DRA7xxx and
	  AM437x use this IP for USB2/3 functionality.

	  Say 'Y' here if you have one such device

endif
```

## drivers/usb/eth/Kconfig
```kconfig
menuconfig USB_HOST_ETHER
	bool "USB to Ethernet Controller Drivers"
	---help---
	  Say Y here if you would like to enable support for USB Ethernet
	  adapters.

if USB_HOST_ETHER

config USB_ETHER_LAN75XX
	bool "Microchip LAN75XX support"
	depends on USB_HOST_ETHER
	---help---
	  Say Y here if you would like to support Microchip LAN75XX Hi-Speed
	  USB 2.0 to 10/100/1000 Gigabit Ethernet controller.
	  Supports 10Base-T/ 100Base-TX/1000Base-T.
	  This driver supports the internal PHY.

config USB_ETHER_LAN78XX
	bool "Microchip LAN78XX support"
	depends on USB_HOST_ETHER
	---help---
	  Say Y here if you would like to support Microchip LAN78XX USB 3.1
	  Gen 1 to 10/100/1000 Gigabit Ethernet controller.
	  Supports 10Base-T/ 100Base-TX/1000Base-T.
	  This driver supports the internal PHY.

endif
```
