## drivers/usb/mtu3/Kconfig
```kconfig
# SPDX-License-Identifier: GPL-2.0
#
# For MTK USB3.0 IP

config USB_MTU3
	bool "MediaTek USB3 Dual Role controller"
	depends on USB_XHCI_HCD || USB_GADGET
	depends on ARCH_MEDIATEK
	help
	  Say Y here if your system runs on MediaTek SoCs with
	  Dual Role SuperSpeed USB controller. You can select usb
	  mode as peripheral role or host role.

	  If you don't know what this is, please say N.

if USB_MTU3
choice
	bool "MTU3 Mode Selection"
	default USB_MTU3_GADGET if USB_GADGET
	default USB_MTU3_HOST if (USB_HOST && !USB_GADGET)

config USB_MTU3_HOST
	bool "Host only mode"
	depends on USB_XHCI_HCD
	help
	  Select this when you want to use MTU3 in host mode only,
	  thereby the gadget feature will be regressed.

config USB_MTU3_GADGET
	bool "Gadget only mode"
	depends on USB_GADGET
	select USB_GADGET_DUALSPEED
	help
	  Select this when you want to use MTU3 in gadget mode only,
	  thereby the host feature will be regressed.

endchoice

config USB_MTU3_DEBUG
	bool "Enable Debugging Messages"
	help
	  Say Y here to enable debugging messages in the MTU3 Driver.

endif

config SPL_USB_MTU3
	bool "MediaTek USB3 controller support in SPL"
	depends on ARCH_MEDIATEK
	depends on SPL_DM_USB
	depends on SPL_USB_HOST || (SPL_DM_USB_GADGET && SPL_USB_GADGET)
	help
	  Enable the MediaTek USB3 controller in SPL. Select host or peripheral
	  mode below.

if SPL_USB_MTU3

choice
	bool "MTU3 SPL Mode Selection"
	default SPL_USB_MTU3_GADGET if SPL_USB_GADGET
	default SPL_USB_MTU3_HOST if (SPL_USB_HOST && !SPL_USB_GADGET)
	help
	  Select whether the MTU3 controller operates as an xHCI host or a USB
	  peripheral in SPL.

config SPL_USB_MTU3_HOST
	bool "Host mode in SPL"
	depends on SPL_USB_HOST && USB_XHCI_HCD
	select SPL_OF_TRANSLATE
	help
	  Enable the MTU3 xHCI host controller in SPL so USB devices can be
	  accessed before U-Boot proper starts.

config SPL_USB_MTU3_GADGET
	bool "Gadget mode in SPL"
	depends on SPL_DM_USB_GADGET && SPL_USB_GADGET
	select USB_GADGET_DUALSPEED
	help
	  Enable the MTU3 peripheral controller in SPL so USB gadget
	  functions can use it before U-Boot proper starts.

endchoice

endif
```

## drivers/video/mediatek/Kconfig
```kconfig
# SPDX-License-Identifier: GPL-2.0-only
#
# Copyright (c) 2026 BayLibre, SAS
#
# Author: Julien Stephan <jstephan@baylibre.com>

# Display pipeline component helpers, selected by the output paths below
config VIDEO_MEDIATEK_DISP_COMP
	bool

# mmsys routing, overlay and display RDMA, shared by the DSI and eDP paths
config VIDEO_MEDIATEK_DISP_PIPELINE
	bool

# DPI timing generator programming, shared by the DPI and HDMI paths
config VIDEO_MEDIATEK_DPI
	bool

config VIDEO_MEDIATEK_DSI
	bool "DSI video path for MediaTek SoCs"
	depends on VIDEO && ARCH_MEDIATEK
	depends on ARM64 && CLK && PHY && POWER_DOMAIN
	select MISC
	select MTK_SMI
	select PANEL
	select PHY_MTK_MIPI_DSI
	select SYSCON
	select VIDEO_MEDIATEK_DISP_COMP
	select VIDEO_MEDIATEK_DISP_PIPELINE
	select VIDEO_MIPI_DSI
	help
	  Enable support for the DSI controller found on MediaTek SoCs such
	  as the MT8365 and the MT8366. The driver drives the mmsys display
	  pipeline (overlay, RDMA and, on the SoCs having one, the colour
	  pipeline) to scan out the U-Boot framebuffer to a DSI panel.

# DVO output stage, the eDP path's replacement for the DPI/DP_INTF block
config VIDEO_MEDIATEK_DVO
	bool
	select MISC
	select VIDEO_MEDIATEK_DISP_COMP

config VIDEO_MEDIATEK_EDP
	bool "eDP video path for MediaTek SoCs"
	depends on VIDEO && ARCH_MEDIATEK
	depends on ARM64 && CLK && PHY && POWER_DOMAIN
	select ARM_SMCCC
	select BACKLIGHT
	select DM_REGULATOR
	select I2C_EDID
	select MISC
	select MTK_SMI
	select PHY_MTK_DP
	select SYSCON
	select VIDEO_MEDIATEK_DISP_COMP
	select VIDEO_MEDIATEK_DISP_PIPELINE
	select VIDEO_MEDIATEK_DVO
	help
	  Enable support for the embedded DisplayPort output found on
	  MediaTek SoCs such as the MT8189. The driver drives the vdosys0
	  display pipeline (OVL, RDMA, DVO) and the eDP transmitter, reads
	  the EDID of the attached panel over the AUX channel and scans out
	  the U-Boot framebuffer to it.

config VIDEO_MEDIATEK_HDMI
	bool "Video HDMI Support for MediaTek SoCs"
	depends on VIDEO && ARCH_MEDIATEK
	depends on ARM64 && CLK && DM_I2C && PHY && POWER_DOMAIN
	select I2C_EDID
	select MISC
	select MTK_SMI
	select PHY_MTK_HDMI
	select SYS_I2C_DDC_MTK
	select VIDEO_MEDIATEK_DISP_COMP
	select VIDEO_MEDIATEK_DPI
	help
	  Enable support for the HDMI TX output found on recent MediaTek
	  SoCs such as the MT8188. The driver reads the EDID of the
	  connected display, selects its preferred mode and drives the
	  vdosys1 display pipeline (MDP RDMA, padding, merge, ETHDR
	  mixer, DPI) to scan out the U-Boot framebuffer over HDMI.
```

## fs/9p/Kconfig
```kconfig
config FS_9P
	bool "9P filesystem support"
	depends on NET_9P
	help
	  This provides support for the 9P2000.L filesystem.

	  To use this filesystem, you also need to enable a 9P
	  transport driver.
```

## net/9p/Kconfig
```kconfig
config NET_9P
	bool "9P2000.L protocol support"
	help
	  This enables support for the 9P network protocol (9P2000.L).
	  It implements the core 9P2000.L client and protocol handling.
```

## test/py/tests/vboot/sign-configs-sha1.its
```
/dts-v1/;

/ {
	description = "Chrome OS kernel image with one or more FDT blobs";
	#address-cells = <1>;

	images {
		kernel {
			data = /incbin/("test-kernel.bin");
			type = "kernel_noload";
			arch = "sandbox";
			os = "linux";
			compression = "none";
			load = <0x4>;
			entry = <0x8>;
			kernel-version = <1>;
			hash-1 {
				algo = "sha1";
			};
		};
		fdt-1 {
			description = "snow";
			data = /incbin/("sandbox-kernel.dtb");
			type = "flat_dt";
			arch = "sandbox";
			compression = "none";
			fdt-version = <1>;
			hash-1 {
				algo = "sha1";
			};
		};
		firmware {
			data = /incbin/("test-kernel.bin");
			type = "firmware";
			arch = "sandbox";
			os = "u-boot";
			compression = "none";
			hash-1 {
				algo = "sha1";
			};
		};
	};
	configurations {
		default = "conf-1";
		conf-1 {
			kernel = "kernel";
			fdt = "fdt-1";
			firmware = "firmware";
			signature {
				algo = "sha1,rsa2048";
				key-name-hint = "dev";
				sign-images = "fdt", "kernel";
			};
		};
	};
};
```
