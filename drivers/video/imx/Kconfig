## drivers/video/imx/Kconfig
```kconfig
config VIDEO_IPUV3
	bool "i.MX IPUv3 Core video support"
	depends on VIDEO && (MX5 || MX6)
	imply VIDEO_DAMAGE
	help
	  This enables framebuffer driver for i.MX processors working
	  on the IPUv3(Image Processing Unit) internal graphic processor.

config IMX_VIDEO_SKIP
	bool "Enable calling board_video_skip function"
	depends on VIDEO_IPUV3

config IMX_HDMI
	bool "Enable HDMI support in IPUv3"
	depends on VIDEO_IPUV3

config IMX_LDB
	bool "Freescale i.MX8MP LDB bridge"
	depends on VIDEO_BRIDGE
	help
	  Support for i.MX8MP DPI-to-LVDS on-SoC encoder.

config IMX_LCDIF
	bool "i.MX LCDIFv3 LCD controller"
```

## drivers/video/tegra/Kconfig
```kconfig
config HOST1X_TEGRA
	bool "NVIDIA Tegra host1x BUS support"
	depends on SIMPLE_BUS

config VIDEO_TEGRA
	bool "Enable Display Controller support on Tegra devices"
	depends on OF_CONTROL
	select HOST1X_TEGRA
	help
	   Enable support for Display Controller found in Tegra SoC. The
	   Display Controller Complex integrates two independent display
	   controllers. Each display controller is capable of interfacing
	   to an external display device, which can be a parallel interface
	   or SPI LCD, DVI, an HDMI HDTV, RGB monitor or a MIPI DSI LCD.
	   Direct interface is supported directly to most LCD displays with
	   TFT or TFT-like interface.

config VIDEO_DSI_TEGRA
	bool "Enable DSI controller support on Tegra devices"
	depends on VIDEO_BRIDGE && PANEL && DM_GPIO
	select VIDEO_TEGRA
	select VIDEO_MIPI_DSI
	help
	   Enable support for the Display Serial Interface (DSI) found in
	   Tegra SoC. It is a MIPI standard serial bitstream, intended to
	   provide a low pin count interface to a display panel.

config VIDEO_HDMI_TEGRA
	bool "Enable HDMI support on Tegra devices"
	depends on VIDEO_BRIDGE && DM_I2C
	select I2C_EDID
	select VIDEO_TEGRA
	help
	   Enable support for the High-Definition Multimedia Interface (HDMI)
	   found in Tegra SoC.

config TEGRA_BACKLIGHT_PWM
	bool "Enable Tegra DC PWM backlight support"
	depends on BACKLIGHT
	select VIDEO_TEGRA
	help
	   Enable support for the Display Controller dependent PWM backlight
	   found in the Tegra SoC and usually used with DSI panels.

config TEGRA_8BIT_CPU_BRIDGE
	bool "Enable 8 bit panel communication protocol for Tegra 20/30"
	depends on VIDEO_BRIDGE && DM_GPIO
	select VIDEO_TEGRA
	select VIDEO_MIPI_DSI
	help
	   Tegra 20 and Tegra 30 feature 8 bit CPU driver panel control
	   protocol. This option allows use it as a MIPI DSI bridge to
	   set up and control compatible panel.

config VIDEO_TEGRA124
	bool "Enable video support on Tegra124"
	imply VIDEO_DAMAGE
	help
	   Tegra124 supports many video output options including eDP and
	   HDMI. At present only eDP is supported by U-Boot. This option
	   enables this support which can be used on devices which
	   have an eDP display connected.
```

## drivers/video/tegra20/Kconfig
```kconfig
config VIDEO_TEGRA20
	bool "Enable Display Controller support on Tegra20 and Tegra 30"
	depends on OF_CONTROL
	help
	   T20/T30 support video output to an attached LCD panel as well as
	   other options such as HDMI. Only the LCD is supported in U-Boot.
	   This option enables this support which can be used on devices which
	   have an LCD display connected.
```

## drivers/video/ti/Kconfig
```kconfig
# SPDX-License-Identifier: GPL-2.0+
#
# Copyright (C) 2020 Dario Binacchi <dariobin@libero.it>
#
config AM335X_LCD
	bool "Enable AM335x video support"
	depends on ARCH_OMAP2PLUS
	help
	   Supports video output to an attached LCD panel.
```

## drivers/virtio/Kconfig
```kconfig
# SPDX-License-Identifier: GPL-2.0+
#
# Copyright (C) 2018, Tuomas Tynkkynen <tuomas.tynkkynen@iki.fi>
# Copyright (C) 2018, Bin Meng <bmeng.cn@gmail.com>
#
# VirtIO is a virtualization standard for network and disk device drivers
# where just the guest's device driver "knows" it is running in a virtual
# environment, and cooperates with the hypervisor. This enables guests to
# get high performance network and disk operations, and gives most of the
# performance benefits of paravirtualization. In the U-Boot case, the guest
# is U-Boot itself, while the virtual environment are normally QEMU targets
# like ARM, RISC-V and x86.
#
# See http://docs.oasis-open.org/virtio/virtio/v1.0/virtio-v1.0.pdf for
# the VirtIO specification v1.0.

menu "VirtIO Drivers"

config VIRTIO
	bool
	help
	  This option is selected by any driver which implements the virtio
	  transport, such as CONFIG_VIRTIO_MMIO or CONFIG_VIRTIO_PCI.

endmenu
```

## drivers/w1-eeprom/Kconfig
```kconfig
#
# EEPROM subsystem configuration
#

menu "1-wire EEPROM support"

config W1_EEPROM
	bool "Enable support for EEPROMs on 1wire interface"
	depends on DM
	help
	  Support for the EEPROMs connected on 1-wire Dallas protocol interface

if W1_EEPROM

config W1_EEPROM_DS24XXX
	bool "Enable Maxim DS24 families EEPROM support"
	depends on W1
	help
	  Maxim DS24 EEPROMs 1-Wire EEPROM support

config W1_EEPROM_SANDBOX
	bool "Enable sandbox onewire EEPROM driver"
	depends on W1
	help
	  Sandbox driver for a onewire EEPROM memory

endif

endmenu
```

## drivers/w1/Kconfig
```kconfig
#
# W1 subsystem configuration
#

menu "1-Wire support"

config W1
	bool "Enable 1-wire controllers support"
	default no
	depends on DM
	help
	  Support for the Dallas 1-Wire bus.

if W1

endif

endmenu
```

## drivers/watchdog/Kconfig
```kconfig
menu "Watchdog Timer Support"

config WATCHDOG
	bool "Enable U-Boot watchdog reset"
	help
	  This option enables U-Boot watchdog support where U-Boot is using
	  watchdog_reset function to service watchdog device in U-Boot. Enable
	  this option if you want to service enabled watchdog by U-Boot. Disable
	  this option if you want U-Boot to start watchdog but never service it.

config HW_WATCHDOG
	bool

config WATCHDOG_RESET_DISABLE
	bool "Disable reset watchdog"
	help
	   Disable reset watchdog, which can let WATCHDOG_RESET invalid, so
	   that the watchdog will not be fed in u-boot.

config BCM2835_WDT
	bool "Enable BCM2835/2836 watchdog driver"
	select HW_WATCHDOG
	help
	  Say Y here to enable the BCM2835/2836 watchdog

	  This provides basic infrastructure to support BCM2835/2836 watchdog
	  hardware, with a max timeout of ~15secs.

config OMAP_WATCHDOG
	bool "TI OMAP watchdog driver"
	depends on ARCH_OMAP2PLUS
	select HW_WATCHDOG
	default y if AM33XX
	help
	  Say Y here to enable the OMAP3+ watchdog driver.

config TANGIER_WATCHDOG
	bool "Intel Tangier watchdog"
	depends on INTEL_MID
	select HW_WATCHDOG
	help
	  This enables support for watchdog controller available on
	  Intel Tangier SoC. If you're using a board with Intel Tangier
	  SoC, say Y here.

config ULP_WATCHDOG
	bool "i.MX7ULP watchdog"
	help
	  Say Y here to enable i.MX7ULP watchdog driver.

config WDT
	bool "Enable driver model for watchdog timer drivers"
	depends on DM
	help
	  Enable driver model for watchdog timer. At the moment the API
	  is very simple and only supports four operations:
	  start, restart, stop and reset (expire immediately).
	  What exactly happens when the timer expires is up to a particular
	  device/driver.

config WDT_SANDBOX
	bool "Enable Watchdog Timer support for Sandbox"
	depends on SANDBOX && WDT
	help
	  Enable Watchdog Timer support in Sandbox. This is a dummy device that
	  can be probed and supports all of the methods of WDT, but does not
	  really do anything.

config WDT_ARMADA_37XX
	bool "Marvell Armada 37xx watchdog timer support"
	depends on WDT && ARMADA_3700
	help
	   Enable this to support Watchdog Timer on Marvell Armada 37xx SoC.
	   There are 4 possible clocks which can be used on these SoCs. This
	   driver uses the second clock (ID 1), assuming that so will also
	   Linux's driver.

config WDT_ASPEED
	bool "Aspeed ast2400/ast2500 watchdog timer support"
	depends on WDT
	default y if ARCH_ASPEED
	help
	  Select this to enable watchdog timer for Aspeed ast2500/ast2400 devices.
	  The watchdog timer is stopped when initialized. It performs reset, either
	  full SoC reset or CPU or just some peripherals, based on the flags.
	  It currently does not support Boot Flash Addressing Mode Detection or
	  Second Boot.

config WDT_BCM6345
	bool "BCM6345 watchdog timer support"
	depends on WDT && (ARCH_BMIPS || ARCH_BCM6858 || ARCH_BCM63158)
	help
	  Select this to enable watchdog timer for BCM6345 SoCs.
	  The watchdog timer is stopped when initialized.
	  It performs full SoC reset.

config WDT_ORION
	bool "Orion watchdog timer support"
	depends on WDT
	help
	   Select this to enable Orion watchdog timer, which can be found on some
	   Marvell Armada chips.

config WDT_CDNS
	bool "Cadence watchdog timer support"
	depends on WDT
	imply WATCHDOG
	help
	   Select this to enable Cadence watchdog timer, which can be found on some
	   Xilinx Microzed Platform.

config WDT_MTK
	bool "MediaTek watchdog timer support"
	depends on WDT && ARCH_MEDIATEK
	help
	  Select this to enable watchdog timer for MediaTek SoCs.
	  The watchdog timer is stopped when initialized.
	  It performs full SoC reset.

config XILINX_TB_WATCHDOG
	bool "Xilinx Axi watchdog timer support"
	depends on WDT
	imply WATCHDOG
	help
	   Select this to enable Xilinx Axi watchdog timer, which can be found on some
	   Xilinx Microblaze Platforms.

config IMX_WATCHDOG
	bool "Enable Watchdog Timer support for IMX and LSCH2 of NXP"
	select HW_WATCHDOG
	help
	   Select this to enable the IMX and LSCH2 of Layerscape watchdog
	   driver.

config WDT_AT91
	bool "AT91 watchdog timer support"
	depends on WDT
	help
	   Select this to enable Microchip watchdog timer, which can be found on
	   some AT91 devices.

config AT91_HW_WDT_TIMEOUT
	bool "AT91 watchdog timeout specified"
	depends on WDT_AT91

config WDT_MT7621
	bool "MediaTek MT7621 watchdog timer support"
	depends on WDT && ARCH_MT7620
	help
	   Select this to enable Ralink / Mediatek watchdog timer,
	   which can be found on some MediaTek chips.

config WDT_MPC8xx
	bool "MPC8xx watchdog timer support"
	depends on WDT && MPC8xx
	select CONFIG_MPC8xx_WATCHDOG
	help
	   Select this to enable mpc8xx watchdog timer

endmenu
```

## drivers/xen/Kconfig
```kconfig
config PVBLOCK
	bool "Xen para-virtualized block device"
	depends on DM
	select BLK
	select HAVE_BLOCK_DEVICE
	help
	  This driver implements the front-end of the Xen virtual
	  block device driver. It communicates with a back-end driver
	  in another domain which drives the actual block device.
```

## dts/Kconfig
```kconfig
#
# Device Tree Control
#

config SUPPORT_OF_CONTROL
	bool

menu "Device Tree Control"
	depends on SUPPORT_OF_CONTROL

config OF_CONTROL
	bool "Run-time configuration via Device Tree"
	help
	  This feature provides for run-time configuration of U-Boot
	  via a flattened device tree.

config SPL_OF_CONTROL
	bool "Enable run-time configuration via Device Tree in SPL"
	depends on SPL && OF_CONTROL
	help
	  Some boards use device tree in U-Boot but only have 4KB of SRAM
	  which is not enough to support device tree. Enable this option to
	  allow such boards to be supported by U-Boot SPL.

choice
	prompt "Provider of DTB for DT control"
	depends on OF_CONTROL

config OF_SEPARATE
	bool "Separate DTB for DT control"
	depends on !SANDBOX
	help
	  If this option is enabled, the device tree will be built and
	  placed as a separate u-boot.dtb file alongside the U-Boot image.

config OF_EMBED
	bool "Embedded DTB for DT control"
	help
	  If this option is enabled, the device tree will be picked up and
	  built into the U-Boot image. This is suitable for local debugging
	  and development only and is not recommended for production devices.
	  Boards in the mainline U-Boot tree should not use it.

config OF_HOSTFILE
	bool "Host filed DTB for DT control"
	depends on SANDBOX
	help
	  If this option is enabled, DTB will be read from a file on startup.
	  This is only useful for Sandbox.  Use the -d flag to U-Boot to
	  specify the file to read.

endchoice

config DEFAULT_DEVICE_TREE
	string "Default Device Tree for DT control"
	depends on OF_CONTROL
	help
	  This option specifies the default Device Tree used for DT control.
	  It can be overridden from the command line:
	  $ make DEVICE_TREE=<device-tree-name>

config OF_LIST
	string "List of device tree files to include for DT control"
	depends on SPL_LOAD_FIT
	help
	  This option specifies a list of device tree files to use for DT
	  control. These will be packaged into a FIT. At run-time, SPL will
	  select the correct DT to use by examining the hardware (e.g.
	  reading a board ID value). This is a list of device tree files
	  (without the directory or .dtb suffix) separated by <space>.

config OF_SPL_REMOVE_PROPS
	string "List of device tree properties to drop for SPL"
	depends on SPL_OF_CONTROL
	default "interrupt-parent" if SPL_PINCTRL_FULL && SPL_CLK
	default "clocks clock-names interrupt-parent" if SPL_PINCTRL_FULL
	default "pinctrl-0 pinctrl-names interrupt-parent" if SPL_CLK
	default "pinctrl-0 pinctrl-names clocks clock-names interrupt-parent"
	help
	  Since SPL normally runs in a reduced memory space, the device tree
	  is cut down to only what is needed to load and start U-Boot. Only
	  nodes marked with the property "u-boot,dm-pre-reloc" will be
	  included. In addition, some properties are not used by U-Boot and
	  can be discarded. This option defines the list of properties to
	  discard.

endmenu
```
