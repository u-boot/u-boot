## net-lwip/Kconfig
```kconfig
#
# Network configuration (with lwIP stack)
#

config LWIP_DEBUG
	bool "Enable debug traces in the lwIP library"

config LWIP_ASSERT
	bool "Enable assertions in the lwIP library"

config PROT_DHCP_LWIP
	bool "DHCP support in lwIP"
	depends on PROT_UDP_LWIP
	help
	  Enable support for the DHCP protocol in lwIP.

config PROT_DNS_LWIP
	bool
	depends on PROT_UDP_LWIP

config PROT_RAW_LWIP
	bool

config PROT_TCP_LWIP
	bool

config PROT_UDP_LWIP
	bool

config BOOTDEV_ETH
        bool "Enable bootdev for ethernet"
        depends on BOOTSTD
        default y
        help
          Provide a bootdev for ethernet so that is it possible to boot
          an operating system over the network, using the PXE (Preboot
          Execution Environment) protocol.
```

## net/Kconfig
```kconfig
#
# Network configuration
#

menuconfig NET
	bool "Networking support"
	default y

if NET

config PROT_UDP
	bool "Enable generic udp framework"
	help
	  Enable a generic udp framework that allows defining a custom
	  handler for udp protocol.

config BOOTP_SEND_HOSTNAME
	bool "Send hostname to DNS server"
	help
	  Some DHCP servers are capable to do a dynamic update of a
	  DNS server. To do this, they need the hostname of the DHCP
	  requester.
	  If CONFIG_BOOTP_SEND_HOSTNAME is defined, the content
          of the "hostname" environment variable is passed as
          option 12 to the DHCP server.

config NET_RANDOM_ETHADDR
	bool "Random ethaddr if unset"
	help
	  Selecting this will allow the Ethernet interface to function
	  even when the ethaddr variable for that interface is unset.
	  A new MAC address will be generated on every boot and it will
	  not be added to the environment.

config NETCONSOLE
	bool "NetConsole support"
	help
	  Support the 'nc' input/output device for networked console.
	  See README.NetConsole for details.

config IP_DEFRAG
	bool "Support IP datagram reassembly"
	help
	  Selecting this will enable IP datagram reassembly according
	  to the algorithm in RFC815.

config NET_MAXDEFRAG
	int "Size of buffer used for IP datagram reassembly"
	depends on IP_DEFRAG
	default 16384
	range 1024 65536
	help
	  This defines the size of the statically allocated buffer
	  used for reassembly, and thus an upper bound for the size of
	  IP datagrams that can be received.

config TFTP_BLOCKSIZE
	int "TFTP block size"
	default 1468
	help
	  Default TFTP block size.
	  The MTU is typically 1500 for ethernet, so a TFTP block of
	  1468 (MTU minus eth.hdrs) provides a good throughput with
	  almost-MTU block sizes.
	  You can also activate CONFIG_IP_DEFRAG to set a larger block.

config TFTP_WINDOWSIZE
	int "TFTP window size"
	default 1
	help
	  Default TFTP window size.
	  RFC7440 defines an optional window size of transmits,
	  before an ack response is required.
	  The default TFTP implementation implies a window size of 1.

config TFTP_TSIZE
	bool "Track TFTP transfers based on file size option"
	depends on CMD_TFTPBOOT
	default y if (ARCH_OMAP2PLUS || ARCH_K3)
	help
	  By default, TFTP progress bar is increased for each received UDP
	  frame, which can lead into long time being spent for sending
	  data over the UART. Enabling this option, TFTP queries the file
	  size from server, and if supported, limits the progress bar to
	  50 characters total which fits on single line.

config SERVERIP_FROM_PROXYDHCP
	bool "Get serverip value from Proxy DHCP response"
	help
	  Allows bootfile config to be fetched from Proxy DHCP server
		while IP is obtained from main DHCP server.

config SERVERIP_FROM_PROXYDHCP_DELAY_MS
	int "# of additional milliseconds to wait for ProxyDHCP response"
	default 100
	help
	  Amount of additional time to wait for ProxyDHCP response after
		receiving response from main DHCP server. Has no effect if
		SERVERIP_FROM_PROXYDHCP is false.

endif   # if NET
```

## net/lwip/Kconfig
```kconfig
#
# Network configuration (with lwIP stack)
#

if NET_LWIP

config LWIP_ICMP_SHOW_UNREACH
	bool "Print ICMP Destination Unreachable messages"
	default y
	depends on CMD_TFTPBOOT || CMD_SNTP
	select PROT_ICMP_LWIP
	help
	  Prints a message whenever an ICMP Destination Unreachable message is
	  received while running a network command that sends requests via UDP.
	  Enabling this can make troubleshooting easier.

config LWIP_DEBUG
	bool "Enable debug traces in the lwIP library"
	help
	  Prints messages to the console regarding network packets that go in
          and out of the lwIP library.

config LWIP_DEBUG_RXTX
	bool "Dump packets sent and received by lwIP"
	help
	  Performs an hexadecimal & ASCII dump of the data received and sent by
	  the lwIP network stack.

config LWIP_ASSERT
	bool "Enable assertions in the lwIP library"
	help
	  Compiles additional error checking code into the lwIP library. These
	  checks are related to conditions that should not happen in typical
	  use, but may be helpful to debug new features.

config PROT_DHCP_LWIP
	bool
	select PROT_UDP_LWIP

config PROT_DNS_LWIP
	bool
	select PROT_UDP_LWIP

config PROT_ICMP_LWIP
	bool

config PROT_RAW_LWIP
	bool

config PROT_TCP_LWIP
	bool

config PROT_TCP_SACK_LWIP
	bool "TCP SACK support"
	depends on PROT_TCP_LWIP
	default y
	help
	  TCP protocol with selective acknowledgements. Improves
	  file transfer speed in wget.

config PROT_UDP_LWIP
	bool

config LWIP_TCP_WND
	int "Value of TCP_WND"
	default 32768 if ARCH_QEMU
	default 3000000
	help
	  Default value for TCP_WND in the lwIP configuration
	  Lower values result in slower wget transfer speeds in
	  general, especially when the latency on the network is high,
	  but QEMU with "-net user" needs no more than a few KB or the
	  transfer will stall and eventually time out.

config USE_TFTPSERVERIP
	bool "Set a default 'tftpserverip' value in the environment"
	depends on CMD_TFTPBOOT
	help
	  Defines a default value for the IP address of a TFTP server to
	  contact when using the "tftpboot" command.  (Environment variable
	  "tftpserverip")

config TFTPSERVERIP
	string "Value of the default 'tftpserverip' value in the environment"
	depends on USE_TFTPSERVERIP

endif # NET_LWIP
```

## test/Kconfig
```kconfig
menu "Testing"

config UNIT_TEST
	bool "Unit tests"
	depends on CMDLINE
	help
	  Select this to compile in unit tests for various parts of
	  U-Boot. Test suites will be subcommands of the "ut" command.
	  This does not require sandbox to be included, but it is most
	  often used there.

config SPL_UNIT_TEST
	bool "Unit tests in SPL"
	depends on SPL
	# We need to be able to unbind devices for tests to work
	select SPL_DM_DEVICE_REMOVE
	help
	  Select this to enable unit tests in SPL. Most test are designed for
	  running in U-Boot proper, but some are intended for SPL, such as
	  of-platdata and SPL handover. To run these tests with the sandbox_spl
	  board, use the -u (unit test) option.

if UNIT_TEST

config UNIT_TEST_DURATION
	bool "Report unit-test duration"
	default y
	help
	  Enable this short the time taken by each test suite. This is reported
	  after the suite runs, alongside the pass/fail results. In addition,
	  an overall total is reported if multiple suites are run.

config UT_LIB
	bool "Unit tests for library functions"
	default y if !SANDBOX_VPL
	help
	  Enables the 'ut lib' command which tests library functions like
	  memcat(), memcyp(), memmove() and ASN1 compiler/decoder.

if UT_LIB

config UT_LIB_ASN1
	bool "Unit test for asn1 compiler and decoder function"
	depends on SANDBOX && !MBEDTLS_LIB_X509
	default y
	imply ASYMMETRIC_KEY_TYPE
	imply ASYMMETRIC_PUBLIC_KEY_SUBTYPE
	imply X509_CERTIFICATE_PARSER
	imply PKCS7_MESSAGE_PARSER
	imply RSA_PUBLIC_KEY_PARSER
	help
	  Enables a test which exercises asn1 compiler and decoder function
	  via various parsers.

config UT_LIB_CRYPT
	bool "Unit test for crypt-style password hashing"
	depends on !SPL && AUTOBOOT_KEYED && AUTOBOOT_ENCRYPTION
	default y
	select CRYPT_PW
	select CRYPT_PW_SHA256
	select CRYPT_PW_SHA512
	help
	  Enables a test for the crypt-style password hash functions.

config UT_LIB_RSA
	bool "Unit test for rsa_verify() function"
	depends on RSA
	depends on RSA_VERIFY_WITH_PKEY
	select IMAGE_SIGN_INFO
	default y
	help
	  Enables rsa_verify() test, currently rsa_verify_with_pkey only()
	  only, at the 'ut lib' command.

endif  # UT_LIB

config UT_BOOTSTD
	bool "Unit tests for standard boot"
	depends on BOOTSTD && SANDBOX
	default y

config UT_COMPRESSION
	bool "Unit test for compression"
	depends on CMDLINE && GZIP_COMPRESSED && BZIP2 && LZMA && LZO && LZ4 && ZSTD
	default y
	help
	  Enables tests for compression and decompression routines for simple
	  sanity and for buffer overflow conditions.

config UT_LOG
	bool "Unit tests for logging functions"
	default y
	help
	  Enables the 'ut log' command which tests logging functions like
	  log_err().
	  See also CONFIG_LOG_TEST which provides the 'log test' command.

config UT_TIME
	bool "Unit tests for time functions"
	help
	  Enables the 'ut time' command which tests that the time functions
	  work correctly. The test is fairly simple and will not catch all
	  problems. But if you are having problems with udelay() and the like,
	  this is a good place to start.

config UT_UNICODE
	bool "Unit tests for Unicode functions"
	default y
	select CHARSET
	help
	  Enables the 'ut unicode' command which tests that the functions for
	  manipulating Unicode strings work correctly.

source "test/dm/Kconfig"
source "test/env/Kconfig"
source "test/image/Kconfig"
source "test/lib/Kconfig"
source "test/optee/Kconfig"
source "test/fdt_overlay/Kconfig"

endif  # UNIT_TEST

config POST
	bool "Power On Self Test support"
	depends on ARM || PPC
	help
	  See doc/README.POST for more details

endmenu
```

## test/dm/Kconfig
```kconfig
config DM_TEST
	bool "Enable driver model test command"
	depends on SANDBOX && CMD_DM
	help
	  This enables the 'dm test' command which runs a series of unit
	  tests on the driver model code. Each subsystem (uclass) is tested.
	  If all is well then all tests pass although there will be a few
	  messages printed along the way.
```

## test/fdt_overlay/Kconfig
```kconfig
config UT_FDT_OVERLAY
	bool "Enable Device Tree Overlays Unit Tests"
	depends on OF_CONTROL && SANDBOX
	default y
	select OF_LIBFDT_OVERLAY
	help
	  This enables the 'ut overlay' command which runs a series of unit
	  tests on the fdt overlay code.
	  If all is well then all tests pass although there will be a few
	  messages printed along the way.
```

## test/image/Kconfig
```kconfig
# SPDX-License-Identifier: GPL-2.0+
# Copyright (C) 2023 Sean Anderson <seanga2@gmail.com>

config SPL_UT_LOAD
	bool "Unit tests for SPL load methods"
	depends on SPL_UNIT_TEST
	default y if SANDBOX
	help
	  Test various SPL load methods.

if SPL_UT_LOAD

config SPL_UT_LOAD_OS
	bool "Test loading from the host OS"
	depends on SANDBOX && SPL_LOAD_FIT
	default y
	help
	  Smoke test to ensure that loading U-boot works in sandbox.

endif
```

## test/lib/Kconfig
```kconfig
# SPDX-License-Identifier: GPL-2.0+
# Copyright 2022 Google LLC

if SANDBOX

config TEST_KCONFIG
	bool "Enable detection of Kconfig macro errors"
	help
	  This is used to test that the IF_ENABLED_INT() macro causes a build error
	  if the value is used when the CONFIG Is not enabled.

config TEST_KCONFIG_ENABLE
	bool "Option to enable"
	help
	  This is the option that controls whether the value is present.

config TEST_KCONFIG_VALUE
	int "Value associated with the option"
	depends on TEST_KCONFIG_ENABLE
	help
	  This is the value whgch is present if TEST_KCONFIG_ENABLE is enabled.

endif # SANDBOX
```

## test/optee/Kconfig
```kconfig
config UT_OPTEE
	bool "Enable OP-TEE Unit Tests"
	depends on OF_CONTROL && OPTEE
	select OPTEE_LIB
	default y
	help
	  This enables the 'ut optee' command which runs a series of unit
	  tests on the optee library code..
```

## test/overlay/Kconfig
```kconfig
config UT_OVERLAY
	bool "Enable Device Tree Overlays Unit Tests"
	depends on OF_LIBFDT_OVERLAY
	depends on UNIT_TEST
	help
	  This enables the 'ut overlay' command which runs a series of unit
	  tests on the fdt overlay code.
	  If all is well then all tests pass although there will be a few
	  messages printed along the way.
	  Be warned that it requires an out-of-tree dtc compiler with patches
	  to support the DT overlays, otherwise it will fail.
```

## test/py/tests/test_efi_capsule/uboot_bin_env.its
```
/*
 * Automatic software update for U-Boot
 * Make sure the flashing addresses ('load' prop) is correct for your board!
 */

/dts-v1/;

/ {
	description = "Automatic U-Boot environment update";
	#address-cells = <2>;

	images {
		u-boot-bin@100000 {
			description = "U-Boot binary on SPI Flash";
			data = /incbin/("BINFILE1");
			compression = "none";
			type = "firmware";
			arch = "sandbox";
			load = <0>;
			hash-1 {
				algo = "sha1";
			};
		};
		u-boot-env@150000 {
			description = "U-Boot environment on SPI Flash";
			data = /incbin/("BINFILE2");
			compression = "none";
			type = "firmware";
			arch = "sandbox";
			load = <0>;
			hash-1 {
				algo = "sha1";
			};
		};
	};
};
```
