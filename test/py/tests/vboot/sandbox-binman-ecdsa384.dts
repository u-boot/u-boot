// SPDX-License-Identifier: GPL-2.0+

/dts-v1/;

/ {
	#address-cells = <1>;
	#size-cells = <1>;

	binman {
		filename = "sandbox.img";

		pre-load {
			 content = <&image>;
			 algo-name = "sha256,ecdsa384";
			 key-name = "dev.pem";
			 header-size = <4096>;
			 version = <1>;
		};

		image: blob-ext {
			 filename = "test.fit";
		};
	};
};
