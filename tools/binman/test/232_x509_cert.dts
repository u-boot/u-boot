// SPDX-License-Identifier: GPL-2.0+

/dts-v1/;

/ {
	#address-cells = <1>;
	#size-cells = <1>;

	binman {
		ti-x509-cert {
			content = <&image>;
		};

		image: blob-ext {
			filename = "tosign.bin";
		};
	};
};
