// SPDX-License-Identifier: GPL-2.0+

/dts-v1/;

#include <sandbox_efi_capsule.h>

/ {
	#address-cells = <1>;
	#size-cells = <1>;

	binman {
		efi-capsule {
			image-index = <0x1>;
			/* Image GUID for testing capsule update */
			image-type-id = SANDBOX_UBOOT_IMAGE_GUID;
			hardware-instance = <0x0>;
		};
	};
};
