// SPDX-License-Identifier: GPL-2.0+

/dts-v1/;

/ {
	#address-cells = <1>;
	#size-cells = <1>;

	binman {
		efi-capsule {
			type = "efi-capsule-cfg-file";
			cfg-file = "capsule_cfg_file.txt";
		};
	};
};
