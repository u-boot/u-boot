// SPDX-License-Identifier: GPL-2.0+

/dts-v1/;

/ {
	binman {
		efi-capsule {
			image-index = <0x1>;
			/* Image GUID for testing capsule update */
			image-guid = "binman-test";
			hardware-instance = <0x0>;
			monotonic-count = <0x1>;
			dump-signature;
			private-key = "pkcs11:token=U-Boot%20token;object=test_key;type=private;pin-value=1111";
			public-key-cert = "pkcs11:token=U-Boot%20token;object=test_cert;type=cert;pin-value=1111";

			blob {
				filename = "capsule_input.bin";
			};
		};
	};
};
