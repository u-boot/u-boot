// SPDX-License-Identifier: GPL-2.0+

/dts-v1/;

/ {
	#address-cells = <1>;
	#size-cells = <1>;

	binman {
		nxp-imx8mimage {
			args;	/* TODO: Needed by mkimage etype superclass */
			nxp,boot-from = "fspi";
			/* Default nxp,fspi-header-filename = "fspi_header.bin"; */
			nxp,rom-version = <2>;
			nxp,loader-address = <0x10>;
		};
	};
};
