// SPDX-License-Identifier: GPL-2.0+

/dts-v1/;

/ {
	#address-cells = <1>;
	#size-cells = <1>;

	binman {
		renesas-rcar4-sa0 {
			filename = "sa0.bin";
			renesas,loader-address = <0x10>;

			fill {	/* Oversize fill to cover size check */
				size = <0x140000>;
				fill-byte = [ff];
			};
		};
	};
};
