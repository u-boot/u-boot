// SPDX-License-Identifier: GPL-2.0+

/dts-v1/;

/ {
	#address-cells = <1>;
	#size-cells = <1>;

	binman {
		ti-secure {
			content = <&unsecure_binary>;
			proc-id = <0x20>;
			flags-set = <0x00000001>;
			// Missing: flags-clr, reset-vector, dest-addr, auth-type
		};
		unsecure_binary: blob-ext {
			filename = "ti_unsecure.bin";
		};
	};
};
